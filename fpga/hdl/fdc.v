// Обёртка чужого ядра ВГ93 под нашу шину и наш дисковод.
//
// Само ядро — hdl/vendor/fdc1793, разбор и замеры там же в README. Подмодули
// взяты как есть (кроме правок из README, «Наши правки»), верхний уровень свой —
// hdl/fdc_core.v; всё, что ниже, — это то, чего ядру для «Вектора» не хватает.
//
// ЧЕГО НЕ ХВАТАЕТ ЯДРУ, и почему это здесь:
//
//   1. ВЫБОРКА НА ЧТЕНИИ. Ядро выдаёт на шину по одному ~nRD, без проверки
//      выборки: оно рассчитано на внешний буфер 245, который и запирается по
//      CS. Внутри ПЛИС такого буфера нет, и без доквалификации ядро лезло бы на
//      шину при ЛЮБОМ чтении ввода-вывода, чужом в том числе.
//   2. ЗАНЯТОСТЬ СЛИШКОМ КОРОТКАЯ. Автомат ядра крутится на 16 МГц, а у живой
//      ВГ93 на 1 МГц: команда, не трогающая носитель, держит занятость 500 нс
//      (замерено). Опрос у «Вектора» — это IN 1Bh с проверкой, единицы
//      микросекунд, и занятость он бы не застал ни разу. Продлеваем.
//   3. ГОТОВНОСТЬ ЗАШИТА. В ядре стоит assign wCPRDY = 1'b1, вывод FDC_RDY не
//      подключён вовсе. Разряд 7 состояния подменяем настоящим сигналом привода.
//   4. ВЫБОР ПРИВОДА И СТОРОНЫ. У 179x таких выходов нет по построению, они
//      внешние — и у Кишинёва, и у Atari. Держим регистр порта 0x1C.
//   5. МОТОР. У 179x выхода мотора тоже нет.
//
// АДРЕСА. У «Вектора» две младшие линии адреса к контроллеру ИНВЕРТИРОВАНЫ,
// поэтому порядок портов обратный вэдэшному: 0x18 данные, 0x19 сектор,
// 0x1A дорожка, 0x1B команда и состояние. Ядро же нумерует регистры по-
// вэдэшному (2'b00 состояние, 2'b11 данные), так что адрес к нему
// идёт инвертированным. Сверено с vector06cc В. Славинского, где тот же
// перевод сделан явно: hostio_addr = {A[2], ~A[1:0]}.
//
// ТАКТ. Автомату ядра нужно 16 МГц: константы задержек посчитаны от них
// (DELAY30 = 234 при предделителе 2048 даёт 30 мс ровно). Делением 50 МГц
// нацело они не получаются, а запас у ядра по частоте ЧЕТЫРЕ ПРОЦЕНТА
// (замерено: при 33,3 вместо 32 МГц на входе делителя чтение не идёт вовсе),
// поэтому 16 МГц даёт ФАПЧ (pll_fdc.v), и CORE_CLK_DIV = 0 -- ядро их не
// делит. CORE_CLK_DIV = 1 -- на `clk_fdc` 32 МГц, ядро делит надвое.
//
// Разряды порта 0x1C: сторона подтверждена живой ДОС, мотор -- нет, см.
// параметры ниже.
`default_nettype none

module fdc #(
    // Порты ВГ93 у «Вектора»: 0x18 данные, 0x19 сектор, 0x1A дорожка,
    // 0x1B команда и состояние, 0x1C выбор привода и стороны.
    parameter [7:0]   PORT_BASE = 8'h18,
    parameter [7:0]   PORT_SEL  = 8'h1C,
    // Продление занятости: 2500 тактов по 20 нс = 50 мкс, заведомо длиннее
    // одного цикла опроса на 8080.
    parameter integer BUSY_MIN  = 2500,
    // РАЗРЯДЫ ПОРТА 0x1C. Снято при загрузке МикроДОС T-72 с дискеты,
    // регистратор ловил каждую запись в 0x1C. 449 записей, только 34h и 30h,
    // чтений -- ни одного:
    //   * разряд 2 -- СТОРОНА, подтверждено: при чтении системных дорожек ДОС
    //     гоняла его туда и обратно, остальное не менялось. Нулевую сторону
    //     загрузчик читает при разряде 2 = 1;
    //   * разряды 4 и 5 -- всегда 1 (это ORI 30h в коде ДОС). Какой из
    //     двух мотор и мотор ли вообще, лог не различает: оба не менялись ни
    //     разу. Мотор по умолчанию -- НЕ по ним, а по обращениям (MOTOR_HOLD,
    //     MOTOR_BY_REG ниже);
    //   * разряд 0 -- привод, НЕ ПРОВЕРЕНО: второго привода не было, он стоял в 0.
    parameter integer SEL_DRIVE_BIT = 0,
    parameter integer SEL_SIDE_BIT  = 2,
    parameter [7:0]   SEL_MOTOR_MASK = 8'h30,   // мотор, если в регистре есть хоть один
    // 1 -- мотор, пока занято или идёт запись. Оставлено на случай, если
    // разряды 4-5 окажутся не мотором.
    parameter integer MOTOR_BY_BUSY = 0,
    // Мотор -- по обращениям: крутится, пока к контроллеру обращаются, и ещё
    // MOTOR_HOLD тактов clk после последней записи в 0x1C, обращения к
    // 0x18..0x1B или конца занятости (по умолчанию 3 с при 50 МГц), на все
    // приводы сразу. Так у кишинёвской платы (база P-CAD M.PCB, 1995):
    // одновибратор АГ3 запускается каждой записью в 0x1C, его выход -- линия
    // мотора и разрешение дешифратора выборки; разряды регистра мотор не
    // ведут, их там всего два -- привод (0) и сторона (2). Обращения к
    // 0x18..0x1B -- наше добавление. Проверено на живом 3,5":
    //   * по разрядам 4-5 мотор не гас никогда: МикроДОС держит их в единице;
    //   * после сброса, когда ДОС поднята с квазидиска, БИОС ждёт готовности,
    //     опрашивая 0x1B, -- без нашего добавления мотор бы не включился,
    //     индекса без мотора нет, зависание до передёргивания дискеты. Gotek
    //     индекс даёт и без мотора, на нём не видно.
    // 0 -- без выдержки. 3 с -- как у оригинального контроллера: при более
    // короткой выдержке мотор 3,5" при форматировании останавливался между
    // дорожками -- программа между командами считает и печатает до ~1,6 с
    // (журнал ВГ93, блок 7), и каждая дорожка начиналась с раскрутки.
    parameter integer MOTOR_HOLD = 150000000,
    // 1 -- мотор ещё и только при разрядах SEL_MOTOR_MASK в 0x1C; 0 -- по
    // одним обращениям.
    parameter integer MOTOR_BY_REG = 0,
    // 1 -- выборка привода живёт столько же, сколько мотор (MOTOR_HOLD): в
    // простое светодиод привода гаснет. Так у Кишинёва: выход АГ3 разрешает
    // дешифратор выборки (база P-CAD M.PCB). PC-привод выдаёт индекс, дорожку 0 и
    // данные только выбранным -- опрос 0x1B выборку и возвращает. 0 -- выборка
    // всегда (светодиод горит постоянно).
    parameter integer SELECT_HOLD = 1,
    // 1 -- на clk_fdc 32 МГц, ядро делит надвое; 0 -- на clk_fdc уже 16 МГц
    parameter integer CORE_CLK_DIV = 1,
    // Готовность «по индексу»: привод готов, пока индекс приходил не дольше
    // RDY_TIMEOUT тактов clk назад (по умолчанию 1 с при 50 МГц -- пять оборотов).
    parameter integer RDY_TIMEOUT = 50000000
) (
    input  wire       clk,          // 50 МГц, наш домен
    input  wire       clk_fdc,      // 32 МГц для ядра (16 при CORE_CLK_DIV = 0)
    input  wire       clk_fdc_lock, // 1 -- такт clk_fdc устоялся (захват ФАПЧ)
    input  wire       reset,
    // Выключатель: 0 -- порты 0x18..0x1C не отвечают, выходы к приводу
    // неактивны. Для машины со своим контроллером дисковода.
    input  wire       enable,
    // Откуда разряд 7 состояния («не готов»):
    //   0 -- с контакта 34 (переделанный привод: RDY вместо смены диска);
    //   1 -- по индексу: импульсы шли за последние RDY_TIMEOUT -- готов. Годится
    //        и к заводскому PC-приводу, у которого на 34 смена диска;
    //   2, 3 -- всегда готов.
    // БИОС ждёт готовности без предела (T-34, петля у E7F6h), а загрузчики без
    // дискеты пробуют дисковод: с «всегда готов» ядро без индекса не выдаст
    // «сектор не найден» никогда, и загрузка встанет.
    input  wire [1:0] rdy_sel,
    // Предкомпенсация записи (mfm_wr.v): величина сдвига импульса, шагов по
    // 62,5 нс, 0..8 (0 -- выключена); precomp_tg43 = 1 -- только с 44-й
    // дорожки (вывод TG43 ВГ93), 0 -- на всех, как у кишинёвской платы, где
    // TG43 не подключён. Пятидюймовым нужна на внутренних дорожках, 3,5" --
    // обычно нет.
    input  wire [3:0] precomp,
    input  wire       precomp_tg43,

    input  wire [7:0] port,         // адрес ввода-вывода
    input  wire       iord,         // активные высокие, уровнем
    input  wire       iowr,
    input  wire [7:0] din,
    output wire [7:0] dout,
    output wire       dout_oe,

    output wire       fdd_ds0_n,
    output wire       fdd_ds1_n,
    output wire       fdd_moton_n,
    output wire       fdd_dir_n,
    output wire       fdd_step_n,
    output wire       fdd_wdata_n,
    output wire       fdd_wgate_n,
    output wire       fdd_side1_n,
    input  wire       fdd_index_n,
    input  wire       fdd_trk00_n,
    input  wire       fdd_wpt_n,
    input  wire       fdd_rdata_n,
    input  wire       fdd_rdy_n,

    output wire       drq,
    output wire       intrq,
    // Диагностика (блок 0x78, top.v): байт 0 -- последняя команда (запись в
    // 0x1B), 1 -- последнее состояние, прочитанное машиной вне занятости, 2 --
    // дорожка (запись в 0x1A), 3 -- сектор (запись в 0x19), 4 -- байтов данных
    // взято из 0x18, 5 -- синхрослов адресных меток, найденных декодером, 6 --
    // импульсов данных с головки / 256, 7 -- импульсов индекса. Счётчики идут
    // по кругу, смысл -- в разности двух чтений.
    output wire [63:0] dbg
);

// ---------------------------------------------------------------- дешифрация
wire sel_reg = enable & (port[7:2] == PORT_BASE[7:2]);   // 0x18...0x1B
wire sel_sel = enable & (port      == PORT_SEL);         // 0x1C
wire ncs     = ~(sel_reg & (iord | iowr));
wire nrd     = ~(sel_reg & iord);
wire nwr     = ~(sel_reg & iowr);

// ---------------------------------------------- регистр выбора привода 0x1C
reg [7:0] r_sel;
always @(posedge clk or posedge reset)
    if (reset)              r_sel <= 8'h00;
    else if (sel_sel & iowr) r_sel <= din;

wire sel_drive = r_sel[SEL_DRIVE_BIT];
wire sel_side  = r_sel[SEL_SIDE_BIT];

// ---------------------------------------------------------------- само ядро
// Сброс в домен ядра: взводится сразу, снимается по такту clk_fdc через два
// триггера. Иначе снятие сброса из домена clk приходит в триггеры ядра в
// произвольной фазе их такта (Diamond видит переход 50 -> 16 МГц от
// por_cnt). Остальные входы ядра -- стробы шины, они держатся сотни
// наносекунд и ядро их ловит само, а адрес и данные при них стоят.
// Сброс держится и до захвата ФАПЧ: сброс по питанию кончается через 5 мкс
// после конфигурации, а захват -- до 15 мс (DS-02056, табл. 3.29). Без этого
// автомат ядра шагал бы на неустоявшемся такте, если команду дадут сразу.
// Захват асинхронен clk_fdc, но
// снятие всё равно идёт через те же два триггера.
wire       core_rst = reset | ~clk_fdc_lock;
reg [1:0] nres_s = 2'b00;
always @(posedge clk_fdc or posedge core_rst)
    if (core_rst) nres_s <= 2'b00;
    else          nres_s <= {nres_s[0], 1'b1};

wire [7:0] core_do;
wire       core_drq, core_intrq, core_wg, core_wd, core_step, core_dir, core_tg43;
wire       core_hld, core_busy_raw, core_sync;

// ВХОДЫ ОТ ПРИВОДА -- ЧЕРЕЗ ДВА ТРИГГЕРА В ДОМЕН ЯДРА. Импульсы
// данных асинхронны такту ядра, а DPLL.v берёт их одним триггером и выход
// этого же триггера сразу пускает в логику (oRAWR = rRDDT1 & rRDDT2): при
// фронте данных у фронта такта первый триггер зависает, и таблица разделителя
// с декодером видят разное -- редкие битые биты, метки и CRC не сходятся:
// приводы выбираются, крутятся и шагают, а чтение то идёт, то нет. Индекс,
// дорожка 0 и защита -- туда же: ядро ловит их фронты тем же способом.
// Задержка в два такта 16 МГц (125 нс) одинакова для всех импульсов и
// разделителю не мешает.
reg [1:0] rd_s = 2'b11, ix_s16 = 2'b11, t0_s = 2'b11, wp_s = 2'b11;
always @(posedge clk_fdc) begin
    rd_s   <= {rd_s[0],   fdd_rdata_n};
    ix_s16 <= {ix_s16[0], fdd_index_n};
    t0_s   <= {t0_s[0],   fdd_trk00_n};
    wp_s   <= {wp_s[0],   fdd_wpt_n};
end

fdc_core #(.CLK_DIV(CORE_CLK_DIV)) core (
    .clk     (clk_fdc),
    .nres    (nres_s[1]),
    .a       (~port[1:0]),                 // инверсия, см. АДРЕСА в шапке
    .din     (din),
    .dout    (core_do),
    .ncs     (ncs),
    .nwr     (nwr),
    .nrd     (nrd),
    .busy    (core_busy_raw),
    .drq     (core_drq),
    .intrq   (core_intrq),
    .rawr_n  (rd_s[1]),
    .wprt_n  (wp_s[1]),
    .tr00_n  (t0_s[1]),
    .index_n (ix_s16[1]),
    .hrdy    (core_hld),                   // выдержка головы: замыкаем на HLD
    .hld     (core_hld),
    .wg      (core_wg),
    .wr_data (core_wd),
    .step    (core_step),
    .dir     (core_dir),
    .tg43    (core_tg43),
    .precomp ((precomp_tg43 & ~core_tg43) ? 4'd0 : precomp),
    .dbg_sync(core_sync)
);
// -------------------------------------------------- продление занятости (2)
// Ядро отпускает занятость в разы быстрее живой микросхемы, и короткие команды
// машина не застанет. Держим разряд 0 взведённым не меньше BUSY_MIN тактов.
// Занятость -- прямо из автомата ядра (такт clk_16), в наш домен через два
// триггера.
reg  [1:0]  busy_s;
always @(posedge clk or posedge reset)
    if (reset) busy_s <= 2'b00;
    else       busy_s <= {busy_s[0], core_busy_raw};
wire core_busy = busy_s[1];
reg  [15:0] busy_cnt;
reg         busy_d;
always @(posedge clk or posedge reset)
    if (reset) begin busy_cnt <= 16'd0; busy_d <= 1'b0; end
    else begin
        busy_d <= core_busy;
        if (core_busy & ~busy_d) busy_cnt <= BUSY_MIN[15:0];
        else if (busy_cnt != 0)  busy_cnt <= busy_cnt - 1'b1;
    end
wire busy_held = core_busy | (busy_cnt != 0);

// ------------------------------------------------------ выдача на шину (1,3)
// Байт ядра наружу отдаём ТОЛЬКО по своей выборке. Разряд 7 (не готов) и
// разряд 0 (занято) подменяем: первый в ядре зашит единицей, второй слишком
// короток.
// ---------------------------------------------- готовность привода (3)
// По индексу: синхронизатор, спад -- «индекс был», счётчик до RDY_TIMEOUT.
// Смена выбранного привода сбрасывает признак: индекс приходит от выбранного.
localparam integer RT_W = $clog2(RDY_TIMEOUT + 1);
reg  [1:0]      idx_s;
reg             idx_d;
reg  [RT_W-1:0] idx_age;
reg             idx_seen;
reg             drv_d;
always @(posedge clk or posedge reset)
    if (reset) begin
        idx_s <= 2'b11; idx_d <= 1'b1; idx_age <= 0; idx_seen <= 1'b0; drv_d <= 1'b0;
    end else begin
        idx_s <= {idx_s[0], fdd_index_n};
        idx_d <= idx_s[1];
        drv_d <= sel_drive;
        if (drv_d != sel_drive) begin idx_seen <= 1'b0; idx_age <= 0; end
        else if (idx_d & ~idx_s[1]) begin idx_seen <= 1'b1; idx_age <= 0; end
        else if (idx_seen) begin
            if (idx_age == RDY_TIMEOUT[RT_W-1:0]) idx_seen <= 1'b0;
            else idx_age <= idx_age + 1'b1;
        end
    end
wire rdy_n_eff = (rdy_sel == 2'd0) ? fdd_rdy_n
               : (rdy_sel == 2'd1) ? ~idx_seen
               :                     1'b0;

wire is_status = sel_reg & (port[1:0] == 2'b11);   // состояние -- это 0x1B
assign dout    = is_status ? {rdy_n_eff, core_do[6:1], busy_held} : core_do;
assign dout_oe = sel_reg & iord;

// ------------------------------------------------------- наружу к дисководу
// Привод и сторона -- из регистра 0x1C, как у кишинёвской платы (база P-CAD:
// регистр -- два триггера ТМ2, разряд 0 -- привод, разряд 2 -- сторона,
// уровень на линии равен разряду). Сторона: разряд 2 = 1 (нулевая сторона
// МикроДОС) -- линия SIDE1 в единице, головка 0. Проверено: Gotek с образом
// МикроДОС T-34 при SIDE1 в нуле читал головку 1 и загрузчик сбрасывался по
// контрольной сумме, с переворотом показал «T:00.0» и загрузился.
// Выключенный контроллер держит все линии к приводу неактивными.
// Мотор (MOTOR_HOLD, MOTOR_BY_REG): свежая запись в 0x1C, обращение к 0x18..0x1B
// или занятость.
localparam integer MH_W = (MOTOR_HOLD > 1) ? $clog2(MOTOR_HOLD + 1) : 1;
reg  [MH_W-1:0] mot_age;
reg             mot_live;
reg  [1:0]      wg_s;                   // запись идёт: из такта ядра -- через два триггера
always @(posedge clk or posedge reset)
    if (reset) wg_s <= 2'b00;
    else       wg_s <= {wg_s[0], core_wg};
wire            mot_kick = (sel_sel & iowr) | (sel_reg & (iord | iowr)) | busy_held | wg_s[1];
always @(posedge clk or posedge reset)
    if (reset) begin mot_live <= 1'b0; mot_age <= 0; end
    else if (mot_kick) begin mot_live <= 1'b1; mot_age <= 0; end
    else if (mot_live) begin
        if (mot_age == MOTOR_HOLD[MH_W-1:0]) mot_live <= 1'b0;
        else mot_age <= mot_age + 1'b1;
    end
wire mot_reg = ((MOTOR_BY_REG == 0) | (|(r_sel & SEL_MOTOR_MASK))) & ((MOTOR_HOLD == 0) | mot_live);

wire sel_on = (SELECT_HOLD == 0) | (MOTOR_HOLD == 0) | mot_live;

assign fdd_ds0_n   = ~enable | ~sel_on |  sel_drive;
assign fdd_ds1_n   = ~enable | ~sel_on | ~sel_drive;
assign fdd_moton_n = ~enable | (MOTOR_BY_BUSY ? ~(busy_held | core_wg) : ~mot_reg);
// Выходы ядра повторяют выводы настоящей ВГ93: STEP -- импульс единицей, DIRC
// = 1 -- к центру, WD уже активна нулём. На шугартовском разъёме STEP и DIR
// активны нулём, а транслятор у нас неинвертирующий: инвертируем здесь. Без
// инверсии в покое шаг стоял бы «нажатым».
assign fdd_dir_n   = ~enable | ~core_dir;
assign fdd_step_n  = ~enable | ~core_step;
assign fdd_wdata_n = ~enable |  core_wd;
assign fdd_wgate_n = ~enable | ~core_wg;
assign fdd_side1_n = ~enable |  sel_side;

assign drq   = core_drq;
assign intrq = core_intrq;

// ------------------------------------------------------------ диагностика
// Метка: импульс в домене ядра -> переключатель -> три триггера в clk.
reg sy_d = 1'b0, sy_t = 1'b0;
always @(posedge clk_fdc) begin
    sy_d <= core_sync;
    if (core_sync & ~sy_d) sy_t <= ~sy_t;
end
reg [2:0] sy_s = 3'b000;
reg [1:0] rp_s = 2'b11;
reg       wr_d = 1'b0, rd_d = 1'b0;
reg [7:0] d_cmd = 8'd0, d_st = 8'd0, d_trk = 8'd0, d_sec = 8'd0, d_rdc = 8'd0,
          d_sync = 8'd0, d_idx = 8'd0;
reg [15:0] d_rdp = 16'd0;
always @(posedge clk) begin
    sy_s <= {sy_s[1:0], sy_t};
    rp_s <= {rp_s[0], fdd_rdata_n};
    wr_d <= sel_reg & iowr;
    rd_d <= sel_reg & iord;
    if (sel_reg & iowr & ~wr_d)
        case (port[1:0])
        2'b11: d_cmd <= din;
        2'b10: d_trk <= din;
        2'b01: d_sec <= din;
        default: ;
        endcase
    if (sel_reg & iord & ~rd_d) begin
        if (port[1:0] == 2'b11 && !busy_held) d_st <= dout;
        if (port[1:0] == 2'b00) d_rdc <= d_rdc + 8'd1;
    end
    if (sy_s[2] != sy_s[1]) d_sync <= d_sync + 8'd1;
    if (rp_s[1] & ~rp_s[0]) d_rdp <= d_rdp + 16'd1;
    if (idx_d & ~idx_s[1])  d_idx <= d_idx + 8'd1;
end
assign dbg = {d_idx, d_rdp[15:8], d_sync, d_rdc, d_sec, d_trk, d_st, d_cmd};

endmodule

`default_nettype wire
