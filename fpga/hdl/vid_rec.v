// Журнал палитры: что машина писала в порты видео, по строкам её растра.
//
// ЗАЧЕМ. Кадр машины 50 Гц, наш VGA -- 60, и строку, которую мы показываем,
// машина показывала в другой момент. Палитру меняют посреди кадра и даже
// посреди строки (мультиколор). Значит для каждой строки машины
// нужно знать, какой палитра была в её начале и что в ней менялось по ходу.
// Строки САМОСТОЯТЕЛЬНЫЕ -- снимок на начало строки плюс
// события, так что проигрыватель (vid_play.v) может взять любую строку в любой
// момент, не ведя палитру от верха кадра.
//
// ЧТО ЛОВИМ -- только записи в порты, других писателей у видео нет:
//   00  управляющее слово ВВ55: с D7 = 1 обнуляет порты A и B;
//   02  порт B: номер бордюра (3..0) и режим 512 (4) -- событие, если сменился;
//   03  порт A: прокрутка, но и строка клавиатуры -- берётся раз в кадр, в
//       момент, когда её читает машина (frame_stb, vid_raster.v);
//   0C..0F  палитра -- событие всегда.
//
// В КАКУЮ ЯЧЕЙКУ ПАЛИТРЫ. У «Вектора» -- в ячейку цвета под лучом, на бордюре и
// в обратном ходе -- в номер бордюра. Отсюда:
//   * запись ВНЕ картинки -- в номер бордюра, как у машины; регистратор ведёт
//     по ней свою палитру, а она уходит в снимки;
//   * запись В КАРТИНКЕ -- ячейку узнаёт проигрыватель при показе, у точки,
//     которую рисует в этом месте строки (vid_play.v). Здесь её не знают:
//     событие уходит с пометкой «под лучом» (разряд 17), а своя палитра НЕ
//     трогается -- иначе снимки следующих строк легли бы в чужую ячейку.
//     Нести такие записи на следующие строки -- забота проигрывателя.
// Картинка -- строки PIC_LINE0..+255 и такты POS_PIC0..+127 растра машины; эти
// же числа у проигрывателя, иначе он и регистратор разойдутся в том, где
// кончается бордюр. Ячейку событие не несёт: у записи вне картинки её берут из
// номера бордюра, который проигрыватель ведёт по тем же событиям порта B.
//
// ПАМЯТЬ -- блочная, запись в 50 МГц, чтение проигрывателем в 40 МГц, по
// строкам КОЛЬЦА (раздел «КОЛЬЦО» ниже): кольцо держит больше кадра, чтобы
// проигрыватель мог показать целиком и предыдущий кадр.
//   журнал: {строка кольца, номер 0..15} -> {под лучом 1, палитра/порт B 1,
//           место 8, значение 8}; за последним событием строки -- слово-конец
//           {11, 0...};
//   снимки: {строка кольца, слово 0..15} -> {разряд порта B, ячейка 8}: слово
//           i -- ячейка палитры i на начало строки, разряд 8 слов 0..4 -- порт
//           B {режим 512, бордюр 3..0}.
// 16 событий на строку -- худший случай, не число из программ: OUT занимает 12
// тактов, строка -- 192, и 12 делит 192 нацело. Семнадцатое не придёт; если
// придёт (сбой растра) -- ovf.
`default_nettype none

module vid_rec #(
    parameter [8:0] PIC_LINE0 = 9'd40,     // как у vid_play.v
    parameter [7:0] POS_PIC0  = 8'd28,     // как у vid_play.v, замер BORD
    parameter [7:0] PAL_ADV   = 8'd5,      // запись в палитру -- на столько тактов раньше
    parameter [8:0] VBL       = 9'd22,     // как у vid_play.v: строки 0..VBL-1 не показываются
    parameter [8:0] RL        = 9'd352     // строк в кольце журнала (см. «КОЛЬЦО»)
) (
    input  wire        clk,
    input  wire        reset,
    input  wire        iowr_reg,      // vu_bus.v
    input  wire [7:0]  port,
    input  wire [7:0]  din,
    input  wire        rast_ok,       // vid_raster.v
    input  wire        line_stb,
    input  wire [8:0]  line_no,
    input  wire [7:0]  pos,
    input  wire        frame_stb,
    output reg  [7:0]  scroll = 8'hFF,
    // где сейчас запись -- для выбора кадра проигрывателем (vid_play.v), в его
    // такте берётся по совпадению двух отсчётов: меняется раз в строку
    output reg  [8:0]  rec_line = 9'd0,   // строка машины, которую пишем
    output reg  [8:0]  fb_last = 9'd0,    // строка кольца, где начат последний кадр
    output reg  [8:0]  fb_prev = 9'd0,    //               и предыдущий
    output reg  [15:0] vm_last = 16'd0,   // ячейки, записанные в гасящих строках
    output reg  [15:0] vm_prev = 16'd0,   //   перед этими кадрами
    // чтение проигрывателем
    input  wire        rclk,
    input  wire        rce,           // разрешение такта чтения: у vid_play в 50 Гц -- через такт
    input  wire [12:0] ev_raddr,      // {строка кольца, событие 0..15}
    output reg  [17:0] ev_q,
    input  wire [12:0] sn_raddr,      // {строка кольца, слово 0..15}
    output wire [8:0]  sn_q,
    output reg  [7:0]  ovf = 8'd0,
    // палитра для снимка экрана (ide_remote.v, 0x57): ячейка pal_ra, тактом
    // позже; номер 16 -- порт B {0, 0, 0, режим 512, бордюр 3..0}. Это
    // палитра, какую ведёт регистратор: по записям вне картинки. Запись в порт
    // под лучом (мультиколор) в неё не попадает -- на снимке одна палитра и
    // один режим на кадр. Адреса 17 и выше читаются нулём.
    input  wire [10:0] pal_ra,
    output wire [7:0]  pal_rd,
    input  wire        lg_hold,       // не используются
    input  wire        rd_stb,
    input  wire [1:0]  rd_kind,
    input  wire [7:0]  rd_a,
    input  wire [7:0]  rd_b
);

// ------------------------------------------------------------ порты
reg [7:0] pal [0:15];
reg [7:0] pa = 8'h00, pb = 8'h00;
integer k;
initial for (k = 0; k < 16; k = k + 1) pal[k] = 8'h00;

wire is_pal  = iowr_reg && port[7:2] == 6'b000011;
wire is_pb   = iowr_reg && port == 8'h02;
wire is_ctl  = iowr_reg && port == 8'h00 && din[7];
wire [7:0] pb_new = is_ctl ? 8'h00 : din;
wire pb_evt  = (is_pb | is_ctl) && pb_new[4:0] != pb[4:0];

// ------------------------------------------------------------ КОЛЬЦО
// Кадр VGA показывает ровно один кадр машины (vid_play.v, «ВЫБОР КАДРА»): в 60
// Гц наш кадр проходит строку машины за 52,8 мкс против 64, и в начале кадра,
// пока машина не ушла от строки 0 дальше порога, показывается ПРЕДЫДУЩИЙ кадр.
// Его верхние строки должны дожить, пока новый кадр пишет свои: кольцо длиннее
// кадра. Строки 0..VBL-1 на VGA чёрные, и их в кольцо не пишем: кадр -- 290
// строк кольца (22..311), кольцо -- RL = 352, запас 62 строки (4 мс). Записи
// в ячейки палитры в гасящих строках проигрыватель не играет, но они снимают
// перенос записей «под лучом» -- для этого маска ячеек на кадр (vm_*).
// Начало кадра в кольце -- на строке VBL; строка L кадра -- fb + L - VBL по
// модулю RL.
localparam [8:0] FRL = 9'd312 - VBL;      // строк кадра в кольце
wire [9:0] fb_next_w = {1'b0, fb_last} + {1'b0, FRL};
wire [8:0] fb_next   = (fb_next_w >= {1'b0, RL}) ? fb_next_w[8:0] - RL : fb_next_w[8:0];
wire [9:0] rl_sum    = {1'b0, (line_no == VBL) ? fb_next : fb_last} + {1'b0, line_no - VBL};
wire [8:0] rl_of     = (rl_sum >= {1'b0, RL}) ? rl_sum[8:0] - RL : rl_sum[8:0];

// ------------------------------------------------------------ память
// Журнал: 16 событий по 18 разрядов на строку кольца, 352 x 16 = 5632 --
// пять банков 1024 x 18 (по два блока EBR, по половине слова) и шестой
// 512 x 18 (один блок, родной режим PDPW8KC), 11 блоков. Снимки: 16 слов по 9
// разрядов на строку -- ячейка палитры и разряд порта B {режим 512, бордюр}
// в словах 0..4 (разряд 8); 5632 x 9 -- шесть банков 1024 x 9, 6 блоков.
// Счёта событий в снимке больше нет: за последним событием строки в журнале
// стоит слово-конец {11, 0...} (запись «под лучом» -- 10, порт B -- 01, так что
// код 11 свободен). Снимок выходит на такт позже адреса, журнал -- на два.
reg        ev_we = 1'b0;
reg [12:0] ev_wa;
reg [17:0] ev_wd;
reg        sn_we = 1'b0;
reg [12:0] sn_wa;
reg [8:0]  sn_wd;

wire [6*18-1:0] ev_bq;
wire [6*9-1:0]  sn_bq;
reg  [2:0]      ev_rb = 3'd0;
reg  [2:0]      sn_rb = 3'd0;
genvar gb, gh;
generate
    for (gb = 0; gb < 5; gb = gb + 1) begin : g_ev
        for (gh = 0; gh < 2; gh = gh + 1) begin : g_h
            bram_sdp #(.AW(10), .DW(9)) b (
                .wclk(clk), .we(ev_we && ev_wa[12:10] == gb), .wa(ev_wa[9:0]),
                .wd(ev_wd[9*gh +: 9]),
                .rclk(rclk), .re(rce), .ra(ev_raddr[9:0]), .q(ev_bq[18*gb + 9*gh +: 9]));
        end
    end
endgenerate
bram_sdp #(.AW(9), .DW(18)) ev5 (
    .wclk(clk), .we(ev_we && ev_wa[12:10] == 3'd5), .wa(ev_wa[8:0]), .wd(ev_wd),
    .rclk(rclk), .re(rce), .ra(ev_raddr[8:0]), .q(ev_bq[18*5 +: 18]));
generate
    for (gb = 0; gb < 6; gb = gb + 1) begin : g_sn
        bram_sdp #(.AW(10), .DW(9)) b (
            .wclk(clk), .we(sn_we && sn_wa[12:10] == gb), .wa(sn_wa[9:0]), .wd(sn_wd),
            .rclk(rclk), .re(rce), .ra(sn_raddr[9:0]), .q(sn_bq[9*gb +: 9]));
    end
endgenerate
always @(posedge rclk) if (rce) begin
    ev_rb <= ev_raddr[12:10];
    sn_rb <= sn_raddr[12:10];
    ev_q  <= ev_bq[18*ev_rb +: 18];
end
assign sn_q = sn_bq[9*sn_rb +: 9];

// ------------------------------------------------------------ строка
reg  [8:0] cur = 9'd0;
reg  [8:0] rl  = 9'd0;                 // строка кольца текущей строки
reg        cur_ok = 1'b0;              // строку пишем: растр опознан, строка видимая
reg  [4:0] n = 5'd0;
reg  [4:0] pb0 = 5'd0;
reg  [15:0] vmask = 16'd0;             // ячейки, записанные вне картинки в гасящих строках

// Место записи: в картинке или нет. Разность по модулю 312 строк не нужна:
// картинка целиком внутри кадра (40 + 256 < 312).
//
// ЗАПИСЬ В ПАЛИТРУ СРАБАТЫВАЕТ НА PAL_ADV ТАКТОВ РАНЬШЕ записи в порт B того
// же OUT -- так в эмуляторе v06x (src/board.cpp: commit_time_pal =
// commit_time - 20, 20 тактов 12 МГц = 5 тактов процессора, подогнано по тесту
// bord2). Без этой поправки тест BORD2 даёт ровные края чёрного провала (точки
// 52 и 124), а у v06x они ступенькой: 42/53 и 114/125 -- запись палитры на
// такте 54 срабатывает на точке 2 x (54 - 5 - 28) = 42.
// Граница картинки POS_PIC0 снята тестом BORD по порту B, поэтому у записи в
// палитру и место, и признак «в картинке» -- по такту pal_pos; запись в
// первые PAL_ADV тактов строки считаем тактом 0.
wire [7:0] pal_pos = (pos >= PAL_ADV) ? pos - PAL_ADV : 8'd0;
wire [8:0] pic_row = cur - PIC_LINE0;
wire [7:0] pic_pos = pal_pos - POS_PIC0;
wire       in_pic  = (cur >= PIC_LINE0) && (pic_row < 9'd256) &&
                     (pal_pos >= POS_PIC0) && (pic_pos < 8'd128);
// Шаг записи снимка: 1..16 -- слова 0..15 этой строки, прямо из рабочей
// палитры, за 16 тактов после начала строки: запись в порт, попавшая в эти
// 320 нс, окажется и в снимке, и в журнале, -- проигрыватель применит её
// дважды, с тем же итогом. На шаге 2 -- слово-конец в событие 0, если строка
// ещё без событий.
reg  [4:0] sq = 5'd0;
reg        term_p = 1'b0;              // за событием -- слово-конец в следующее
reg [12:0] term_a = 13'd0;

reg  [7:0] pal_rd_r = 8'h00;
always @(posedge clk)
    pal_rd_r <= pal_ra[10]           ? 8'h00
              : !pal_ra[4]           ? pal[pal_ra[3:0]]
              : pal_ra[1:0] == 2'd0  ? {3'b000, pb[4:0]} : 8'h00;
assign pal_rd = pal_rd_r;

always @(posedge clk) begin
    ev_we <= 1'b0;
    sn_we <= 1'b0;

    if (is_pal && !in_pic) pal[pb[3:0]] <= din;   // в картинке ячейка неизвестна
    if (is_pal && !in_pic && cur < VBL) vmask[pb[3:0]] <= 1'b1;
    if (iowr_reg && port == 8'h03) pa <= din;
    if (is_ctl) pa <= 8'h00;
    if (is_pb | is_ctl) pb <= pb_new;
    if (frame_stb) scroll <= pa;

    if (line_stb) begin
        cur      <= line_no;
        rec_line <= line_no;
        rl       <= rl_of;
        cur_ok   <= rast_ok && line_no >= VBL;
        if (line_no == VBL && rast_ok) begin
            fb_prev <= fb_last;  fb_last <= fb_next;
            vm_prev <= vm_last;  vm_last <= vmask;
            vmask   <= 16'd0;
        end
        n        <= 5'd0;
        pb0      <= pb[4:0];
        sq       <= 5'd1;
    end
    else if (sq != 5'd0) begin
        // снимок: слова 0..15 этой строки
        sn_we <= cur_ok;
        sn_wa <= {rl, sq[3:0] - 4'd1};
        sn_wd <= {(sq <= 5'd5) ? pb0[sq[2:0] - 3'd1] : 1'b0, pal[sq[3:0] - 4'd1]};
        sq    <= (sq == 5'd16) ? 5'd0 : sq + 5'd1;
    end

    // слово-конец: за последним событием, иначе -- в событие 0 на шаге 2
    // снимка (на такте line_stb журнал может быть занят словом-концом
    // прошлой строки)
    if (term_p) begin
        term_p <= 1'b0;
        ev_we  <= 1'b1; ev_wa <= term_a; ev_wd <= {2'b11, 16'd0};
    end
    else if (sq == 5'd2 && n == 5'd0 && cur_ok) begin
        ev_we  <= 1'b1; ev_wa <= {rl, 4'd0}; ev_wd <= {2'b11, 16'd0};
    end

    // событие: палитра всегда, порт B -- если сменился. Запись в такте
    // line_stb -- первое событие НОВОЙ строки: снимок этой строки взял порт B и
    // палитру до неё. OUT короче 12 тактов машины не бывает, так что
    // слово-конец за прошлым событием к следующему уже записано.
    if ((is_pal | pb_evt) && (line_stb ? (rast_ok && line_no >= VBL) : cur_ok)) begin
        if (!line_stb && n == 5'd16)
            ovf <= (&ovf) ? ovf : ovf + 8'd1;       // семнадцатое -- сбой растра
        else begin
            ev_we <= 1'b1;
            ev_wa <= {line_stb ? rl_of : rl, line_stb ? 4'd0 : n[3:0]};
            ev_wd <= {is_pal & in_pic & ~line_stb, is_pal ? 1'b0 : 1'b1,
                      is_pal ? pal_pos : pos, is_pal ? din : pb_new};
            n     <= line_stb ? 5'd1 : n + 5'd1;
            term_p <= line_stb ? 1'b1 : (n != 5'd15);
            term_a <= {line_stb ? rl_of : rl, line_stb ? 4'd1 : n[3:0] + 4'd1};
        end
    end
    if (reset) begin cur_ok <= 1'b0; sq <= 5'd0; ovf <= 8'd0; term_p <= 1'b0; end
end

endmodule

`default_nettype wire
