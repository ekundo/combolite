// Подставной загрузчик: свой загрузчик в окне 0000-7FFF без замены ПЗУ машины.
//
// МЕХАНИЗМ (у Славинского -- fakerom в vector06c-lesshadoks). После БЛК+СБР машина отключает своё ПЗУ сама, и
// процессор исполняет с адреса 0 из ОЗУ. В этот момент плата выставляет ~БЛК
// (буфер памяти машины закрывается) и отдаёт на чтения свои байты. ПЕРЕКРЫВАЕТСЯ
// ТОЛЬКО ЧТЕНИЕ: записи идут в ОЗУ машины, иначе загружаемому некуда лечь.
// Окно -- вся младшая половина, A15 = 0, образ на 2 КБ повторяется в ней, как
// повторяется настоящее ПЗУ: BOOT26 и рассчитан на то, что читает там себя.
//
// ПРИ ЖИВОМ ПЗУ МАШИНЫ ОКНО ОТКРЫВАТЬ НЕЛЬЗЯ: ~БЛК ПЗУ не гасит, и две
// микросхемы подерутся на шине. ПЗУ включается
// ВВОДом и выключается СБРом, а видно нам только ~СБРОС, общий для обоих.
// Отсюда правило:
//   * окно открывается, когда отпущен НАШ СБР (key_sbr, autostart.v) и
//     загрузчик взведён -- после этой перезагрузки ПЗУ заведомо выключено;
//   * окно закрывается на ЛЮБОМ начале сброса машины. Чей бы ни был ВВОД или
//     СБР, после него ПЗУ может оказаться живым, а наш СБР окно снова откроет.
// Держится это на том, что ВВОД и СБР оба опускают ~СБРОС на разъёме
// (контакт 41). На проверенной машине так и есть: ВВОД тянет
// СБР через диод VD9 клавиатуры, и сброс от него идёт через тот же D17. Если
// на какой-то машине это не так, после ручного ВВОД окно останется открытым
// поверх ПЗУ.
//
// КОНЕЦ ЗАГРУЗКИ. Все пути BOOT26 кончаются циклом, который мигает РУС/ЛАТ --
// разрядом PC3 ВВ55 командой в порт 00h -- и ждёт БЛК+СБР (hdl/vendor/boot26/
// README.md). Насчитав BLINKS смен PC3, модуль развзводится и просит СБР
// (sbr_req); окно гаснет с началом этого сброса, а не раньше -- иначе между
// закрытием и сбросом процессор успел бы исполнить из ОЗУ под окном что попало
// и испортить загруженное. После СБР процессор идёт с 0000 уже по ОЗУ: там
// загрузчик оставил JMP на загруженное.
//
// КОМАНДЫ ESP (0x4C + байт, ide_remote.v): 0 -- развзвести и закрыть окно;
// 1 -- взвести, окно откроется после нашего следующего СБР; 2 -- взвести и
// сразу попросить СБР (обычный путь: ESP ожила, машина в удержании ВВОД).
// То же, что 2, делает auto_boot: так rom_sense.v отвечает на ВВОД с
// клавиатуры, если режим включён (0x56).
//
// ЧТЕНИЕ ИЛИ ЗАПИСЬ -- ПО СЛОВУ СОСТОЯНИЯ, как у Славинского (kvaz.v,
// lesshadoks_top.v: psw по СТРОБ СОСТ.). ~БЛК выставляется только в цикле
// чтения памяти: разряд MEMR (D7) слова состояния этого цикла. Сам строб
// ~ЗПЗУ для этого не годится: он короткий (160-200 нс) и приходит в конце
// цикла, а ~CAS машина дает раньше -- в окне при выставленном ~БЛК он уходил
// на разъем, и записи загрузчика в ОЗУ машины не ложились бы. Слово
// снимается так же, как в vid_raster.v; с началом СТРОБ СОСТ. признак
// сбрасывается, чтобы слово прошлого цикла не действовало в новом.
//
// МЛАДШИЙ БАЙТ АДРЕСА -- с ~ШАП (shap_demux.v), перестановка выведена из схемы
// машины. ~CAS на разъём выходит только при выставленном ~БЛК, так
// что без ~БЛК адреса не было бы вовсе: ~БЛК держится всё время, пока окно
// открыто и A15 = 0, кроме записей и ввода-вывода -- как у Славинского.
`default_nettype none

module fakerom #(
    parameter integer BLINKS = 4
) (
    input  wire       clk,
    input  wire       por,
    input  wire       sys_reset,     // сброс машины (или по питанию)
    input  wire       strob,         // СТРОБ СОСТ.: слово состояния на ШД
    // шина
    input  wire [7:0] a_hi,          // ~ШАВВ в цикле памяти: A15..A8
    input  wire [7:0] a_lo,          // с shap_demux
    input  wire       memrd,         // ~ЧТЗУ очищенный
    input  wire       chtzu_n,       // ~ЧТЗУ живой: снимать шину вместе с машиной
    input  wire       memwr,
    input  wire       zpzu_n,        // ~ЗПЗУ живой: снимать ~БЛК без задержки
    input  wire       iord,
    input  wire       iowr,
    input  wire       iowr_reg,      // импульс записи в порт, vu_bus.v
    input  wire [7:0] din,
    input  wire       kv_on,         // квазидиск выбран: он главнее, данные его
    // управление
    input  wire       cmd_stb,
    input  wire [1:0] cmd,
    input  wire       key_sbr,       // наш СБР нажат (autostart.v)
    input  wire       auto_boot,     // ВВОД с клавиатуры (rom_sense.v): взвести и СБР
    output reg        sbr_req = 1'b0,// нажать СБР
    // наружу
    output wire       blk,           // выставить ~БЛК
    output wire [7:0] dout,
    output wire       dout_oe,
    output reg        on = 1'b0,     // окно открыто
    output reg        armed = 1'b0
);

// ------------------------------------------------------------ управление
reg       key_sbr_r = 1'b0, rst_r = 1'b0;
reg       pc3 = 1'b0;
reg [2:0] blinks = 3'd0;

wire sbr_released = key_sbr_r & ~key_sbr;
wire reset_begins = sys_reset & ~rst_r;

// PC3 ВВ55: прямая запись в порт C (01h) или команда установки разряда в
// управляющий (00h, D7 = 0, D3..D1 = 3). Запись режима (D7 = 1) обнуляет порт C.
reg       pc3_wr;
reg       pc3_new;
always @(*) begin
    pc3_wr  = 1'b0;
    pc3_new = pc3;
    if (iowr_reg) begin
        if (a_hi == 8'h01)                              begin pc3_wr = 1'b1; pc3_new = din[3]; end
        else if (a_hi == 8'h00 && din[7])               begin pc3_wr = 1'b1; pc3_new = 1'b0;   end
        else if (a_hi == 8'h00 && din[3:1] == 3'd3)     begin pc3_wr = 1'b1; pc3_new = din[0]; end
    end
end

always @(posedge clk) begin
    key_sbr_r <= key_sbr;
    rst_r     <= sys_reset;
    sbr_req   <= 1'b0;
    if (pc3_wr) pc3 <= pc3_new;

    if (por) begin
        on <= 1'b0; armed <= 1'b0; blinks <= 3'd0; pc3 <= 1'b0;
    end
    else begin
        if (cmd_stb) case (cmd)
            2'd0:    begin armed <= 1'b0; on <= 1'b0; end
            2'd1:    armed <= 1'b1;
            2'd2:    begin armed <= 1'b1; sbr_req <= 1'b1; end
            default: ;
        endcase
        // После ВВОД с клавиатуры -- то же, что команда 2: машина только что
        // ушла в ПЗУ, наш СБР его выключит и откроет окно (rom_sense.v).
        else if (auto_boot) begin
            armed   <= 1'b1;
            sbr_req <= 1'b1;
        end

        if (reset_begins)
            on <= 1'b0;
        else if (sbr_released & armed) begin
            on     <= 1'b1;
            blinks <= 3'd0;
        end

        // конец загрузки: мигание РУС/ЛАТ в цикле ожидания БЛК+СБР
        if (on & armed & pc3_wr & (pc3_new != pc3)) begin
            if (blinks == BLINKS - 1) begin
                armed   <= 1'b0;     // окно погаснет с началом сброса
                sbr_req <= 1'b1;
            end
            blinks <= blinks + 3'd1;
        end
    end
end

// ---------------------------------------------------------- слово состояния
reg [1:0] st_s = 2'b00;
reg       st_taken = 1'b0;
reg       st_memr = 1'b0;            // этот цикл -- чтение памяти
always @(posedge clk) begin
    st_s <= {st_s[0], strob};
    if (por)
        st_memr <= 1'b0;
    else if (st_s[0] & ~st_s[1])
        st_memr <= 1'b0;             // новый цикл: прошлое слово не в счёт
    if (!st_s[1]) st_taken <= 1'b0;
    else if (!st_taken) begin
        st_taken <= 1'b1;
        st_memr  <= din[7];
    end
end
// ------------------------------------------------------------------ окно
wire win = on & ~a_hi[7] & st_memr;

// Цикл записи отсекает уже слово состояния (st_memr): ~CAS при выставленном
// ~БЛК уходит на разъём, а не в память машины, и байт не лёг бы никуда.
// Стробы записи и ввода-вывода оставлены вторым рубежом.
assign blk = win & ~(memwr | ~zpzu_n | iord | iowr);

wire [7:0] rom_q;
boot_rom rom (.clk(clk), .addr({a_hi[2:0], a_lo}), .q(rom_q));

// Шина -- только на чтении и только пока машина держит строб: подъём по
// очищенному, снятие по живому (как iord в vu_bus.v).
assign dout    = rom_q;
assign dout_oe = win & memrd & ~chtzu_n & ~kv_on;

endmodule

`default_nettype wire
