// Различитель видеоцикла и процессорного цикла на шине «Вектора».
//
// ЗАЧЕМ. Защёлка адреса строки (`DD7`, 574) тактуется каждым спадом `~RAS`,
// включая спады видеоадаптера. Внутрь строба нашего чтения такой спад попадает
// (замерено: ровно один), защёлка берёт видеоадрес, и ОЗУ отдаёт байт по чужому
// адресу. Здесь вырабатывается «сейчас придёт ВИДЕОспад», чтобы такт защёлки
// погасить заранее.
//
// ПОЧЕМУ НЕ ПО ПЕРИОДУ. Спады видеоадаптера идут через 1333 нс (Шашков, 1994,
// `caglrc.cc/scalar/media/w/bus.txt`), период 66..67 тактов без срывов, но
// предсказывать их по периоду нельзя. Механизм `READY` притягивает процессор к
// такту 3 КАЖДОГО цикла, поэтому при непрерывной работе процессорные спады
// периодичны ровно так же. Предсказатель по периоду захватывает один из двух
// потоков и не знает, который; захватив процессорный, гейт гасит процессорные
// строки, и чтения портятся во всех группах. Счётчики периода этого не видят:
// они СИММЕТРИЧНЫ относительно двух потоков -- за какой ни зацепись, второй
// выглядит как «один вставленный спад за период».
//
// ЧЕМ РАЗЛИЧАЮТСЯ НА САМОМ ДЕЛЕ -- ПРОМЕЖУТКОМ ПЕРЕД СПАДОМ. Замер логическим
// анализатором: промежутков между спадами ~RAS ровно четыре -- 480, 520, 800,
// 840 нс, короткий и длинный строго чередуются (751774 и 751774 за секунду, с
// платой и без), и потоки разделены по содержимому ~ШАП: видеоспад -- адрес +1
// каждый цикл, процессорный спад приходит через 480 нс после видеоспада. Значит
// видеоспад -- тот, перед которым был ДЛИННЫЙ промежуток (800-840 нс, 40-42
// такта), процессорный -- после короткого (24-26). Порог GAP_TH = 33 такта,
// запас по 7 в обе стороны, и ни строб, ни его полярность не нужны.
//
// ЧЕМ НЕ РАЗЛИЧАЮТСЯ -- СТРОБОМ. Считать видеоспадом тот, после которого до
// следующего спада не было строба (~ЧТЗУ, ~ЗПЗУ), нельзя: на живой машине такой
// захват не набирается ни в одной полярности. Процессорный ~RAS идёт в КАЖДОМ
// слоте (равенство коротких и длинных промежутков выше), а строб -- нет: у 8080
// есть машинные циклы без памяти (внутренние такты DAD, пятитактный M1 у
// MOV r,r, INX -- на «Векторе» это два слота, второй без строба; IN и OUT --
// строб ввода-вывода, который сюда не заведён). Такой спад проходит как видео,
// и предсказание рвётся сотни раз в секунду. Замеры по стробу ниже оставлены
// для сверки.
//
// vid_pol -- запасной переключатель (команда по SPI): 1 -- видеоспад после
// КОРОТКОГО промежутка. На замеренной машине верен 0.
//
// ПОЧЕМУ ОКНО, А НЕ ИМПУЛЬС. `latch_clk` в `vu_bus` собран КОМБИНАЦИОННО: адрес
// строки держится после спада недолго, лишние такты его теряют. Узнать «это был
// видеоспад» постфактум поздно. Окно поднимается ДО спада, по счётчику фазы.
//
// ОКНО ДЕРЖИТСЯ ДО СНЯТИЯ `~RAS`. Спад на 66-67 такте, а низкий уровень длится
// ещё 13 тактов. Закрой окно по счётчику — `latch_clk` подскочит ВВЕРХ посреди
// низкого `~RAS` и защёлка возьмёт фазу СТОЛБЦА видеоцикла, то есть ту же порчу
// с другой стороны.
//
// ОТКАЗОУСТОЙЧИВОСТЬ. Без захвата окно не поднимается вовсе -- такт защёлки
// идёт как без различителя. Захват теряется на первом промахе. Гейт снаружи ещё и
// отключается командой.
`default_nettype none

module vid_phase #(
    parameter [7:0] P_LO   = 8'd58,   // 1160 нс, окно ожидания видеоспада
    parameter [7:0] P_HI   = 8'd76,   // 1520 нс
    parameter [3:0] LOCK_N = 4'd4,    // сбывшихся предсказаний до захвата
    parameter [7:0] GAP_TH = 8'd33,   // промежуток перед видеоспадом: не короче
    // 0 -- без замеров по стробу (stb_*): они только для info, классификации не
    // нужны, а стоят ~170 eq по yosys
    parameter       STATS  = 1
)(
    input  wire clk,
    input  wire reset,
    input  wire clr,                  // обнулить измерения
    input  wire ras_n,                // сырой с транслятора
    input  wire strobe_n,             // очищенные ~ЧТЗУ и ~ЗПЗУ -- только для замеров
    // 0 -- видеоспад после длинного промежутка (по замеру), 1 -- после короткого
    input  wire vid_pol,

    output wire vid_block,            // окно: такт защёлки гасить
    output reg  locked,

    // измерения, они же независимая проверка классификации
    // ЗАМЕР ПРИВЯЗКИ. Строб принадлежит тому спаду, к которому он привязан
    // ЖЁСТКО: у «своего» спада разброс должен быть узкий, у чужого широкий.
    output reg [7:0] stb_after_min,   // от предыдущего спада до строба
    output reg [7:0] stb_after_max,
    output reg [7:0] stb_before_min,  // от строба до следующего спада
    output reg [7:0] stb_before_max,
    output reg [7:0] vid_lost,        // предсказание не сбылось (насыщается)
    output reg [7:0] vid_state,       // 0 захват, 1 окно, 7:4 счёт совпадений
    // Срабатываний строба между двумя соседними спадами ~RAS. Считается БЕЗ
    // всякой классификации, поэтому годится как проверка самого признака: в
    // чистой картине здесь 0 или 1, у каждого спада свой строб. Двойка и выше
    // означает фантомные фронты на линии строба — а мы знаем, что уровень
    // единицы `~ЧТВВ` заходит под порог транслятора (замер).
    output reg [7:0] stb_max
);

localparam [7:0] SAT = 8'hFF;

reg [1:0] ras_sync, stb_sync;
reg       ras_d, stb_d;
wire      ras_s    = ras_sync[1];
wire      stb_s    = stb_sync[1];
wire      ras_fall = ras_d & ~ras_s;
wire      stb_act  = stb_d & ~stb_s;   // строб пошёл вниз

reg [7:0] since_vid;    // тактов с последнего ВИДЕОспада
reg [7:0] since_fall;   // тактов с любого предыдущего спада
reg [3:0] hits;
reg [7:0] stb_run;      // срабатываний строба с прошлого спада
reg [7:0] since_stb;    // тактов с последнего срабатывания строба
reg [1:0] vid_seen;     // 0 нет опоры, 1 опора сырая, 2 можно мерить
reg       blk, fell;

assign vid_block = locked & blk;

always @(posedge clk) begin
    if (reset) begin
        ras_sync <= 2'b11;  stb_sync <= 2'b11;
        ras_d    <= 1'b1;   stb_d    <= 1'b1;
        since_vid <= 8'd0;  since_fall <= 8'd0;
        hits <= 4'd0;
        vid_seen <= 2'd0;   locked <= 1'b0;
        blk <= 1'b0;        fell <= 1'b0;
        stb_after_min <= 8'hFF; stb_after_max <= 8'h00;
        stb_before_min<= 8'hFF; stb_before_max<= 8'h00;
        vid_lost <= 8'h00;  stb_max <= 8'h00;  stb_run <= 8'h00;
        since_stb <= 8'd0;
    end
    else begin
        ras_sync <= {ras_sync[0], ras_n};
        stb_sync <= {stb_sync[0], strobe_n};
        ras_d <= ras_s;
        stb_d <= stb_s;

        if (clr) begin
            stb_after_min <= 8'hFF; stb_after_max <= 8'h00;
            stb_before_min<= 8'hFF; stb_before_max<= 8'h00;
            vid_lost    <= 8'h00;
            stb_max     <= 8'h00;
        end

        if (since_vid  != SAT) since_vid  <= since_vid  + 1'b1;
        if (since_fall != SAT) since_fall <= since_fall + 1'b1;
        if (STATS && since_stb != SAT) since_stb <= since_stb + 1'b1;

        if (stb_act) begin
            if (STATS) begin
                since_stb <= 8'd1;
                if (stb_run != SAT) stb_run <= stb_run + 1'b1;
                // от предыдущего спада до строба
                if (since_fall < stb_after_min) stb_after_min <= since_fall;
                if (since_fall > stb_after_max) stb_after_max <= since_fall;
            end
        end

        // --- окно: открыть по счётчику, закрыть по снятию ~RAS
        if (locked && (since_vid == P_LO)) begin
            blk  <= 1'b1;
            fell <= 1'b0;
        end
        else if (blk && ras_fall)
            fell <= 1'b1;
        // ЗАКРЫВАТЬ ТОЛЬКО ПРИ СНЯТОМ ~RAS, в обеих ветках: упади окно посреди
        // низкого уровня — `latch_clk` подскочит вверх и защёлка возьмёт фазу
        // СТОЛБЦА.
        // И СЫРОЙ `ras_n` тоже, не только синхронизированный. Синхронизатор
        // отстаёт на два такта, а `latch_clk` собран от сырого — по одному
        // синхронизированному условие в момент реального спада видело бы ещё
        // старое «снят» и роняло окно прямо посреди низкого уровня. Сырой уровень здесь только
        // ОТСРОЧИВАЕТ закрытие и никогда не ускоряет, так что асинхронности
        // он не добавляет.
        else if (blk && ras_s && ras_n && (fell || (since_vid > P_HI)))
            blk <= 1'b0;

        if (ras_fall) begin
            since_fall <= 8'd1;
            if (STATS) begin
                if (stb_run > stb_max) stb_max <= stb_run;
                stb_run <= (stb_act ? 8'd1 : 8'd0);
                // от строба до ЭТОГО спада
                if (since_stb < stb_before_min) stb_before_min <= since_stb;
                if (since_stb > stb_before_max) stb_before_max <= since_stb;
            end

            // --- КЛАССИФИКАЦИЯ: по промежутку перед этим спадом.
            if ((since_fall >= GAP_TH) ^ vid_pol) begin
                // ЭТОТ спад видеоадаптерный -- опора здесь и сейчас
                if (vid_seen == 2'd2) begin
                    if (since_vid >= P_LO && since_vid <= P_HI) begin
                        if (hits != LOCK_N) hits <= hits + 1'b1;
                        else                locked <= 1'b1;
                    end
                    else begin
                        if (vid_lost != SAT) vid_lost <= vid_lost + 1'b1;
                        hits <= 4'd0; locked <= 1'b0; blk <= 1'b0;
                    end
                end
                if (vid_seen != 2'd2) vid_seen <= vid_seen + 1'b1;
                since_vid <= 8'd1;
            end
        end
    end
end

always @(*) vid_state = {hits, 2'b00, blk, locked};

endmodule

`default_nettype wire
