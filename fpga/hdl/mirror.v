// Захват зеркала ОЗУ машины в DD6B и карта «грязных» блоков для ESP.
//
// ЧТО ДЕЛАЕТ. Каждая запись процессора в ОЗУ машины (не в квазидиск) пишется
// ещё и в DD6B, по тому же адресу: это зеркало, по которому генератор кадра
// перерисовывает кадр (vid_fetch.v). Попутно отмечается блок по 256 байт,
// куда писали, --
// ESP забирает эту карту по SPI (0x4D) для снимков экрана и стрима.
//
// АДРЕС СТАТИКЕ ДАЮТ ЗАЩЁЛКИ, А НЕ ПЛИС: строка -- DD7 по latch_clk, столбец --
// DD7B по latch_clk2. И здесь загвоздка: ~CAS на разъём выходит ТОЛЬКО при
// выставленном ~БЛК (замер), а в обычной записи в ОЗУ машины ~БЛК нет.
// Значит такт столбца приходится делать самим: через COL_DELAY тактов после
// спада ~RAS, когда мультиплексор машины уже переключился на столбец (100-110 нс
// после спада, замер) и ~RAS ещё низкий (250 нс). С разбором спада это 140-180
// нс после настоящего спада при COL_DELAY = 6 (симуляция показывает 140-150).
//
// ЧЕЙ ~RAS. Импульс столбца даётся только спаду ~RAS, пришедшему, когда строба
// памяти нет, -- то же правило, что у заморозки защёлки строки (vu_bus.v):
// видеоциклы внутри строба чтения защёлку не перетрогают. Внутрь строба ЗАПИСИ
// чужих спадов ~RAS не попадает вовсе (замер), так что для записи процессорный
// ~RAS -- последний перед стробом или начавшийся с ним.
//
// /CE1 -- ТОЛЬКО В ЗАПИСИ И ТОЛЬКО ПОСЛЕ ТАКТА СТОЛБЦА. /WE обеих микросхем --
// это ~ЗПЗУ машины, /OE -- ~ЧТЗУ. Выбери мы DD6B на чтении, она вышла бы на шину
// данных поверх ОЗУ машины. Поэтому /CE1 собран из ЖИВОГО ~ЗПЗУ и запрещён
// живым ~ЧТЗУ, а ~ЧТЗУ и ~ЗПЗУ разом не бывает (0 из 2049, замер).
// Выброс на ~ЗПЗУ даст лишнюю запись -- но в зеркало, машине это безразлично.
//
// ЧЕГО НЕ ЗНАЕМ. Где ~ЗПЗУ относительно ~RAS на нашей машине, не мерено (у
// чужой -- 160 нс). Если строб начинается раньше такта столбца, запись в DD6B
// короче строба: при 160 нс строба и начале через 60 нс после ~RAS останется
// около 40 нс, на пределе tCW микросхемы на 55 нс. Ответ даёт счётчик miss
// ниже.
`default_nettype none

module mirror #(
    parameter integer COL_DELAY = 6
) (
    input  wire       clk,
    input  wire       por,
    input  wire       en,            // зеркало включено (dev_off[5] = 0)
    input  wire       ras_n,         // живые с разъёма
    input  wire       chtzu_n,
    input  wire       zpzu_n,
    input  wire       memrd,         // очищенные, vu_bus.v
    input  wire       memwr,
    input  wire       kv_on,         // цикл ушёл в квазидиск -- ОЗУ машины не пишется
    input  wire [7:0] a_hi,          // A15..A8
    output reg        col_pulse = 1'b0, // в latch_clk2, по ИЛИ с ~CAS
    output wire       ce1,           // выбрать DD6B
    // карта блоков: 32 байта, разряд i байта j -- блок 8j+i, чтение гасит
    input  wire       dm_start,      // начать выдачу с байта 0
    input  wire       dm_next,       // байт отдан -- следующий
    output reg  [7:0] dm_byte = 8'h00,
    // Записей машины, в которых DD6B так и не выбрали (не было такта столбца
    // этого цикла) -- насыщается. Это и есть замер «где ~ЗПЗУ относительно
    // ~RAS»: не ноль -- зеркало теряет записи, COL_DELAY или правило взвода
    // не годятся для этой машины.
    output reg  [7:0] miss = 8'd0
);

// --------------------------------------------------------- такт столбца
reg [3:0] rs = 4'hF;
always @(posedge clk) rs <= {rs[2:0], ras_n};
wire ras_fall = rs[3] & rs[2] & ~rs[1];

wire ras_rise = ~rs[2] & rs[1];
wire strobe = memrd | memwr;
reg  strobe_d = 1'b0;
reg  col_arm = 1'b1;
reg [3:0] dly = 4'd0;
// Столбец ЭТОГО цикла защёлкнут. Гаснет на спаде ~RAS (новый цикл), на
// подъёме ~RAS без строба (цикл был видео или без обращения) и в конце
// строба. Иначе признак от прошлого цикла доживал бы до записи, начатой
// раньше своего ~RAS, и DD6B выбиралась бы сразу -- по СТАРОМУ адресу
// защёлок.
reg  col_ok = 1'b0;

always @(posedge clk) begin
    strobe_d <= strobe;
    if (strobe)     col_arm <= 1'b0;
    else if (rs[1]) col_arm <= 1'b1;         // взвод при снятом ~RAS

    // Одним присваиванием, а не «ноль по умолчанию, потом единица»: это
    // вывод на защёлку, и в симуляторе двойное присваивание за такт даёт
    // иголку нулевой ширины -- лишний фронт для всех, кто ждёт фронта.
    col_pulse <= ~ras_fall & ((dly == 4'd2) | (dly == 4'd1));  // два такта
    if (ras_fall) begin
        col_ok <= 1'b0;                      // новый цикл -- прежний столбец чужой
        dly    <= col_arm ? COL_DELAY[3:0] : 4'd0;
    end
    else if (dly != 4'd0) begin
        dly <= dly - 4'd1;
        if (dly == 4'd1) col_ok <= 1'b1;
    end
    else if ((ras_rise & ~strobe) | (strobe_d & ~strobe))
        col_ok <= 1'b0;
end

assign ce1 = en & ~kv_on & col_ok & ~zpzu_n & chtzu_n;

reg wrote = 1'b0;                    // в этой записи DD6B выбиралась
reg memwr_d = 1'b0;
reg kv_seen = 1'b0;                  // запись ушла в квазидиск -- не считать
always @(posedge clk) begin
    memwr_d <= memwr;
    if (~memwr_d & memwr) begin wrote <= 1'b0; kv_seen <= kv_on; end
    else if (memwr) begin
        if (ce1)   wrote   <= 1'b1;
        if (kv_on) kv_seen <= 1'b1;
    end
    if (memwr_d & ~memwr & en & ~kv_seen & ~wrote & ~(&miss))
        miss <= miss + 8'd1;
    if (por) miss <= 8'd0;
end

// ------------------------------------------------------ карта блоков
// Распределённая память 32 x 8, один порт: либо отметить (прочитать, OR,
// записать -- за один такт, чтение асинхронное), либо выдать и погасить.
// Выдача главнее: ESP ждёт байт через полпериода SCK, это три такта, поэтому
// dm_start и dm_next приходят из ide_remote комбинационно, в такт приёма
// байта, и байт готов тактом позже. Отметка ждёт в очереди одного места:
// записи идут не чаще раза в микросекунду.
//
// Выдача -- ровно 32 байта: dm_next после последнего ничего не гасит, иначе
// лишний байт посылки стёр бы байт 0, отмеченный уже после его выдачи.
reg [7:0] dm [0:31];
integer k;
initial for (k = 0; k < 32; k = k + 1) dm[k] = 8'h00;

reg        set_pend = 1'b0;
reg  [7:0] set_blk  = 8'h00;
reg  [4:0] rd_idx   = 5'd0;
reg        memwr_r  = 1'b0;

wire       take     = dm_start | (dm_next & (rd_idx != 5'd31));
wire [4:0] take_idx = dm_start ? 5'd0 : rd_idx + 5'd1;
wire [4:0] addr     = take ? take_idx : set_blk[7:3];
wire [7:0] q        = dm[addr];
wire [7:0] mask     = 8'h01 << set_blk[2:0];

always @(posedge clk) begin
    if (take) begin
        dm_byte  <= q;
        dm[addr] <= 8'h00;
        rd_idx   <= take_idx;
    end
    else if (set_pend) begin
        dm[addr] <= q | mask;
        set_pend <= 1'b0;
    end

    // отметка: по НАЧАЛУ записи в ОЗУ машины -- тогда ~ШАВВ и выбор квазидиска
    // ещё этого цикла, а к концу очищенного строба (40 нс после живого) машина
    // уже выставляет следующий адрес. Отмечается любая запись, даже без такта
    // столбца: ОЗУ машины изменилось, и ESP должна это знать. Стоит после
    // обслуживания -- новая отметка не пропадёт в такт, когда гасится прежняя.
    memwr_r <= memwr;
    if (~memwr_r & memwr & en & ~kv_on) begin
        set_pend <= 1'b1;
        set_blk  <= a_hi;
    end

    if (por) set_pend <= 1'b0;
end

endmodule

`default_nettype wire
