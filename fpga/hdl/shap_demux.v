// Разбор ~ШАП: младший байт адреса процессора из мультиплексированного адреса
// динамической памяти.
//
// ЗАЧЕМ. Старший байт адреса в цикле памяти приходит на ~ШАВВ (A15..A8, см.
// vu_bus.v), а младшего на разъёме нет -- есть только ~ШАП, то есть MA0..MA7
// самой динамической памяти: в фазе строки одни разряды адреса, в фазе столбца
// другие, перемешанные и частично инвертированные. Подставному загрузчику
// (fakerom.v) нужен A0..A7, чтобы знать, какой байт отдать.
//
// ПЕРЕСТАНОВКА ВЫВЕДЕНА ИЗ СХЕМЫ МАШИНЫ. Мультиплексор адреса -- четыре 555КП2,
// D11..D14, выход каждого через резистор R44..R52 прямо на ~ШАП; вход 2 --
// строка процессорного цикла, вход 3 -- столбец (0 и 1 -- видеоадрес):
//     ~ШАП     0    1    2    3    4    5    6    7
//     строка   A8   A9   A10  A11  A12  A0   A1   ~A13
//     столбец  A2   A3   A4   A5   A6   A7   A15  ~A14
// A13 и A14 инвертированы потому, что взяты с ~ШАВВ, после инвертирующего
// КР580ВА87. Это ровно захват svofski (RA = {a9,a10,a11,a12,a13,a1,a2,~a14},
// CA = {a3,a4,a5,a6,a7,a8,a16,~a15}, разряды a1..a16 = A0..A15), если читать
// его списки начиная с ~ШАП0 (прочитанные со старшего, они дают перевёрнутый
// параметр). Разводка машины одна на все «Векторы» по этой схеме;
// замер на живой машине -- проверка, а не поиск.
//
// Формат MAP: восемь полей по пять разрядов, поле i -- откуда взять Ai:
//     {инверсия, фаза (0 строка, 1 столбец), номер линии ~ШАП [2:0]}
// A7 слева.
//
// КОГДА БРАТЬ. Строку машина держит 100 нс после спада ~RAS (замер),
// столбец -- всё время низкого ~CAS, от 380 нс. ~ШАП, ~RAS и
// ~CAS отсчитываются одним тактом 50 МГц; строка берётся через 20-40 нс после
// спада ~RAS (60 с метастабильностью -- всё равно внутри 100), столбец через
// столько же после спада ~CAS.
//
// ЧЬЯ ЭТО СТРОКА. Видеоциклы тоже дают ~RAS -- два внутри строба чтения, -- но
// ~CAS на разъём выходит ТОЛЬКО при выставленном ~БЛК, и внутри строба он один
// (замер). Строка процессорного цикла -- последняя перед ~CAS: ~CAS
// падает, пока ~RAS того же цикла ещё низкий, и чужой спад ~RAS между ними не
// помещается. Спадом ~RAS считается только переход после ДВУХ отсчётов
// единицы: выброс вверх на низком ~RAS не перепишет строку фазой столбца.
`default_nettype none

module shap_demux #(
    //                     A7          A6          A5          A4
    parameter [39:0] MAP = {5'b0_1_101, 5'b0_1_100, 5'b0_1_011, 5'b0_1_010,
    //                     A3          A2          A1          A0
                            5'b0_1_001, 5'b0_1_000, 5'b0_0_110, 5'b0_0_101}
) (
    input  wire       clk,
    input  wire [7:0] shap,         // ~ШАП с разъёма, как есть
    input  wire       ras_n,
    input  wire       cas_n,
    output reg  [7:0] a_lo = 8'h00, // A7..A0 последнего цикла с ~CAS
    output reg        lo_stb = 1'b0 // такт, в который a_lo обновился
);

reg [3:0] rs = 4'hF;
reg [2:0] cs = 3'h7;
reg [7:0] s1 = 8'h00;
reg [7:0] row = 8'h00;

always @(posedge clk) begin
    rs <= {rs[2:0], ras_n};
    cs <= {cs[1:0], cas_n};
    s1 <= shap;
end

wire ras_fall = rs[3] & rs[2] & ~rs[1];
wire cas_fall = cs[2] & ~cs[1];

function pick(input [4:0] cfg, input [7:0] r, input [7:0] c);
    pick = cfg[4] ^ (cfg[3] ? c[cfg[2:0]] : r[cfg[2:0]]);
endfunction

wire [7:0] lo_now;
genvar i;
generate for (i = 0; i < 8; i = i + 1) begin : g
    assign lo_now[i] = pick(MAP[5*i +: 5], row, s1);
end endgenerate

always @(posedge clk) begin
    lo_stb <= cas_fall;
    if (ras_fall) row  <= s1;
    if (cas_fall) a_lo <= lo_now;   // столбец -- то, что на ~ШАП сейчас
end

endmodule

`default_nettype wire
