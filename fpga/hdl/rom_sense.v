// Сброс с клавиатуры: ВВОД или БЛК+СБР -- и подставной загрузчик после ВВОД.
//
// ЗАЧЕМ. При плате загрузчик из ПЗУ «Вектора» не нужен: подставной BOOT26
// (fakerom.v) грузится с квазидиска, винчестера, дискеты и магнитофона. Но
// окно загрузчика открывается только после СБР самой платы, а ВВОД с
// клавиатуры ведёт в ПЗУ. Здесь плата узнаёт, что сброс с клавиатуры был
// именно ВВОД, и тогда сама взводит загрузчик и нажимает СБР -- как при
// включении. БЛК+СБР с клавиатуры остаётся как есть: им запускают программы,
// которые после заставки ждут именно его, им же холодный старт МикроДОС.
//
// ПО ~СБРОС ИХ НЕ ОТЛИЧИТЬ (замер на живой машине). ВВОД тянет и СБР
// через диод VD9 клавиатуры, сброс от обоих защёлкивает D17 одним тактом
// 50 Гц, фронты 41 стоят в одном месте кадра. Различаются они только тем, что
// после ВВОД включено ПЗУ: процессор начинает с 0000 из ПЗУ, а после БЛК+СБР --
// из ОЗУ. ПЗУ отвечает на шине разъёма (тот же замер), и первые чтения после
// сброса у него всегда одни: у ПЗУ замеренной машины восемь чтений --
// 3E 9B D3 04 3E 88 D3 00, MVI A,9Bh; OUT 04h; MVI A,88h; OUT 00h.
//
// ПОДПИСЬ ПЗУ БЕРЁТСЯ ПО СВОЕМУ ВВОД. Какое ПЗУ стоит в машине, модуль не
// знает: он запоминает первые N байт после сброса, который держала сама
// плата ВВОДом (autostart.v). Это бывает при каждом включении: ПЛИС держит ВВОД
// с питания, и даже при подставном загрузчике ESP отпускает ВВОД на 20 мс
// перед СБР -- ПЗУ успевает начать. Пока подписи нет, сброс с клавиатуры не
// разобран, и плата ничего не делает.
//
// ОШИБКИ В ДВЕ СТОРОНЫ СТОЯТ ПО-РАЗНОМУ. БЛК+СБР, принятый за ВВОД, запустит
// BOOT26 вместо программы в памяти, -- для этого первые N чтений из ОЗУ должны
// повторить ПЗУ байт в байт (после BOOT26 с 0000 лежит JMP на загруженное).
// ВВОД, принятый за СБР (байт прочитан криво, у ПЗУ среди первых чтений данные
// из памяти), даст загрузчик из ПЗУ -- как без платы. Поэтому ВВОД -- только
// при полном совпадении, а чтение, на которое ответила сама плата (квазидиск,
// окно загрузчика), делает сброс неразобранным.
//
// ДРЕБЕЗГ. Сброс снова начался до N чтений -- читаем заново после
// следующего конца сброса. Узнанный ВВОД просит загрузчик один раз: до своего
// следующего сброса (его и нажмёт плата) новых просьб нет.
//
// БАЙТ ЧТЕНИЯ. Процессор берёт данные в конце строба. Очищенный memrd
// кончается на CLEAN_LAG тактов позже живого ~ЧТЗУ (vu_bus.v), а после живого
// память шину уже не держит, поэтому байт берётся из задержки на DLY тактов:
// за 20-40 нс до конца живого строба, когда данные заведомо стоят.
`default_nettype none

module rom_sense #(
    parameter integer N   = 8,         // чтений в подписи
    parameter integer DLY = 4
) (
    input  wire        clk,
    input  wire        por,
    input  wire        sys_reset,      // ~СБРОС машины (очищенный)
    input  wire        key_vvod,       // свои клавиши (autostart.v)
    input  wire        key_sbr,
    input  wire        memrd,          // ~ЧТЗУ очищенный
    input  wire [7:0]  din,            // шина данных
    input  wire        ours,           // на это чтение отвечает плата
    input  wire        en,             // после ВВОД -- подставной загрузчик
    output reg         vvod_boot = 1'b0,  // импульс: взвести и нажать СБР
    output wire [63:0] diag            // блок 6, см. конец файла
);

localparam [1:0] K_NONE = 2'd0, K_OWN = 2'd1, K_SBR = 2'd2, K_VVOD = 2'd3;

// ----------------------------------------------------------- байт чтения
reg [7:0] dq [0:DLY-1];
integer i;
initial for (i = 0; i < DLY; i = i + 1) dq[i] = 8'h00;
always @(posedge clk) begin
    dq[0] <= din;
    for (i = 1; i < DLY; i = i + 1) dq[i] <= dq[i-1];
end

reg memrd_r = 1'b0;
always @(posedge clk) memrd_r <= memrd;
wire rd_end = memrd_r & ~memrd;

// --------------------------------------------------------------- событие
reg        rst_r = 1'b0;
reg        own = 1'b0, own_vvod = 1'b0;   // в этом сбросе нажимала плата
reg        rd_on = 1'b0;                  // после конца сброса, ждём чтений
localparam integer NW = $clog2(N);
reg  [NW-1:0] n = {NW{1'b0}};
reg        foreign = 1'b0;                // одно из чтений -- наше
reg        rd_ours = 1'b0;                // в этом стробе отвечала плата
reg [8*N-1:0] sig = {8*N{1'b0}};          // первые N байт, первый -- младший
reg        s_own = 1'b0, s_ovv = 1'b0;
reg        done = 1'b0;

always @(posedge clk) begin
    rst_r <= sys_reset;
    done  <= 1'b0;
    if (rd_end)              rd_ours <= 1'b0;
    else if (memrd & ours)   rd_ours <= 1'b1;
    if (por) begin
        rd_on <= 1'b0; own <= 1'b0; own_vvod <= 1'b0;
    end
    else if (sys_reset) begin
        // Сброс идёт: начатый разбор бросаем, свои клавиши копим. Флаги
        // снимаются в начале сброса: с питания ПЛИС уже держит ВВОД, и это
        // свой сброс без всякого фронта.
        rd_on <= 1'b0;
        own      <= (rst_r ? own      : 1'b0) | key_sbr | key_vvod;
        own_vvod <= (rst_r ? own_vvod : 1'b0) | key_vvod;
    end
    else if (rst_r) begin
        rd_on   <= 1'b1;               // сброс кончился: процессор идёт с 0000
        n       <= {NW{1'b0}};
        foreign <= 1'b0;
    end
    else if (rd_on & rd_end) begin
        sig     <= {dq[DLY-1], sig[8*N-1:8]};
        foreign <= foreign | rd_ours | ours;
        n       <= n + 1'b1;
        if (n == N - 1) begin
            rd_on <= 1'b0;
            done  <= 1'b1;
            s_own <= own;
            s_ovv <= own_vvod;
        end
    end
end

// ----------------------------------------------------------------- разбор
reg  [8*N-1:0] rom = {8*N{1'b0}};
reg         rom_ok = 1'b0;
reg         pend = 1'b0;               // ВВОД узнан, ждём своего сброса
reg  [1:0]  kind = K_NONE;
reg         last_ovv = 1'b0;
reg  [3:0]  n_ev = 4'd0, n_vvod = 4'd0;

wire bad = foreign;

always @(posedge clk) begin
    vvod_boot <= 1'b0;
    if (por) begin
        rom_ok <= 1'b0; pend <= 1'b0; kind <= K_NONE; last_ovv <= 1'b0;
        n_ev <= 4'd0; n_vvod <= 4'd0;
    end
    else if (done) begin
        n_ev <= n_ev + 4'd1;
        if (s_own) begin
            kind     <= K_OWN;
            last_ovv <= s_ovv;
            pend     <= 1'b0;
            if (s_ovv & ~bad) begin
                rom    <= sig;
                rom_ok <= 1'b1;
            end
        end
        else if (!rom_ok || bad)
            kind <= K_NONE;
        else if (sig == rom) begin
            kind   <= K_VVOD;
            n_vvod <= n_vvod + 4'd1;
            if (en & ~pend) begin
                vvod_boot <= 1'b1;
                pend      <= 1'b1;
            end
        end
        else
            kind <= K_SBR;
    end
end

// ------------------------------------------------------- диагностика, блок 6
//   0  {подпись ПЗУ есть, ждём своего сброса после узнанного ВВОД,
//       своё последнее -- наш ВВОД, ждём чтений после сброса, 0, 0,
//       вид последнего: 0 не разобран, 1 свой, 2 не ВВОД, 3 ВВОД}
//   1  какие из первых восьми чтений совпали с подписью: разряд k -- чтение k
//   2  {узнано ВВОД, событий} -- по четыре разряда, по кругу
//   3..7  первые пять байт после последнего сброса, по порядку чтения
// Подпись ПЗУ отдельно не выводится: это байты 3..7 после своего ВВОД (вид 1
// и разряд 5 в байте 0).
reg [7:0] same;
integer k;
always @(*) begin
    same = 8'h00;
    for (k = 0; k < N && k < 8; k = k + 1)
        same[k] = sig[8*k +: 8] == rom[8*k +: 8];
end

assign diag = {sig[39:0], n_vvod, n_ev, same,
               {rom_ok, pend, last_ovv, rd_on, 2'b00, kind}};

endmodule

`default_nettype wire
