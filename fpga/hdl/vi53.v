// Эмулятор таймера КР580ВИ53 (i8253) «Вектора» ПРОСЛУШИВАНИЕМ шины.
//
// ЗАЧЕМ. Вывода `beep` на плате нет: звук машины с
// контакта 42 идёт мимо ПЛИС, а на наш звуковой выход таймер надо собрать
// самим. Свой ВИ53 у машины остаётся и отвечает на чтения — мы только слушаем
// записи и повторяем выходы трёх каналов. Поэтому чтений, защёлки счёта и
// обратного чтения здесь нет вовсе: наружу они ничего не меняют.
//
// ПОРТЫ. 08h..0Bh, младшие два разряда адреса к микросхеме инвертированы, как у
// всех устройств «Вектора» (у Славинского `~address_bus_r[1:0]`):
//   08h -- управляющее слово, 0Bh -- канал 0, 0Ah -- канал 1, 09h -- канал 2.
// Сходится с загрузчиком BOOT26: `MVI A,36h / OUT 08h`, потом делитель 1500
// в `0Bh` -- 1 кГц на канале 0.
//
// ТАКТ. 1,5 МГц, как у машины. Дробным делителем 3/100 от 50 МГц -- тот же
// приём, что у AY (ay_iface.v): за любые 100 тактов ровно 3 разрешения,
// дрожание один такт, на высоту тона не влияет.
//
// GATE всех трёх каналов у «Вектора» -- с контакта 41 разъёма ВУ, «~СБРОС»
// (на плате это `sbros_n`, заведён в кристалл).
// Пока машина работает, он в единице; в сбросе -- в нуле, и на отпускании сброса
// приходит фронт. Поведение затвора -- по i8254 (у Славинского затворы просто
// `3'b111`, режимы 1 и 5 там не сделаны вовсе):
//   0, 4  -- в нуле счёт стоит;
//   2, 3  -- в нуле выход сразу в единицу и счёт стоит, по фронту счёт заново;
//   1, 5  -- по фронту запуск (и перезапуск), уровень дальше не важен.
//
// ТАКТ ОТ МАШИНЫ. Такт обязан идти от машины (два такта на
// видеоцикл): звук машины с контакта 42 идёт на то же гнездо, и два таймера с
// разной частотой дали бы биение. Его даёт vi53_tick.v на вход `tick_ext`;
// свой генератор ниже -- запасной, пока нет захвата различителя. На машине с
// проводом на 42 эмуляцию всё равно выключают (команда 0x48 по SPI, top.v):
// частота совпадёт, фаза -- нет.
//
// ПОВЕДЕНИЕ -- по описанию i8254/8253, при GATE = 1:
//   0  по окончании счёта: OUT в нуль при записи слова и счёта, в единицу через
//      N+1 такт после записи счёта. Первый байт двухбайтового счёта останавливает
//      счёт, второй запускает заново;
//   2  делитель: период N тактов, OUT в нуле один такт в конце периода. Новый
//      счёт вступает со следующего периода;
//   3  меандр: N/2 в единице, N/2 в нуле, при нечётном N единица на такт
//      длиннее. Новый счёт -- со следующего полупериода;
//   4  строб: через N+1 такт после записи OUT на один такт в нуль;
//   1, 5 -- OUT в единице (нет фронта GATE).
// Счёт 0 -- это 65 536 (двоичный) или 10 000 (двоично-десятичный). Режимы 6 и 7
// -- это 2 и 3, как у i8254.
//
// ЭКОНОМИЯ (в лоб выходит около 700 eq, почти всё в сумматорах). Двоично-десятичный счёт переводится в двоичный ОДИН раз, при
// записи, и ПОСЛЕДОВАТЕЛЬНО: `acc*10 + цифра` за четыре такта, один
// преобразователь на три канала -- записи в порт идут не чаще раза в 4 мкс.
// Меандр считается, как в самой микросхеме, вычитанием по два: полупериод
// кончается на остатке 1 или 2, в нуль при нечётном N грузится N-1. Сумматоров
// полупериодов нет.
//
// ЗАПИСЬ ПОРТА -- импульс `wr` в один такт на цикл (`iowr_reg` из vu_bus.v, тот
// же, что пишет регистр квазидиска): каждая запись считается РОВНО один раз, от
// этого зависит порядок байтов двухбайтового счёта.
//
// ЗАОДНО -- разряд PC0 внутреннего ВВ55 (`pc0`): второй источник звука машины,
// у Славинского он сводится вместе с таймером. Порт 01h пишет порт C целиком,
// в 00h разряд 7 = 0 -- установка одного разряда, разряд 7 = 1 -- слово режима,
// которое сбрасывает выходы порта C в нуль.
`default_nettype none

module vi53 #(
    parameter integer CE_NUM = 3,       // 3/100 от 50 МГц = 1,5 МГц
    parameter integer CE_DEN = 100
) (
    input  wire       clk,
    input  wire       reset,
    input  wire [7:0] port,             // адрес ввода-вывода, прямой
    input  wire       wr,               // один такт на цикл записи в порт
    input  wire [7:0] din,
    input  wire       gate,             // GATE всех трёх каналов, асинхронный
    input  wire       tick_ext_en,      // 1 -- считать по tick_ext, а не по своему
    input  wire       tick_ext,         // такт от машины, импульс в один такт clk
    output wire [2:0] out,              // выходы каналов 0, 1, 2
    output reg        pc0               // разряд PC0 ВВ55
);

// ----------------------------------------------------------------- такт 1,5 МГц
localparam ACC_W = $clog2(CE_DEN) + 1;
reg [ACC_W-1:0] ce_acc;
reg             tick_int;
always @(posedge clk)
    if (reset) begin ce_acc <= 0; tick_int <= 1'b0; end
    else if (ce_acc + CE_NUM >= CE_DEN) begin ce_acc <= ce_acc + CE_NUM - CE_DEN; tick_int <= 1'b1; end
    else begin ce_acc <= ce_acc + CE_NUM; tick_int <= 1'b0; end
wire tick = tick_ext_en ? tick_ext : tick_int;

// ---------------------------------------------------------------- затвор
// Два триггера на асинхронный вход; фронт ждёт ближайшего такта таймера, как у
// самой микросхемы (она смотрит затвор по фронту CLK).
reg [1:0] g_s = 2'b11;
reg       g_d = 1'b1, trig_pend = 1'b0;
wire      g = g_s[1];
always @(posedge clk)
    if (reset) begin g_s <= 2'b11; g_d <= 1'b1; trig_pend <= 1'b0; end
    else begin
        g_s <= {g_s[0], gate};
        g_d <= g;
        if (g & ~g_d)  trig_pend <= 1'b1;
        else if (tick) trig_pend <= 1'b0;
    end
wire trig = tick & trig_pend;           // фронт затвора, на такте таймера

// ---------------------------------------------------------------- декодирование
wire       sel   = (port[7:2] == 6'b000010);    // 08h..0Bh
wire [1:0] a     = ~port[1:0];                  // 3 -- слово, 0..2 -- каналы
wire       wr_cw = wr & sel & (a == 2'd3);
wire [1:0] cw_sc = din[7:6];
wire [1:0] cw_rl = din[5:4];
// Слово с RL = 00 -- защёлка счёта для чтения: режим не меняет. SC = 11 у 8253
// недопустимо (у 8254 это обратное чтение) -- тоже пропускаем.
wire       cw_ok = wr_cw & (cw_rl != 2'b00) & (cw_sc != 2'b11);

// ----------------------------------------------------------- состояние каналов
// Регистры у каждого канала свои (внутри generate), наружу -- плоскими векторами:
// один массив на три канала писался бы из трёх always, а синтезаторы делают из
// массива память и на нескольких писателях путаются.
wire [5:0]  rl_all;                     // по 2 разряда на канал
wire [2:0]  bcd_all;
wire [23:0] lsb_all;                    // по 8 разрядов на канал
wire [2:0]  done_all;                   // записан последний байт счёта

// Записываемый счёт того канала, в который пишут сейчас.
wire [1:0]  wa    = (a == 2'd3) ? 2'd0 : a;
wire [1:0]  wrl   = rl_all[2*wa +: 2];
wire [7:0]  wlsb  = lsb_all[8*wa +: 8];
wire [15:0] wval  = (wrl == 2'b01) ? {8'h00, din}
                  : (wrl == 2'b10) ? {din, 8'h00}
                  :                  {din, wlsb};

// ---- перевод записанного счёта в период, один на все каналы
// Двоичный -- на следующем такте; двоично-десятичный -- за четыре шага
// acc = acc*10 + цифра, от старшей цифры к младшей.
reg        cv_run;
reg [1:0]  cv_ch, cv_step;
reg [15:0] cv_val;
reg [13:0] cv_acc;
reg        cv_done;                     // один такт: период готов
reg [16:0] cv_per;
wire [3:0]  cv_dig = cv_val[15 - 4*cv_step -: 4];
wire [13:0] cv_nxt = {cv_acc[10:0], 3'b000} + {cv_acc[12:0], 1'b0} + {10'b0, cv_dig};
always @(posedge clk) begin
    cv_done <= 1'b0;
    if (reset) begin
        cv_run <= 1'b0; cv_ch <= 2'd0; cv_step <= 2'd0; cv_val <= 16'h0;
        cv_acc <= 14'd0; cv_per <= 17'h10000;
    end else if (|done_all) begin
        cv_ch  <= wa;
        cv_val <= wval;
        if (bcd_all[wa]) begin
            cv_run <= 1'b1; cv_step <= 2'd0; cv_acc <= 14'd0;
        end else begin
            cv_per  <= (wval == 16'h0000) ? 17'h10000 : {1'b0, wval};
            cv_done <= 1'b1;
        end
    end else if (cv_run) begin
        cv_acc  <= cv_nxt;
        cv_step <= cv_step + 1'b1;
        if (cv_step == 2'd3) begin
            cv_run  <= 1'b0;
            cv_per  <= (cv_val == 16'h0000) ? 17'd10000 : {3'b000, cv_nxt};
            cv_done <= 1'b1;
        end
    end
end

genvar c;
generate for (c = 0; c < 3; c = c + 1) begin : ch
    reg [2:0]  mode;
    reg        bcd;
    reg [1:0]  rl;
    reg        wr_hi;                   // ждём старший байт двухбайтового счёта
    reg [7:0]  lsb;                     // младший байт, пока ждём старший
    reg [16:0] per;                     // период в тактах, 1..65 536, двоичный
    reg [16:0] cnt;
    reg        pend;                    // счёт записан, загрузить на ближайшем такте
    reg        run;
    reg        o;

    assign rl_all[2*c +: 2]  = rl;
    assign bcd_all[c]        = bcd;
    assign lsb_all[8*c +: 8] = lsb;
    assign out[c]            = o;

    wire wr_me  = wr & sel & (a == c[1:0]);
    wire cw_me  = cw_ok & (cw_sc == c[1:0]);
    wire done   = wr_me & ((rl != 2'b11) | wr_hi);          // последний байт счёта
    wire first  = wr_me & (rl == 2'b11) & ~wr_hi;           // первый из двух
    wire got    = cv_done & (cv_ch == c[1:0]);              // период переведён
    assign done_all[c] = done;
    wire [2:0]  m   = {1'b0, mode[1:0]} | {mode[2] & ~mode[1], 2'b00};   // 6,7 -> 2,3
    wire [16:0] dec = cnt - ((m == 3'd3) ? 17'd2 : 17'd1);

    always @(posedge clk) begin
        if (reset) begin
            mode <= 3'd0; bcd <= 1'b0; rl <= 2'b11; wr_hi <= 1'b0;
            lsb <= 8'h00; per <= 17'h10000; cnt <= 17'd0;
            pend <= 1'b0; run <= 1'b0; o <= 1'b1;
        end else if (cw_me) begin
            mode  <= din[3:1];
            bcd   <= din[0];
            rl    <= din[5:4];
            wr_hi <= 1'b0;
            pend  <= 1'b0;
            run   <= 1'b0;
            o     <= (din[3:1] == 3'd0) ? 1'b0 : 1'b1;
        end else begin
            // ---- запись счёта
            if (first) begin
                lsb   <= din;
                wr_hi <= 1'b1;
                if (m == 3'd0) begin run <= 1'b0; o <= 1'b0; end
            end
            if (done) wr_hi <= 1'b0;
            if (got) begin
                per <= cv_per;
                case (m)
                    3'd0: begin pend <= 1'b1; run <= 1'b0; o <= 1'b0; end
                    3'd4: begin pend <= 1'b1; run <= 1'b0; end
                    3'd2, 3'd3: if (!run) pend <= 1'b1;        // идущий -- со след. периода
                    default: ;                                  // 1, 5: ждут GATE, не дождутся
                endcase
            end
            // ---- счёт
            if (tick && !(got || first)) begin
                if (pend) begin
                    pend <= 1'b0;
                    run  <= 1'b1;
                    cnt  <= per;
                    if (m == 3'd2 || m == 3'd3) o <= 1'b1;
                end else if (trig && m != 3'd0 && m != 3'd4) begin
                    // фронт затвора: 1 и 5 -- запуск, 2 и 3 -- счёт заново
                    run <= 1'b1;
                    cnt <= per;
                    o   <= (m == 3'd1) ? 1'b0 : 1'b1;
                end else if (run && (g || m == 3'd1 || m == 3'd5)) begin
                    case (m)
                        3'd0:
                            if (cnt == 17'd1) begin o <= 1'b1; run <= 1'b0; end
                            else cnt <= dec;
                        3'd2:
                            if      (cnt == 17'd2) begin cnt <= 17'd1; o <= 1'b0; end
                            else if (cnt == 17'd1) begin cnt <= per;   o <= 1'b1; end
                            else cnt <= dec;
                        3'd3:                                   // вычитание по два
                            if ((cnt[16:2] == 15'd0 && (cnt[1] ^ cnt[0])) || cnt == 17'd0) begin   // остаток 1 или 2
                                if (o && per[16:1] != 16'd0) begin
                                    o <= 1'b0; cnt <= {per[16:1], 1'b0};   // N-1 при нечётном
                                end else begin
                                    o <= 1'b1; cnt <= per;
                                end
                            end else cnt <= dec;
                        3'd1:                                   // одновибратор
                            if (cnt == 17'd1) begin o <= 1'b1; run <= 1'b0; end
                            else cnt <= dec;
                        3'd4, 3'd5:                             // строб
                            if      (cnt == 17'd1) begin cnt <= 17'd0; o <= 1'b0; end
                            else if (cnt == 17'd0) begin o <= 1'b1; run <= 1'b0; end
                            else cnt <= dec;
                        default: ;
                    endcase
                end
            end
            // затвор в нуле: в режимах 2 и 3 выход в единицу сразу, не по такту
            if (!g && (m == 3'd2 || m == 3'd3)) o <= 1'b1;
        end
    end
end endgenerate

// ------------------------------------------------------------------ PC0 ВВ55
// Внутренний ВВ55 «Вектора»: 00h -- управление, 01h -- порт C (инверсия
// младших разрядов адреса та же).
always @(posedge clk)
    if (reset) pc0 <= 1'b0;
    else if (wr && port == 8'h01) pc0 <= din[0];
    else if (wr && port == 8'h00) begin
        if (din[7])                 pc0 <= 1'b0;        // слово режима: выходы в нуль
        else if (din[3:1] == 3'd0)  pc0 <= din[0];      // установка разряда 0
    end

endmodule

`default_nettype wire
