// Автозапуск: плата сама «нажимает» ВВОД и СБР на клавиатуре машины.
//
// ЖЕЛЕЗО (проверено на живой машине).
// Два ключа с открытым стоком на контакты клавиатуры: 39 (`ВВОД`) и 36 (`СБР`).
// Единица на выводе ПЛИС -- ключ открыт, клавиша нажата. Затворы подтянуты к
// земле, так что до конфигурации ПЛИС клавиши отпущены.
//
//   * ВВОД, пока нажат, ДЕРЖИТ машину в сбросе; загрузка идёт по отпусканию.
//   * СБР от 20 мс -- загрузка с отключённым ПЗУ (то, что делает БЛК+СБР).
//
// ЧТО ДЕЛАЕТ МОДУЛЬ.
//   * С включения питания держит ВВОД: у «Вектора» нет схемы сброса по
//     питанию, и машина до первого ВВОД гудит (доработка «антигудок»). Держит
//     HOLD_TICKS или пока ESP не скажет иначе. ESP не ожила -- машина всё
//     равно стартует сама, по времени: обычная загрузка из ПЗУ.
//   * Исполняет команду ESP (0x4B + код по SPI, см. ide_remote.v):
//       0 -- отпустить всё сейчас же;
//       1 -- нажать ВВОД на PRESS_TICKS (перезагрузка из ПЗУ);
//       2 -- нажать СБР на PRESS_TICKS (загрузка с отключённым ПЗУ);
//       3 -- держать ВВОД ещё HOLD_TICKS (ESP ждёт раскрутки диска и т. п.).
//     Команда 3 -- продление, а не «держать, пока не отпустят»: зависшая ESP
//     не должна запереть машину в сбросе навсегда. Выглядело бы это как
//     «плата убила компьютер».
//   * Две клавиши сразу не нажимает никогда. Смена клавиши идёт через паузу
//     GAP_TICKS, когда отпущены обе: как себя ведёт машина при ВВОД и СБР
//     вместе, не мерили, и рецепт с живой машины -- два НЕЗАВИСИМЫХ импульса.
//
// СБРОС -- ТОЛЬКО ПО ПИТАНИЮ. Нажатый ВВОД опускает ~СБРОС на шине, и сброс
// от шины сбросил бы сам автозапуск: вышла бы петля. По той же причине разбор
// посылок SPI в ide_remote.v живёт на por, а не на сбросе машины.
//
// ОГОВОРКА. Перезаливка ПЛИС на работающей машине -- тоже «включение»: плата
// подержит ВВОД и перезагрузит машину. Кто заливает через ESP, тот может сразу
// послать код 0 -- удержание снимется за один байт.
`default_nettype none

module autostart #(
    parameter integer HOLD_TICKS  = 100_000_000,   // 2 с при 50 МГц
    parameter integer PRESS_TICKS = 2_500_000,     // 50 мс: СБР требует от 20
    parameter integer GAP_TICKS   = 1_000_000      // 20 мс между клавишами
) (
    input  wire       clk,
    input  wire       por,
    input  wire       cmd_stb,
    input  wire [1:0] cmd,
    output reg        key_vvod = 1'b0,
    output reg        key_sbr  = 1'b0
);

localparam integer W = $clog2(HOLD_TICKS + 1);

localparam [1:0] S_IDLE = 2'd0, S_GAP = 2'd1, S_DOWN = 2'd2;

reg [1:0]   st;
reg         key;            // какая клавиша: 0 -- ВВОД, 1 -- СБР
reg         long;           // после паузы держать HOLD, а не PRESS
reg [W-1:0] cnt;

wire         want_key  = (cmd == 2'd2);
wire         want_long = (cmd == 2'd3);
wire [W-1:0] want_len  = want_long ? HOLD_TICKS - 1 : PRESS_TICKS - 1;

always @(posedge clk)
    if (por) begin
        st   <= S_DOWN;         // держать ВВОД с включения
        key  <= 1'b0;
        long <= 1'b0;
        cnt  <= HOLD_TICKS - 1;
    end
    else if (cmd_stb) begin
        if (cmd == 2'd0)
            st <= S_IDLE;
        else if (st == S_DOWN && key != want_key) begin
            st   <= S_GAP;      // сперва отпустить нажатую
            cnt  <= GAP_TICKS - 1;
            key  <= want_key;
            long <= want_long;
        end
        else if (st == S_GAP) begin
            key  <= want_key;   // пауза идёт своим чередом, меняется только цель
            long <= want_long;
        end
        else begin
            st  <= S_DOWN;      // та же клавиша -- таймер заново, без паузы
            key <= want_key;
            cnt <= want_len;
        end
    end
    else if (st != S_IDLE) begin
        if (cnt != {W{1'b0}})
            cnt <= cnt - 1'b1;
        else if (st == S_GAP) begin
            st  <= S_DOWN;
            cnt <= long ? HOLD_TICKS - 1 : PRESS_TICKS - 1;
        end
        else
            st <= S_IDLE;
    end

// Выходы -- с триггера: на ключ не должна пройти иголка от смены состояния.
always @(posedge clk) begin
    key_vvod <= (st == S_DOWN) & ~key;
    key_sbr  <= (st == S_DOWN) &  key;
end

endmodule

`default_nettype wire
