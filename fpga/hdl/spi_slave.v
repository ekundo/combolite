// Ведомый SPI к модулю ESP32. Байтовый уровень, без всякого протокола.
//
// РАЗДЕЛЕНИЕ ОБЯЗАННОСТЕЙ. Модуль умеет одно: пока выбран, принимать и отдавать
// байты. Что эти байты значат — дело следующего слоя. Тот же приём, что с
// ide_cycle.v: держать в HDL только то, что обязано быть в железе.
//
// НАПРАВЛЕНИЯ ЗАДАНЫ ПЛАТОЙ. esp_sck, esp_mosi, esp_cs — входы ПЛИС, esp_miso —
// выход. Значит ведущий на шине ESP, и обмен начинает она. Подтяжки на плате:
// cs вверх, sck и mosi вниз, то есть без модуля вход не висит и «выбора» не
// возникает.
//
// РЕЖИМ 0 (CPOL=0, CPHA=0): в покое SCK низкий, ведущий читает по нарастающему
// фронту, ведомый выставляет новый бит по спадающему. Это исходный режим ESP32,
// и он же согласуется с подтяжкой SCK вниз. Старший бит первым.
//
// ДВА ТАКТОВЫХ ДОМЕНА. SCK приходит извне, а мы живём на 50 МГц. Здесь взята
// ПЕРЕДИСКРЕТИЗАЦИЯ: входы синхронизируются двумя триггерами, фронты SCK
// определяются в нашем домене. Так все регистры тактируются одним тактом и
// замыкание по времени считается обычным образом.
//
// Плата за это — ограничение на частоту SCK, и оно ИЗМЕРЕНО прогонкой, а не
// выведено из «четырёх тактов на период». Прикидка давала 12,5 МГц и оказалась
// вдвое оптимистичной по сути дела:
//
//   SCK        приём (ведущий -> нам)   передача (мы -> ведущему)
//   0,5 МГц    цел                      цела
//   5,0 МГц    цел                      цела
//   6,0 МГц    цел                      цела
//   8,3 МГц    цел                      цела
//   10,0 МГц   цел                      цела        <- последняя чистая
//   10,4 МГц   цел                      СБИТА
//   11,1 МГц   цел                      цела, но с нарушением устойчивости MISO
//   12,5 МГц   цел                      СБИТА
//
// Ломается ИМЕННО передача от нас: приём выживает, потому что нам достаточно
// передискретизировать MOSI, а вот выставить новый бит после спада SCK мы
// успеваем не всегда. Задержка от настоящего фронта до смены MISO — два-три
// наших такта, то есть до 60 нс, и на быстром SCK ведущий читает прежний бит.
//
// Обратите внимание на немонотонность: 11,1 МГц «проходит», а 10,4 и 11,6 нет.
// Это значит, что выше 10 МГц исход зависит от совпадения фаз SCK и нашего
// такта, то есть работает по случайности. В прогонке нет ни разброса по
// процессу, ни задержек выводов, которые в железе только добавятся.
//
// В ЖЕЛЕЗЕ ПРЕДЕЛ НИЖЕ: ~7,5 МГц. К двум-трём тактам добавляются выводы, по
// SDF из Diamond вход SCK до первого триггера 1,5 нс, триггер
// MISO в блоке вывода до вывода 3,4 нс. Итого от спада SCK до смены MISO на
// выводах 45..65 нс, а ведущий читает MISO через полпериода: на 8 МГц это
// 62,5 нс, на 7 МГц 71,4. Живая плата так и показала: на 8 МГц данные сдвинуты
// на разряд, на 7 МГц ошибок нет. Предел задаёт передискретизация в ПЛИС, а
// не провода к ESP.
//
// ПОЭТОМУ: SCK 4 МГц — столько стоит в COMBO_SPI_HZ, полпериода 125 нс.
//
// Узкое место обмена здесь, а не в приводе. Считаем по замерам: сектор с привода — 256 слов по 740 нс, это 189 мкс, или
// 2,70 МБ/с. Сектор по SPI — 524 байта, на 4 МГц это 1048 мкс, 0,49 МБ/с:
// впятеро медленнее привода. Больше скорости дало бы тактирование регистров
// самим SCK, но тогда вся сложность уходит в переход между доменами, и в
// Diamond такой путь придётся описывать ограничениями отдельно.

`default_nettype none

module spi_slave (
    input  wire       clk,            // 50 МГц, наш домен
    input  wire       reset,          // активный высокий

    // выводы к ESP32
    input  wire       sck,
    input  wire       mosi,
    input  wire       cs_n,
    output wire       miso,
    output wire       miso_oe,        // 0 = отпустить линию, когда не выбраны

    // байтовый уровень
    output reg  [7:0] rx_data,
    output reg        rx_valid,       // один такт на принятый байт
    input  wire [7:0] tx_data,        // должен быть готов к моменту tx_load
    output reg        tx_load,        // один такт: «взял байт для передачи»
    output wire       cs_active       // выбраны; следующий слой сбрасывается по спаду
);

// ------------------------------------------------- синхронизация входов

reg [1:0] sck_s, mosi_s, cs_s;
always @(posedge clk) begin
    sck_s  <= {sck_s [0], sck };
    mosi_s <= {mosi_s[0], mosi};
    cs_s   <= {cs_s  [0], cs_n};
end

reg  sck_d;
wire sck_q   = sck_s[1];
wire sck_rise = sck_q & ~sck_d;
wire sck_fall = ~sck_q & sck_d;
wire cs_q     = cs_s[1];               // синхронный cs_n
reg  cs_d;
wire cs_start = ~cs_q & cs_d;          // выбрали
assign cs_active = ~cs_q;

// ------------------------------------------------- сдвиговые регистры

reg [7:0] sh_in, sh_out;
reg [2:0] bit_cnt;
reg       need_load;

assign miso    = sh_out[7];
assign miso_oe = cs_active;

always @(posedge clk) begin
    sck_d    <= sck_q;
    cs_d     <= cs_q;
    rx_valid <= 1'b0;
    tx_load  <= 1'b0;

    if (reset) begin
        sh_in     <= 8'h00;
        sh_out    <= 8'h00;
        bit_cnt   <= 3'd0;
        need_load <= 1'b0;
        rx_data   <= 8'h00;
        sck_d     <= 1'b0;
        cs_d      <= 1'b1;
    end
    else if (cs_start) begin
        // Первый байт надо выставить ДО первого фронта SCK, иначе ведущий
        // прочитает мусор в старшем бите.
        sh_out    <= tx_data;
        tx_load   <= 1'b1;
        sh_in     <= 8'h00;
        bit_cnt   <= 3'd0;
        need_load <= 1'b0;
    end
    else if (cs_active) begin
        if (sck_rise) begin
            sh_in <= {sh_in[6:0], mosi_s[1]};
            if (bit_cnt == 3'd7) begin
                rx_data   <= {sh_in[6:0], mosi_s[1]};
                rx_valid  <= 1'b1;
                bit_cnt   <= 3'd0;
                need_load <= 1'b1;      // новый байт возьмём на спаде
            end
            else
                bit_cnt <= bit_cnt + 3'd1;
        end
        else if (sck_fall) begin
            // Новый байт берём именно здесь, а не на восьмом нарастающем:
            // там ведущий как раз читает последний бит прежнего байта, и
            // подмена сдвигового регистра испортила бы его.
            if (need_load) begin
                sh_out    <= tx_data;
                tx_load   <= 1'b1;
                need_load <= 1'b0;
            end
            else
                sh_out <= {sh_out[6:0], 1'b0};
        end
    end
    else begin
        // Не выбраны: незаконченный байт выбрасывается целиком. Так и надо —
        // ведущий, оборвавший посылку, не должен получить полубайт как данные.
        bit_cnt   <= 3'd0;
        sh_in     <= 8'h00;
        need_load <= 1'b0;
    end
end

endmodule

`default_nettype wire
