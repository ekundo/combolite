// Арбитр шины IDE: процессор «Вектора» против удалённой стороны (ESP).
//
// ЗАЧЕМ. Приводом владеет ПЛИС целиком, и обращаться к нему могут двое: ide.v
// по обращениям процессора и ide_cycle.v по команде от ESP. Одновременно нельзя.
//
// ГЛАВНАЯ ОПАСНОСТЬ НЕ ТАМ, ГДЕ КАЖЕТСЯ. Столкновение двух циклов на шине
// поймать легко. Опаснее другое: обращение к диску по ATA — это
// ПОСЛЕДОВАТЕЛЬНОСТЬ (записать команду, дождаться BSY=0, вычитать 256 слов).
// Если перехватить шину между командой процессора и его переносом данных, ни
// один отдельный цикл не столкнётся, а состояние привода будет испорчено.
//
// Поэтому правило такое: **шина отдаётся только после того, как процессор
// молчал на портах привода заданное время.** Если машина стоит в мониторе, она
// к диску не обращается вовсе и удалённая сторона получит шину сразу же. Если
// машина работает с диском — удалённая сторона ждёт. Это грубо, зато безопасно
// и не требует угадывать, где у чужого драйвера границы транзакции.
//
// Второе правило: **владение ограничено по времени.** Зависшая ESP не должна
// запирать диск навсегда.
//
// Третье: **по умолчанию владеет процессор.** Плата без ESP обязана вести себя
// ровно как контроллер без ESP.
//
// Модуль только РЕШАЕТ. Мультиплексирование выводов и подмена ответа
// процессору — дело верхнего уровня, здесь только сигналы sel_remote и cpu_hold.

`default_nettype none

module ide_arb #(
    // Сколько процессор должен молчать, прежде чем шину можно отдать.
    // При 50 МГц: 2 500 000 тактов = 50 мс.
    parameter IDLE_TICKS  = 2500000,
    // Предел владения удалённой стороной. При 50 МГц: 500 000 = 10 мс.
    // Сектор при 740 нс на слово занимает около 190 мкс, так что запас большой.
    parameter GRANT_TICKS = 500000,
    // Долгое владение: сколько отрезков по GRANT_TICKS держать, если попросили.
    // 255 x 10 мс это 2,55 с — хватает записать дискету целиком.
    //
    // СЧИТАЕМ ОТРЕЗКИ, а не расширяем счётчик. Прямой предел в секундах
    // потребовал бы 28 разрядов вместо 23, то есть шире стали бы ВСЕ счётчики
    // арбитра, включая счётчик тишины. При запасе удержания в 0,180 нс
    // (по Diamond) платить пятью разрядами на всех ради одного предела
    // расточительно; восемь триггеров обходятся дешевле.
    parameter LONG_CHUNKS = 8'd255,
    parameter CW          = 23      // разрядность счётчиков
) (
    input  wire clk,
    input  wire reset,              // активный высокий

    input  wire cpu_active,         // ide.v сейчас в обращении к приводу
    input  wire cyc_busy,           // ide_cycle.v сейчас в цикле

    input  wire rem_req,            // удалённая сторона просит шину
    input  wire rem_long,           // ...и просит держать долго
    output reg  rem_grant,          // ...и владеет ею
    output reg  rem_timeout,        // владение отобрано по времени, липкий

    // Согласованность с «Вектором». Машина и удалённая сторона пишут на один
    // диск и знать друг о друге им нечем: у «Вектора» каталог в ОЗУ, у клиента
    // свой кэш. Отсюда две наружные приметы.
    input  wire cpu_seen_clr,       // снять липкий признак (команда 34h)
    output reg  cpu_seen,           // процессор трогал привод, липкий
    output wire cpu_quiet,          // молчит дольше IDLE_TICKS

    output wire sel_remote,         // 1 = выводы ведёт ide_cycle
    output wire cpu_hold            // 1 = обращения процессора не пускать к приводу
);

localparam S_CPU = 2'd0, S_WAIT = 2'd1, S_REM = 2'd2, S_DROP = 2'd3;

reg [1:0]    state;
reg [CW-1:0] idle_cnt;
reg [CW-1:0] grant_cnt;
// После отбора владения по времени запрос запирается до тех пор, пока
// удалённая сторона его не снимет. Без этого зависшая ESP, держащая запрос
// поднятым, получала бы шину снова и снова, и тайм-аут ничего не защищал бы.
reg          locked;
reg [7:0]    long_cnt;          // отрезков долгого владения позади

// Выводы держим и в S_DROP: там ещё может идти начатый цикл, и оборвать его
// на середине нельзя. Иначе привод останется с недоведённым стробом.
assign sel_remote = (state == S_REM) || (state == S_DROP);
assign cpu_hold   = sel_remote;

// Тот же порог, по которому отдаётся шина: если процессор молчал столько,
// начинать запись безопасно. Выведен наружу, чтобы правило соблюдало ЖЕЛЕЗО, а
// не документ: ide_remote не запустит запись сектора, пока здесь ноль.
//
// Сравнение с порогом взято в регистр idle_ok. Комбинационно оно вместе с
// автоматом ide_remote и сумматором blk_cnt давало худший путь clk50: 15
// уровней, 18,4 нс из 20 (по Diamond). Признак поднимается на такт позже --
// при пороге в 50 мс это ничего не меняет, а гаснет по cpu_active он сразу.
reg idle_ok;
assign cpu_quiet  = idle_ok && !cpu_active;

always @(posedge clk) begin
    if (reset) begin
        state       <= S_CPU;
        idle_cnt    <= {CW{1'b0}};
        idle_ok     <= 1'b0;
        grant_cnt   <= {CW{1'b0}};
        rem_grant   <= 1'b0;
        rem_timeout <= 1'b0;
        locked      <= 1'b0;
        long_cnt    <= 8'd0;
        cpu_seen    <= 1'b0;
    end
    else begin
        // Счётчик тишины: любое обращение процессора обнуляет его.
        if (cpu_active)                    idle_cnt <= {CW{1'b0}};
        else if (idle_cnt != {CW{1'b1}})   idle_cnt <= idle_cnt + 1'b1;
        idle_ok <= !cpu_active && (idle_cnt >= IDLE_TICKS[CW-1:0]);

        // Липкий признак «процессор трогал привод». Взводится обращением и
        // держится, пока его не снимут командой, — иначе удалённая сторона,
        // спрашивающая раз в секунду, пропустила бы короткое обращение между
        // двумя опросами и показала бы человеку устаревший каталог.
        //
        // Взвод СИЛЬНЕЕ снятия: обращение ровно в такт со снятием оставляет
        // признак поднятым. Потерять такое обращение хуже, чем показать лишний
        // раз, что машина лазила на диск.
        if (cpu_active)          cpu_seen <= 1'b1;
        else if (cpu_seen_clr)   cpu_seen <= 1'b0;

        case (state)

        S_CPU: begin
            rem_grant <= 1'b0;
            if (!rem_req) begin
                locked <= 1'b0;            // запрос снят — отпираем
            end
            else if (!locked) begin
                rem_timeout <= 1'b0;       // новый запрос снимает липкий признак
                state       <= S_WAIT;
            end
        end

        // Ждём, пока процессор замолчит на IDLE_TICKS и не будет в цикле.
        S_WAIT:
            if (!rem_req)
                state <= S_CPU;
            else if (cpu_quiet) begin
                rem_grant <= 1'b1;
                grant_cnt <= {CW{1'b0}};
                long_cnt  <= 8'd0;
                state     <= S_REM;
            end

        S_REM: begin
            grant_cnt <= grant_cnt + 1'b1;
            if (!rem_req) begin
                // Отпускает сама — но выводы отдаём лишь по окончании цикла.
                state <= S_DROP;
            end
            else if (grant_cnt >= GRANT_TICKS[CW-1:0]) begin
                if (rem_long && long_cnt != LONG_CHUNKS) begin
                    // Долгое владение: отрезок кончился, начинаем следующий.
                    // Предел всё равно есть — LONG_CHUNKS отрезков, — потому
                    // что «навсегда» означало бы, что зависшая ESP запирает
                    // диск до выключения питания.
                    grant_cnt <= {CW{1'b0}};
                    long_cnt  <= long_cnt + 8'd1;
                end
                else begin
                    // Отбираем по времени. Тоже дожидаемся конца цикла, чтобы
                    // не оборвать строб на середине и не оставить привод в
                    // непонятном состоянии.
                    rem_timeout <= 1'b1;
                    locked      <= 1'b1;   // до снятия запроса больше не дадим
                    state       <= S_DROP;
                end
            end
        end

        // Цикл ещё может идти. Пока он идёт, выводы отдавать нельзя, но и
        // процессора к приводу не пускаем — отсюда cpu_hold в этом состоянии.
        S_DROP:
            if (!cyc_busy) begin
                rem_grant <= 1'b0;
                state     <= S_CPU;
            end

        default: state <= S_CPU;
        endcase
    end
end

endmodule

`default_nettype wire
