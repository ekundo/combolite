// Протокол поверх SPI, буфер сектора и перенос блока.
//
// МЕСТО В СТОПКЕ:
//
//   ESP --SPI--> spi_slave --байты--> ide_remote --команды--> ide_cycle --> привод
//                                         |
//                                    буфер 512 байт
//
// spi_slave не знает, что значат байты; ide_cycle не знает, зачем его дёргают;
// последовательность ATA живёт в прошивке ESP. Здесь только склейка: разбор
// команд, буфер и перенос 256 слов подряд.
//
// ОБМЕН. Ведущий — ESP, линии внимания нет, поэтому всё построено на опросе.
// Каждая посылка (пока CS активен) начинается с байта команды. В ответ ПЕРВЫМ
// байтом всегда идёт СОСТОЯНИЕ — так опрос не требует отдельной команды и ESP
// узнаёт обстановку бесплатно при любом обращении.
//
// Ответ сдвигается с задержкой на один байт: это устройство SPI, байт N выходит,
// пока входит байт N+1. Иначе и быть не может.
//
// КОМАНДЫ:
//   0x00           состояние (и любой неизвестный код тоже отдаёт состояние)
//   0x10 | рег     прочитать регистр привода 0..7; результат забрать 0x18
//   0x18           отдать два байта результата: младший, потом старший
//   0x20 | рег     записать регистр; далее два байта: младший, старший
//   0x30           запросить шину, 0x31 — отпустить
//   0x33           запросить шину в ДОЛГОЕ владение (см. сторож ниже)
//   0x32           сбросить привод (только когда шина наша)
//   0x40           читать буфер, которым владеет ESP: далее 512 байт наружу
//   0x44 | N       читать буфер N (0 или 1) — ЯВНО, без оглядки на владение
//   0x41           писать буфер: далее 512 байт внутрь
//   0x50           привод -> буфер (чередует железо), 256 слов
//   0x54 | N       привод -> буфер N — ЯВНО
//   0x51           буфер -> привод, 256 слов в регистр данных
//
// ДВА БУФЕРА. Их два, чтобы перенос с привода шёл ОДНОВРЕМЕННО с выборкой
// предыдущего сектора по SPI. Порознь эти два дела стоят 190 и 510 мкс, а с
// одним буфером складывались бы.
//
// ЧЕРЕДОВАНИЕ ЖЕЛЕЗОМ (0x40/0x50) -- С ГОНКОЙ НА ЧТЕНИИ. Правило чисто
// буферное, БУФЕР МЕНЯЕТ ХОЗЯИНА:
//
//   наполнил привод (0x50)  -> по окончании переноса буфер переходит к ESP;
//   наполнила ESP  (0x41)   -> в начале переноса (0x51) буфер переходит к приводу.
//
// ГДЕ ГОНКА. Владение у чтения меняется по СОБЫТИЮ — концу переноса, — а оно
// асинхронно потоку команд. Прошивка пускает перенос сектора i и, не дожидаясь
// его, забирает сектор i-1. Обычно выборка успевает начаться, пока перенос идёт,
// и берёт прежний буфер — верно. Но ESP живёт под FreeRTOS рядом с Wi-Fi, и
// вытеснение на 200 мкс между двумя посылками — дело обычное. Перенос (190 мкс)
// к тому времени кончается, владение уже перешло, и 0x40 отдаёт сектор i вместо
// i-1. Прошивка при этом ничего не нарушает: она опоздала, а сказать, какой
// буфер она имеет в виду, ей было нечем.
//
// На живой плате это шесть сбойных секторов на 9420 прочитанных, и КАЖДЫЙ —
// побайтная копия СЛЕДУЮЩЕГО.
//
// ЯВНЫЙ НОМЕР (0x44|N, 0x54|N) — для чтения. Номер буфера
// приезжает в самой команде, поэтому взяться из состояния, которое успело
// смениться, он не может. Владение (esp_buf) при явных командах не трогается
// вовсе. Чередует прошивка, по номеру сектора: буфер i&1 наполняется, буфер
// (i-1)&1 выбирается. Сбиться на шаг прошивка не может: чередование —
// чистая функция счётчика, а не память о прошлом шаге, и железо не даёт
// выбрать буфер, который привод наполняет сейчас.
//
// 0x40/0x50 оставлены: на них работает путь ЗАПИСИ, где гонки нет (там
// владение меняется на самой команде 0x51, синхронно с потоком).
//
// Какой буфер занят, сторона SPI ЗАПОМИНАЕТ в начале посылки. Иначе перенос,
// закончившийся посреди выборки, сменил бы владение прямо под ней.
//
// СОСТОЯНИЕ (первый байт ответа):
//   бит 0  шина захвачена
//   бит 1  идёт цикл обращения к приводу
//   бит 2  идёт перенос блока
//   бит 3  владение отбиралось по времени
//   бит 4  запрошено долгое владение
//   бит 7  признак живости, всегда 1 — отличить от оборванной линии
//
// СТОРОЖ ПРИ ДОЛГОМ ВЛАДЕНИИ. Пока шина у нас, процессор к приводу не ходит —
// значит зависшая ESP заперла бы диск. Полагаться на то, что она сама отпустит,
// нельзя: зависшая на то и зависшая. Поэтому запрос снимается ЗДЕСЬ, если по
// SPI давно ничего не приходило. Порог задаётся разрядом счётчика, а не
// сравнением с числом: один разряд дешевле магнитудного компаратора.

`default_nettype none

module ide_remote #(
    // Разряд счётчика тишины по SPI, по которому сторож снимает запрос.
    // 26 при 50 МГц это 2^26 тактов, около 1,34 с.
    parameter QUIET_BIT = 26,
    // Есть ли различитель сброса с клавиатуры (rom_sense.v). Без него коды
    // C_BOOT и 0x70..0x77 не разбираются вовсе: ESP узнаёт о них по разряду
    // 3 байта 0x6E и без него их не шлёт.
    parameter KBD = 1,
    // Есть ли палитра для снимка экрана (генератор кадра, vid_rec.v). Без неё
    // код C_PALRD не разбирается.
    parameter PAL = 1
) (
    input  wire        clk,
    // ДВА СБРОСА. reset -- сброс машины (~СБРОС с шины) или по питанию: им
    // сбрасывается всё, что касается шины и привода. por -- только по питанию:
    // разбор посылок, буфер со стороны SPI и выключатели устройств. ВВОД
    // держит ~СБРОС всё время нажатия, и автозапуск (autostart.v) держит его
    // так секундами -- ESP должна говорить с платой и тогда, иначе не отпустит
    // машину сама. А выключатель ВГ93, снятый любым ВВОДом, дал бы спор на шине
    // с тем контроллером, ради которого его выключали.
    input  wire        reset,
    input  wire        por,

    // байтовый уровень от spi_slave
    input  wire [7:0]  rx_data,
    input  wire        rx_valid,
    output wire [7:0]  tx_data,
    input  wire        cs_active,

    // к арбитру
    output reg         rem_req,
    output reg         rem_long,       // просим долгое владение
    input  wire        rem_grant,
    input  wire        rem_timeout,
    input  wire        cpu_seen,       // процессор трогал привод, липкий
    input  wire        cpu_quiet,      // процессор молчит дольше порога
    output reg         cpu_seen_clr,   // снять липкий признак

    // к генератору циклов
    // Импульс сброса привода. Исполняет ide.v — линия RESET физически одна.
    output reg         rem_reset,

    output reg         cyc_start,
    output reg         cyc_wr,
    output reg  [2:0]  cyc_addr,
    output reg  [15:0] cyc_wdata,
    input  wire [15:0] cyc_rdata,
    input  wire        cyc_busy,
    input  wire        cyc_done,

    // ---------------------------------------------------------- диагностика
    // Байты, которые иначе с платы не достать никак. Регистр порта 0x10
    // (страницы квазидиска, стековый режим, окна Баркаря) для машины ТОЛЬКО
    // для записи, и что именно пишет туда MicroDOS, иначе не узнать. А от
    // этого зависит, какая страница выбрана,
    // включён ли стековый режим и не выставлены ли биты 6-7, то есть окна
    // 0x8000-0x9FFF и 0xE000-0xFFFF — область экрана и верхняя память.
    //
    // Отсюда и три байта: текущее значение, ЛИПКОЕ «какие разряды когда-либо
    // были выставлены» и счётчик записей. Липкое важнее прочего: одиночную
    // запись мусора в регистр иначе не поймать вовсе.
    // Шесть байт: [0] текущий регистр, [1] липкое «что видели», [2] число
    // записей в порт, [3] обращений в штатном окне, [4] обращений в ОКНАХ
    // БАРКАРЯ, [5] обращений по стеку. Четвёртый важнее прочих: если он не
    // ноль, плата отвечает за область экрана и верхнюю память.
    // Блоки 4 и 5 (0x60..0x6F) -- новые узлы и набор узлов битстрима, top.v.
    input  wire [447:0] diag,

    // Сброс счётчиков наблюдателя (bus_watch). Без него насыщенный счётчик
    // говорит только «за всё время с включения хоть раз было»; со сбросом
    // можно мерить заданный отрезок — например, минуту теста.
    output reg          diag_clr,

    // Заморозка защёлки адреса на время обращения — опыт, см. vu_bus.v.
    // УРОВЕНЬ, а не импульс: держится до обратной команды. Ноль по сбросу,
    // то есть плата всегда поднимается без опыта.
    output reg          latch_gate,
    // Гасить такт защёлки на предсказанном видеоспаде ~RAS. См. vid_phase.v.
    output reg          vid_gate,
    output reg          vid_pol,

    // Квалификация выбора кристалла ОЗУ стробом процессора — опыт, разбор в
    // kvaz_sram.v. Тоже УРОВЕНЬ и тоже ноль по сбросу.
    output reg          ce_gate,

    // Чем квалифицировать выбор кристалла: 1 = по ~CAS, 0 = по стробам.
    // По сбросу ноль, испытанный вариант.
    output reg          ce_by_cas,
    // Эмуляция ВИ53 выключена (vi53.v): на машине с проводом на контакт 42 её
    // звук идёт на то же гнездо, и два таймера дали бы биение.
    output reg          vi53_off,
    // Мышь (mouse.v): ESP шлёт отчёт USB-мыши пакетом 0x42 + кнопки, dx, dy,
    // колесо; 0x43 -- мыши нет. Импульс mouse_stb -- когда пакет принят целиком.
    output reg          mouse_stb,
    output reg  [7:0]   mouse_btn,
    output reg  [7:0]   mouse_dx,
    output reg  [7:0]   mouse_dy,
    output reg  [7:0]   mouse_wh,
    output reg          mouse_present,
    // Выключатели устройств платы (команда 0x49 + маска): разряд 0 -- ВГ93,
    // 1 -- квазидиск 0x10, 2 -- квазидиск 0x11, 3 -- IDE, 4 -- AY, 5 -- зеркало
    // в DD6B (mirror.v). Единица -- устройство не отвечает на шину: для машины,
    // где своё такое уже стоит.
    output reg  [7:0]   dev_off,
    // Источник готовности ВГ93 (команда 0x4A + байт, разряды 1..0), см.
    // rdy_sel в fdc.v. Разряд 2 того же байта -- шлейф дисковода (fdd_pc_cable):
    // 0 -- Шугарт (A: на 10, B: на 12, мотор на 16), 1 -- шлейф ПК с
    // перекруткой (разводка выходов -- в top.v).
    output reg  [1:0]   fdc_rdy_sel,
    output reg          fdd_pc_cable,
    // Предкомпенсация записи ВГ93 (команда 0x4F + байт), см. precomp в fdc.v:
    // разряды 3..0 -- сдвиг импульса, шагов по 62,5 нс (0 -- выключена),
    // разряд 4 -- только с 44-й дорожки (TG43).
    output reg  [4:0]   fdc_pc,
    // Клавиши машины (команда 0x4B + байт), исполняет autostart.v: импульс
    // key_stb и код 0 -- отпустить, 1 -- нажать ВВОД, 2 -- нажать СБР.
    output reg          key_stb,
    output reg  [1:0]   key_cmd,
    // Подставной загрузчик (команда 0x4C + байт), исполняет fakerom.v:
    // 0 -- развзвести, 1 -- взвести, 2 -- взвести и нажать СБР.
    output reg          loader_stb,
    output reg  [1:0]   loader_cmd,
    // Подставной загрузчик после ВВОД с клавиатуры (команда 0x56 + байт,
    // разряд 0), исполняет rom_sense.v. По сбросу выключен.
    output reg          boot_kbd,
    // Карта «грязных» блоков зеркала (команда 0x4D, дальше 32 байта ответа),
    // хранит mirror.v. Сигналы -- комбинационные, в такт приёма байта: ответ
    // нужен через полпериода SCK, а это три такта.
    output wire         dm_start,
    output wire         dm_next,
    input  wire [7:0]   dm_byte,
    // Режим VGA (команда 0x4E + байт, разряд 0): 1 -- 800x600@60 по VESA (по
    // сбросу: 50 Гц берут не все мониторы), 0 -- 50 Гц с привязкой к кадру
    // машины.
    output reg          vga60,
    // Строка экрана для ESP (scr_buf.v): 0x52 + номер -- заявка, 0x53 --
    // выдача 131 байта. Сигналы выдачи -- комбинационные, как у карты блоков.
    output reg          scr_req_stb,
    output reg  [7:0]   scr_req_row,
    output wire         sr_start,
    output wire         sr_next,
    input  wire [7:0]   sr_byte,
    // Палитра для снимка экрана (vid_rec.v): 0x57 -- выдача 17 байт, ячейки
    // 0..15 и порт B (режим 512, бордюр). Номер -- отсюда, байт приходит
    // тактом позже. Дальше по тому же счёту -- журнал записей в порты
    // (vid_rec.v): 2048 байт; пока идёт выдача, pal_busy держит журнал.
    output reg  [10:0]  pal_ra = 11'd0,
    input  wire [7:0]   pal_rd,
    output wire         pal_busy
);

localparam C_RES    = 8'h18,
           C_REQ    = 8'h30, C_REL    = 8'h31, C_RESET = 8'h32,
           C_REQ_LONG = 8'h33, C_SEEN_CLR = 8'h34,
           C_DIAG_CLR = 8'h35,        // обнулить счётчики наблюдателя
           C_LATCH_ON = 8'h36,        // заморозить защёлку на время обращения
           C_LATCH_OFF= 8'h37,        // выключить опыт
           // 0x3A/0x3B БРАТЬ НЕЛЬЗЯ: это середина диапазона чтения диагностики
           // 0x38..0x3F. Переключатели опытов живут рядом с C_CE_* в 0x19..0x1C.
           C_VID_ON   = 8'h1D,        // гасить такт защёлки на видеоспаде
           C_VID_OFF  = 8'h1E,        // выключить опыт
           C_VID_POLA = 8'h1F,        // строб принадлежит ПРЕДЫДУЩЕМУ спаду
           // КАРТА КОДОВ. Выписана потому, что промах мимо неё молчалив: в
           // case выигрывает ПЕРВАЯ совпавшая ветка, лишний код просто
           // становится мёртвым, а команда продолжает возвращать состояние и
           // выглядеть исполненной.
           //
           //   0x00        состояние
           //   0x08..0x0F  C_DIAG3, фаза строба
           //   0x10..0x17  чтение регистра привода
           //   0x18        C_RES
           //   0x19..0x1F  переключатели опытов (C_CE_*, C_VID_*)
           //   0x20..0x27  ЗАПИСЬ регистра привода
           //   0x28..0x2F  C_DIAG2
           //   0x30..0x37  шина, сброс, счётчики, защёлка
           //   0x38..0x3F  C_DIAG
           //   0x40..0x45  буфер: владение и явный номер
           //   0x46        C_VID_POLB
           //   0x47, 0x48  C_VI53_ON, C_VI53_OFF
           //   0x42        C_MOUSE + 4 байта (кнопки, dx, dy, колесо)
           //   0x43        C_MOUSE_OFF
           //   0x49        C_DEV + 1 байт (маска выключенных устройств)
           //   0x4A        C_FDC_RDY + 1 байт (откуда готовность ВГ93)
           //   0x4B        C_KEYS + 1 байт (клавиши ВВОД и СБР)
           //   0x4C        C_LOADER + 1 байт (подставной загрузчик)
           //   0x4D        C_DIRTY, дальше 32 байта карты блоков зеркала
           //   0x4E        C_VGA + 1 байт (режим VGA: 50 или 60 Гц)
           //   0x4F        C_FDC_PC + 1 байт (предкомпенсация записи ВГ93)
           //   0x52        C_SCRROW + 1 байт (заявка на строку экрана)
           //   0x53        C_SCRRD, дальше 131 байт строки экрана
           //   0x57        C_PALRD, дальше 17 байт: палитра и порт B (vid_rec.v)
           //   0x60..0x67  C_DIAG4: новые узлы (генератор кадра, зеркало, ...)
           //   0x68..0x6F  C_DIAG5: растр, дисковод, набор узлов битстрима
           //   0x70..0x77  C_DIAG6: сброс с клавиатуры (rom_sense.v)
           //   0x78..0x7F  C_DIAG7: ВГ93 (fdc.v, dbg)
           //   0x50..0x55  перенос: владение и явный номер
           //
           // Свободно: 0x01..0x07, 0x58..0x5F, 0x80 и выше.
           //
           // C_VID_POLB не на 0x30: там сидит C_REQ, и команда поднимала бы
           // запрос шины, не трогая vid_pol. 0x20 не лучше: это начало
           // диапазона записи регистров.
           C_VID_POLB = 8'h46,        // строб принадлежит ЭТОМУ спаду
           C_VI53_ON  = 8'h47,        // эмуляция ВИ53 в звук (по сбросу)
           C_VI53_OFF = 8'h48,        // выключить: звук таймера даёт сама машина
           C_MOUSE    = 8'h42,        // отчёт мыши, дальше четыре байта
           C_MOUSE_OFF= 8'h43,        // мыши нет: порт D4h молчит
           C_DEV      = 8'h49,        // + маска выключенных устройств
           C_FDC_RDY  = 8'h4A,        // + источник готовности ВГ93
           C_KEYS     = 8'h4B,        // + что нажать: 0 ничего, 1 ВВОД, 2 СБР
           C_LOADER   = 8'h4C,        // + подставной загрузчик: 0 нет, 1 взвести, 2 и СБР
           C_DIRTY    = 8'h4D,        // карта блоков зеркала: 32 байта, чтение гасит
           C_VGA      = 8'h4E,        // + режим VGA: разряд 0 -- 60 Гц
           C_FDC_PC   = 8'h4F,        // + предкомпенсация ВГ93: 3..0 шаги, 4 -- TG43
           C_BOOT     = 8'h56,        // + загрузчик после ВВОД с клавиатуры: разряд 0
           C_SCRROW   = 8'h52,        // + номер строки экрана для ESP
           C_SCRRD    = 8'h53,        // выдача строки экрана, 131 байт
           C_PALRD    = 8'h57,        // выдача палитры и порта B, 17 байт
           C_CE_ON    = 8'h19,        // выбирать кристалл ОЗУ только на стробах
           C_CE_OFF   = 8'h1A,        // выключить опыт
           C_CE_CAS   = 8'h1B,        // квалифицировать по ~CAS
           C_CE_STB   = 8'h1C,        // квалифицировать по стробам
           C_DIAG   = 8'h38,          // 0x38..0x3F: первые восемь байт
           C_DIAG2  = 8'h28,          // 0x28..0x2F: ещё восемь
           C_DIAG3  = 8'h08,          // 0x08..0x0F: фаза строба относительно шины
           C_BUF_RD = 8'h40, C_BUF_WR = 8'h41,
           C_SEC_RD = 8'h50, C_SEC_WR = 8'h51,
           // ЧТЕНИЕ С ЯВНЫМ НОМЕРОМ БУФЕРА, младший разряд кода — номер.
           // Зачем понадобилось — см. раздел «Чередование» в шапке.
           C_BUF_RD0 = 8'h44, C_BUF_RD1 = 8'h45,   // выборка буфера N по SPI
           C_SEC_RD0 = 8'h54, C_SEC_RD1 = 8'h55;   // привод -> буфер N

// ------------------------------------------------------------- буфер сектора
// 256 слов по 16 разрядов = 512 байт.
//
// ДОСТУП СТРОГО ОДНИМ ПОРТОМ НА БУФЕР, и это не стилистика. Три разных
// выражения чтения массива вперемешку с остальной логикой синтез разворачивает
// в РЕГИСТРЫ: 11 580 LUT4 и 4 193 триггера, в пять с половиной раз больше
// всего кристалла. Чтобы память легла в блочную (EBR), нужен ровно один порт с
// регистрированным выходом и никаких чтений в условных ветках.
//
// Задержка чтения в один такт никому не мешает: между байтами SPI проходит
// 1,6 мкс, между циклами привода 740 нс, а такт у нас 20 нс.



// --------------------------------------------------------------- состояние

localparam P_CMD = 4'd0, P_WR_LO = 4'd1, P_WR_HI = 4'd2,
           P_RES = 4'd3, P_BUF_RD = 4'd4, P_BUF_WR = 4'd5,
           P_DIAG = 4'd6, P_MOUSE = 4'd7,
           P_ARG = 4'd8,                  // один байт аргумента, см. arg_of
           P_DIRTY = 4'd9,                // выдача карты блоков зеркала
           P_SCR   = 4'd10,               // выдача строки экрана
           P_PAL   = 4'd11;               // выдача палитры

reg [3:0]  phase;
reg [2:0]  arg_of;                  // чей аргумент ждём: 0 C_DEV, 1 C_FDC_RDY, 2 C_KEYS, 3 C_LOADER, 4 C_VGA, 5 C_SCRROW, 6 C_FDC_PC
reg [15:0] res_word;
reg [7:0]  wr_lo, wr_hi;
reg [1:0]  ms_n;                    // какой байт отчёта мыши ждём
reg        buf_half, res_half, buf_first;

// Четыре состояния, и три из них нужны из-за однопортовой памяти:
//   B_PREP  — дать blk_dout устояться после смены адреса (нужно ДВА такта:
//             blk_dout <= buf_mem[...] берёт адрес ДО фронта);
//   B_ISSUE — выдать цикл;
//   B_WAIT  — дождаться его конца и подготовить запись в память;
//   B_STORE — здесь blk_we уже поднят, запись совершается на выходе из
//             состояния, и только ПОСЛЕ этого адрес можно увеличивать.
// Приращение в том же такте, что и blk_we, положило бы данные на единицу
// дальше: запись в блок идёт на следующем фронте, а адрес к тому времени уже
// другой.
localparam B_IDLE = 3'd0, B_PREP = 3'd1, B_ISSUE = 3'd2, B_WAIT = 3'd3,
           B_STORE = 3'd4;
reg [1:0] blk_prep;
reg [2:0]  blk_state;
reg        blk_wr;
// Наполнение начато командой с ЯВНЫМ номером буфера. Тогда владение по
// окончании не меняется: при явной адресации esp_buf никого не интересует, а
// лишняя смена состояния только путала бы разбор.
reg        blk_expl;
reg [8:0]  blk_cnt;
wire       blk_busy = (blk_state != B_IDLE);

// ------------------------------------------------------------- буфер сектора
// Два буфера по 256 слов, у каждого свой порт памяти (ниже): буфер 0 на
// порту A, буфер 1 на порту B. Каждый порт обслуживает либо SPI, либо перенос.
//
// Одновременно работать с ОДНИМ буфером стороны не могут по построению:
//
//   - выборка по SPI занимает буфер esp_buf, перенос — всегда другой;
//   - команда переноса не может прийти посреди выборки: выборка кончается
//     снятием CS, а оно возвращает разбор в ожидание команды.
//
// Поэтому каждый буфер обслуживает ровно ту сторону, которой он сейчас нужен,
// и мультиплексор ниже не создаёт спора за порт.

reg [7:0]  spi_addr, blk_addr;      // адрес внутри буфера
reg        spi_buf,  blk_buf;       // номер буфера, взятый в начале посылки
reg        esp_buf;                 // чей сейчас: буфер esp_buf принадлежит ESP
reg        spi_we,   blk_we;
reg [15:0] spi_din,  blk_din;
wire [15:0] q0, q1;

wire blk_on0 = blk_busy & (blk_buf == 1'b0);
wire blk_on1 = blk_busy & (blk_buf == 1'b1);

wire [7:0]  a0 = blk_on0 ? blk_addr : spi_addr;
wire        w0 = blk_on0 ? blk_we   : spi_we;
wire [15:0] d0 = blk_on0 ? blk_din  : spi_din;

wire [7:0]  a1 = blk_on1 ? blk_addr : spi_addr;
wire        w1 = blk_on1 ? blk_we   : spi_we;
wire [15:0] d1 = blk_on1 ? blk_din  : spi_din;

// Оба буфера -- в одной двухпортовой памяти: порт A -- буфер 0 (адреса
// 0..255), порт B -- буфер 1 (256..511). Два блока EBR на оба буфера, по байту
// слова в каждом; порознь Synplify отвёл бы на каждый буфер по два (bram.v).
genvar gy;
generate
    for (gy = 0; gy < 2; gy = gy + 1) begin : g_buf
        bram_tdp #(.AW(9), .DW(8)) b (
            .clk(clk),
            .we_a(w0), .a_a({1'b0, a0}), .d_a(d0[8*gy +: 8]), .q_a(q0[8*gy +: 8]),
            .we_b(w1), .a_b({1'b1, a1}), .d_b(d1[8*gy +: 8]), .q_b(q1[8*gy +: 8]));
    end
endgenerate

wire [15:0] spi_dout = spi_buf ? q1 : q0;
wire [15:0] blk_dout = blk_buf ? q1 : q0;

// Разряд 7 — признак живости, по нему видно, что отвечает ПЛИС, а не тишина на
// шине. Разряды 6 и 5 -- согласованность с «Вектором»:
// cpu_seen говорит «машина лазила на диск с тех пор, как вы смотрели», cpu_quiet
// — «сейчас писать можно».
wire [7:0] status = {1'b1, cpu_seen, cpu_quiet, rem_long, rem_timeout,
                     blk_busy, cyc_busy, rem_grant};

// Счётчик тишины по SPI для сторожа. Обнуляется любым байтом и любым выбором.
reg [5:0] diag_sel;
reg [QUIET_BIT:0] quiet;
wire quiet_too_long = quiet[QUIET_BIT];

// Ответ отдаётся по ТЕКУЩЕЙ фазе, а spi_slave берёт его на границе байта, когда
// фаза уже обновлена приёмом. Поэтому здесь комбинация, а не регистр: так
// исчезает целый класс ошибок «на байт раньше или позже».
// Явный мультиплексор, а не индексная часть-выборка: так надёжнее с чужими
// синтезаторами, а шесть веток читаются не хуже одной строки.
//
// Исключение -- байт диагностики: после мультиплексора на 40 байт стоит регистр
// diag_byte_q. Комбинационно путь diag_sel -> мультиплексор -> sh_out в блоке
// вывода MISO был бы худшим в clk50 после пути арбитра (по Diamond).
// Опоздание на такт безопасно: diag_sel меняется в такт после
// rx_valid, а spi_slave берёт байт на спаде SCK, через полпериода после
// восьмого фронта. Регистр готов на третьем такте после rx_valid, то есть
// SCK до ~8 МГц -- выше и так не даёт передискретизация (spi_slave.v).
reg [7:0] diag_byte, diag_byte_q;
always @(posedge clk) diag_byte_q <= diag_byte;
always @(*) case (diag_sel)
    4'd0:  diag_byte = diag[7:0];
    4'd1:  diag_byte = diag[15:8];
    4'd2:  diag_byte = diag[23:16];
    4'd3:  diag_byte = diag[31:24];
    4'd4:  diag_byte = diag[39:32];
    4'd5:  diag_byte = diag[47:40];
    4'd6:  diag_byte = diag[55:48];
    4'd7:  diag_byte = diag[63:56];
    4'd8:  diag_byte = diag[71:64];
    4'd9:  diag_byte = diag[79:72];
    5'd10: diag_byte = diag[87:80];
    5'd11: diag_byte = diag[95:88];
    5'd12: diag_byte = diag[103:96];
    5'd13: diag_byte = diag[111:104];
    5'd14: diag_byte = diag[119:112];
    5'd15: diag_byte = diag[127:120];
    5'd16: diag_byte = diag[135:128];
    5'd17: diag_byte = diag[143:136];
    5'd18: diag_byte = diag[151:144];
    5'd19: diag_byte = diag[159:152];
    5'd20: diag_byte = diag[167:160];
    5'd21: diag_byte = diag[175:168];
    5'd22: diag_byte = diag[183:176];
    5'd23: diag_byte = diag[191:184];
    6'd24: diag_byte = diag[199:192];
    6'd25: diag_byte = diag[207:200];
    6'd26: diag_byte = diag[215:208];
    6'd27: diag_byte = diag[223:216];
    6'd28: diag_byte = diag[231:224];
    6'd29: diag_byte = diag[239:232];
    6'd30: diag_byte = diag[247:240];
    6'd31: diag_byte = diag[255:248];
    6'd32: diag_byte = diag[263:256];
    6'd33: diag_byte = diag[271:264];
    6'd34: diag_byte = diag[279:272];
    6'd35: diag_byte = diag[287:280];
    6'd36: diag_byte = diag[295:288];
    6'd37: diag_byte = diag[303:296];
    6'd38: diag_byte = diag[311:304];
    6'd39: diag_byte = diag[319:312];
    6'd40: diag_byte = diag[327:320];
    6'd41: diag_byte = diag[335:328];
    6'd42: diag_byte = diag[343:336];
    6'd43: diag_byte = diag[351:344];
    6'd44: diag_byte = diag[359:352];
    6'd45: diag_byte = diag[367:360];
    6'd46: diag_byte = diag[375:368];
    6'd47: diag_byte = diag[383:376];
    6'd48: diag_byte = diag[391:384];
    6'd49: diag_byte = diag[399:392];
    6'd50: diag_byte = diag[407:400];
    6'd51: diag_byte = diag[415:408];
    6'd52: diag_byte = diag[423:416];
    6'd53: diag_byte = diag[431:424];
    6'd54: diag_byte = diag[439:432];
    default: diag_byte = diag[447:440];
endcase

assign dm_start = rx_valid & (phase == P_CMD) & (rx_data == C_DIRTY);
assign dm_next  = rx_valid & (phase == P_DIRTY);
assign sr_start = rx_valid & (phase == P_CMD) & (rx_data == C_SCRRD);
assign sr_next  = rx_valid & (phase == P_SCR);
assign pal_busy = (phase == P_PAL);

assign tx_data = (phase == P_RES)    ? (res_half ? res_word[15:8] : res_word[7:0])
               : (phase == P_DIRTY)  ? dm_byte
               : (phase == P_SCR)    ? sr_byte
               : (phase == P_PAL)    ? pal_rd
               : (phase == P_BUF_RD) ? (buf_half ? spi_dout[7:0]  : spi_dout[15:8])
               : (phase == P_DIAG)   ? diag_byte_q
               : status;

always @(posedge clk) begin
    cyc_start <= 1'b0;
    spi_we    <= 1'b0;
    blk_we    <= 1'b0;
    rem_reset <= 1'b0;          // импульс в один такт
    cpu_seen_clr <= 1'b0;       // тоже импульс
    diag_clr     <= 1'b0;       // и этот импульс
    mouse_stb    <= 1'b0;       // и этот
    key_stb      <= 1'b0;       // и этот
    loader_stb   <= 1'b0;       // и этот
    scr_req_stb  <= 1'b0;       // и этот
    // ВНИМАНИЕ. Выше — блок умолчаний, он исполняется КАЖДЫЙ ТАКТ и существует
    // ровно затем, чтобы делать импульсы в один такт. Класть сюда уровни
    // нельзя: они гаснут через 20 нс -- команда проходит, уровень живёт один
    // такт, и опыт молча ничего не меняет. Уровни живут только
    // в блоках сброса ниже -- их два, см. reset и por в списке портов.

    if (por) begin
        phase     <= P_CMD;
        diag_sel  <= 6'd0;
        quiet     <= {(QUIET_BIT+1){1'b0}};
        spi_addr  <= 8'h00;
        spi_buf   <= 1'b0;
        esp_buf   <= 1'b0;
        spi_din   <= 16'h0000;
        buf_half  <= 1'b0;
        res_half  <= 1'b0;
        buf_first <= 1'b1;
        cpu_seen_clr <= 1'b0;
        diag_clr     <= 1'b0;
        vi53_off     <= 1'b0;   // по сбросу эмуляция включена
        mouse_present <= 1'b0;  // пока ESP не прислал отчёт, мыши нет
        dev_off   <= 8'h00;     // по сбросу всё включено
        fdc_rdy_sel <= 2'd1;    // готовность по индексу -- годится к любому приводу
        fdd_pc_cable <= 1'b0;   // по сбросу шлейф Шугарта, как у кишинёвской платы
        fdc_pc    <= 5'd0;      // по сбросу предкомпенсации нет: 3,5" и Gotek она не нужна
        arg_of    <= 3'd0;
        vga60     <= 1'b1;      // по сбросу -- 60 Гц по VESA, как и в ESP
        key_cmd   <= 2'd0;
        loader_cmd <= 2'd0;
        boot_kbd  <= 1'b0;      // по сбросу ВВОД с клавиатуры ведёт в ПЗУ, как без платы
        scr_req_row <= 8'd0;
        mouse_btn <= 8'h00; mouse_dx <= 8'h00; mouse_dy <= 8'h00; mouse_wh <= 8'h00;
        ms_n      <= 2'd0;
    end
    else begin
        // Сторож: любой признак жизни по SPI обнуляет счётчик, а по его
        // переполнению запрос снимается сам. Без этого зависшая ESP держала бы
        // диск, пока арбитр не отберёт его по своему пределу.
        if (rx_valid | cs_active)      quiet <= {(QUIET_BIT+1){1'b0}};
        else if (!quiet_too_long)      quiet <= quiet + 1'b1;

        if (quiet_too_long) begin rem_req <= 1'b0; rem_long <= 1'b0; end

        if (!cs_active) phase <= P_CMD;

        // ------------------------------------------------- разбор посылки
        if (rx_valid) case (phase)

        P_CMD:
            casez (rx_data)
            8'b0001_0???: begin                     // 0x10..0x17 чтение регистра
                              cyc_addr  <= rx_data[2:0];
                              cyc_wr    <= 1'b0;
                              cyc_start <= 1'b1;
                          end
            C_RES:        begin res_half <= 1'b0; phase <= P_RES; end
            8'b0010_0???: begin                     // 0x20..0x27 запись регистра
                              cyc_addr <= rx_data[2:0];
                              phase    <= P_WR_LO;
                          end
            C_REQ:      begin rem_req <= 1'b1; rem_long <= 1'b0; end
            C_REQ_LONG: begin rem_req <= 1'b1; rem_long <= 1'b1; end
            C_REL:      begin rem_req <= 1'b0; rem_long <= 1'b0; end
            // Сброс — ТОЛЬКО когда шина наша. Иначе привод перезапустится
            // посреди последовательности процессора, и драйвер в машине
            // обнаружит его в состоянии, которого не ожидал. Проверка здесь,
            // а не в ide.v: там про владение шиной не знают.
            C_RESET:  if (rem_grant & ~cyc_busy & ~blk_busy) rem_reset <= 1'b1;
            // Признак снимают ПЕРЕД тем, как читать диск: тогда поднявшийся к
            // концу чтения cpu_seen означает, что машина вмешалась именно
            // сейчас, и прочитанному верить нельзя.
            C_SEEN_CLR: cpu_seen_clr <= 1'b1;
            C_DIAG_CLR: diag_clr <= 1'b1;
            C_LATCH_ON:  latch_gate <= 1'b1;
            C_LATCH_OFF: latch_gate <= 1'b0;
            C_VID_ON:    vid_gate   <= 1'b1;
            C_VID_OFF:   vid_gate   <= 1'b0;
            C_VID_POLA:  vid_pol    <= 1'b0;
            C_VID_POLB:  vid_pol    <= 1'b1;
            C_CE_ON:     ce_gate    <= 1'b1;
            C_CE_OFF:    ce_gate    <= 1'b0;
            C_CE_CAS:    ce_by_cas  <= 1'b1;
            C_CE_STB:    ce_by_cas  <= 1'b0;
            C_VI53_ON:   vi53_off   <= 1'b0;
            C_VI53_OFF:  vi53_off   <= 1'b1;
            C_MOUSE:     begin ms_n <= 2'd0; phase <= P_MOUSE; end
            C_MOUSE_OFF: mouse_present <= 1'b0;
            C_DEV:       begin arg_of <= 3'd0; phase <= P_ARG; end
            C_FDC_RDY:   begin arg_of <= 3'd1; phase <= P_ARG; end
            C_KEYS:      begin arg_of <= 3'd2; phase <= P_ARG; end
            C_LOADER:    begin arg_of <= 3'd3; phase <= P_ARG; end
            C_VGA:       begin arg_of <= 3'd4; phase <= P_ARG; end
            C_FDC_PC:    begin arg_of <= 3'd6; phase <= P_ARG; end
            C_BOOT:      if (KBD) begin arg_of <= 3'd7; phase <= P_ARG; end
            C_DIRTY:     phase <= P_DIRTY;
            C_SCRROW:    begin arg_of <= 3'd5; phase <= P_ARG; end
            C_SCRRD:     phase <= P_SCR;
            C_PALRD:     if (PAL) begin pal_ra <= 11'd0; phase <= P_PAL; end
            // Диагностика: 0x38 текущий регистр, 0x39 липкое «что видели»,
            // 0x3A..0x3D счётчики, 0x3E..0x3F наблюдатель. Ответ приходит
            // СЛЕДУЮЩИМ байтом, как у чтения регистра привода.
            8'b0011_1???: begin
                              diag_sel <= {3'b000, rx_data[2:0]};
                              phase    <= P_DIAG;
                          end
            // Второй блок, 0x28..0x2F: измерения наблюдателя. Отдельным
            // диапазоном, а не расширением первого, нарочно -- прошивка,
            // встретив битстрим без этого блока, получит на 0x28 байт
            // состояния вместо данных и это заметит.
            //
            // Диапазон именно 0x28, а не 0x20: 0x20..0x27 — это запись
            // регистра привода, и ветка casez выше просто съела бы команду.
            8'b0010_1???: begin
                              diag_sel <= {3'b001, rx_data[2:0]};
                              phase    <= P_DIAG;
                          end
            // Третий блок, 0x08..0x0F: фаза строба относительно циклов шины.
            8'b0000_1???: begin
                              diag_sel <= {3'b010, rx_data[2:0]};
                              phase    <= P_DIAG;
                          end
            // Четвёртый и пятый, 0x60..0x6F: новые узлы (шапка карты выше).
            8'b0110_????: begin
                              diag_sel <= 6'd24 + {2'b00, rx_data[3:0]};
                              phase    <= P_DIAG;
                          end
            // Шестой, 0x70..0x77: сброс с клавиатуры (rom_sense.v).
            8'b0111_0???: if (KBD) begin
                              diag_sel <= 6'd40 + {3'b000, rx_data[2:0]};
                              phase    <= P_DIAG;
                          end
            // Седьмой, 0x78..0x7F: ВГ93 (fdc.v, dbg).
            8'b0111_1???: begin
                              diag_sel <= 6'd48 + {3'b000, rx_data[2:0]};
                              phase    <= P_DIAG;
                          end
            // Буфер по SPI — всегда тот, что принадлежит ESP. Номер берётся
            // ЗДЕСЬ и держится до конца посылки: смена владения посреди
            // выборки не должна её задеть. Проверка на занятость оставлена
            // страховкой — при исправном чередовании она не срабатывает
            // никогда, потому что привод работает с другим буфером.
            C_BUF_RD: if (!blk_busy || blk_buf != esp_buf) begin
                          spi_buf  <= esp_buf;
                          spi_addr <= 8'h00;
                          buf_half <= 1'b0;
                          phase    <= P_BUF_RD;
                      end
            // ЯВНЫЙ НОМЕР. Владение здесь ни при чём: буфер называет прошивка,
            // а железо только не даёт залезть в тот, который привод наполняет
            // прямо сейчас. Гонки нет по построению — номер приехал в самой
            // команде, а не был взят из состояния, которое могло смениться.
            C_BUF_RD0,
            C_BUF_RD1: if (!blk_busy || blk_buf != rx_data[0]) begin
                          spi_buf  <= rx_data[0];
                          spi_addr <= 8'h00;
                          buf_half <= 1'b0;
                          phase    <= P_BUF_RD;
                      end
            C_BUF_WR: if (!blk_busy || blk_buf != esp_buf) begin
                          spi_buf   <= esp_buf;
                          spi_addr  <= 8'h00;
                          buf_half  <= 1'b0;
                          buf_first <= 1'b1;
                          phase     <= P_BUF_WR;
                      end
            // Чтение: привод наполняет СВОБОДНЫЙ буфер, а по окончании
            // переноса тот переходит к ESP (см. B_STORE).
            C_SEC_RD: if (!blk_busy) begin
                          blk_wr    <= 1'b0;
                          blk_expl  <= 1'b0;
                          blk_buf   <= ~esp_buf;
                          blk_cnt   <= 9'd0;
                          blk_addr  <= 8'h00;
                          blk_prep  <= 2'd2;
                          blk_state <= B_PREP;
                      end
            // Наполнение с ЯВНЫМ номером: парная к C_BUF_RD0/1. Владение
            // (esp_buf) здесь НЕ трогается вовсе — при явной адресации оно
            // никому не нужно, а менять его значило бы оставить прошивке
            // состояние, за которым надо следить. Чередует буферы прошивка,
            // и делает это по номеру сектора, а не по памяти о прошлом шаге.
            C_SEC_RD0,
            C_SEC_RD1: if (!blk_busy) begin
                          blk_wr    <= 1'b0;
                          blk_expl  <= 1'b1;
                          blk_buf   <= rx_data[0];
                          blk_cnt   <= 9'd0;
                          blk_addr  <= 8'h00;
                          blk_prep  <= 2'd2;
                          blk_state <= B_PREP;
                      end
            // Запись: привод забирает буфер, который ESP только что наполнила,
            // и владение меняется СРАЗУ — ESP получает свободный и может
            // готовить в нём следующий сектор, пока идёт перенос.
            // ЗАПИСЬ ТОЛЬКО ПО ТИШИНЕ. Это не подсказка прошивке, а правило,
            // за которым следит железо: пока процессор не помолчал, цикл
            // записи не начнётся вовсе. Прошивка узнаёт причину из состояния —
            // blk_busy не поднялся, а cpu_quiet в нуле.
            C_SEC_WR: if (!blk_busy && cpu_quiet) begin
                          blk_wr    <= 1'b1;
                          blk_expl  <= 1'b0;
                          blk_buf   <= esp_buf;
                          esp_buf   <= ~esp_buf;
                          blk_cnt   <= 9'd0;
                          blk_addr  <= 8'h00;
                          blk_prep  <= 2'd2;
                          blk_state <= B_PREP;
                      end
            default: ;                              // прочее = только состояние
            endcase

        // Байт диагностики отдан — возвращаемся к приёму команд.
        P_DIAG: phase <= P_CMD;

        // Карта блоков и строка экрана идут до конца выборки: фазу сбросит
        // подъём CS.
        P_DIRTY: ;
        P_SCR:   ;
        P_PAL:   pal_ra <= pal_ra + 11'd1;   // по кругу, до подъёма CS

        P_WR_LO: begin wr_lo <= rx_data; phase <= P_WR_HI; end

        P_ARG: begin
            case (arg_of)
            3'd0:    dev_off     <= rx_data;
            3'd1:    begin fdc_rdy_sel <= rx_data[1:0]; fdd_pc_cable <= rx_data[2]; end
            3'd2:    begin key_cmd    <= rx_data[1:0]; key_stb    <= 1'b1; end
            3'd3:    begin loader_cmd <= rx_data[1:0]; loader_stb <= 1'b1; end
            3'd4:    vga60 <= rx_data[0];
            3'd6:    fdc_pc <= rx_data[4:0];
            3'd7:    if (KBD) boot_kbd <= rx_data[0];
            default: begin scr_req_row <= rx_data; scr_req_stb <= 1'b1; end
            endcase
            phase <= P_CMD;
        end

        // Отчёт мыши: кнопки, dx, dy, колесо. Пакет целиком в одной выборке SPI,
        // оборванный (CS поднялся раньше) просто пропадает: фаза сбрасывается в
        // P_CMD по снятию CS, импульса не будет.
        P_MOUSE: begin
            case (ms_n)
                2'd0: mouse_btn <= rx_data;
                2'd1: mouse_dx  <= rx_data;
                2'd2: mouse_dy  <= rx_data;
                2'd3: begin
                          mouse_wh      <= rx_data;
                          mouse_stb     <= 1'b1;
                          mouse_present <= 1'b1;
                          phase         <= P_CMD;
                      end
            endcase
            ms_n <= ms_n + 1'b1;
        end

        P_WR_HI: begin
            cyc_wdata <= {rx_data, wr_lo};
            cyc_wr    <= 1'b1;
            cyc_start <= 1'b1;
            phase     <= P_CMD;
        end

        P_RES:
            if (!res_half) res_half <= 1'b1;
            else           phase    <= P_CMD;

        P_BUF_RD:
            if (!buf_half) buf_half <= 1'b1;
            else begin
                buf_half <= 1'b0;
                spi_addr <= spi_addr + 8'd1;
            end

        // Приращение адреса стоит на ПРИЁМЕ СТАРШЕГО байта следующего слова, а
        // не рядом с spi_we. Иначе запись, совершающаяся на следующем фронте,
        // уходит на адрес выше (см. перенос блока).
        P_BUF_WR:
            if (!buf_half) begin
                if (!buf_first) spi_addr <= spi_addr + 8'd1;
                buf_first <= 1'b0;
                wr_hi     <= rx_data;
                buf_half  <= 1'b1;
            end
            else begin
                spi_din  <= {wr_hi, rx_data};
                spi_we   <= 1'b1;
                buf_half <= 1'b0;
            end

        default: phase <= P_CMD;
        endcase

        // ------------------------------------------------- перенос блока
        case (blk_state)
        B_PREP:
            if (blk_prep != 2'd0) blk_prep <= blk_prep - 2'd1;
            else                  blk_state <= B_ISSUE;
        B_ISSUE: if (!cyc_busy) begin
            cyc_addr  <= 3'd0;                      // регистр данных привода
            cyc_wr    <= blk_wr;
            if (blk_wr) cyc_wdata <= blk_dout;      // устоялось за B_PREP
            cyc_start <= 1'b1;
            blk_state <= B_WAIT;
        end
        B_WAIT: if (cyc_done) begin
            if (!blk_wr) begin
                blk_din <= cyc_rdata;
                blk_we  <= 1'b1;                    // запись — на выходе из B_STORE
            end
            blk_state <= B_STORE;
        end
        B_STORE: begin
            // blk_we поднят, запись совершается на фронте ВЫХОДА отсюда, и
            // приращение адреса здесь же ей не мешает: блок памяти берёт адрес
            // до фронта.
            if (blk_cnt == 9'd255) begin
                blk_state <= B_IDLE;
                // Наполненный приводом буфер переходит к ESP. У записи владение
                // сменилось ещё на команде, второй раз менять нечего.
                if (!blk_wr && !blk_expl) esp_buf <= ~esp_buf;
            end
            else begin
                blk_cnt   <= blk_cnt + 9'd1;
                blk_addr  <= blk_addr + 8'd1;
                blk_prep  <= 2'd2;
                blk_state <= B_PREP;
            end
        end
        default: ;
        endcase

        // Результат одиночного чтения регистра
        if (cyc_done && !blk_busy) res_word <= cyc_rdata;
    end

    // Сброс машины: всё, что касается шины и привода. Стоит ПОСЛЕ разбора
    // посылок и перекрывает его -- команда к приводу, пришедшая во время
    // сброса, пропадает (ide_cycle и арбитр в это время сами в сбросе, цикл
    // не начался бы, а перенос ждал бы cyc_done вечно). Опыты с защёлкой и
    // выбором кристалла -- тоже здесь: машина после ВВОД поднимается без опытов.
    if (reset) begin
        rem_req   <= 1'b0;
        rem_long  <= 1'b0;
        cyc_start <= 1'b0;
        cyc_wr    <= 1'b0;
        cyc_addr  <= 3'd0;
        cyc_wdata <= 16'h0000;
        res_word  <= 16'h0000;
        blk_addr  <= 8'h00;
        blk_buf   <= 1'b0;
        blk_din   <= 16'h0000;
        blk_we    <= 1'b0;
        blk_state <= B_IDLE;
        blk_cnt   <= 9'd0;
        blk_prep  <= 2'd0;
        blk_wr    <= 1'b0;
        rem_reset <= 1'b0;
        latch_gate   <= 1'b0;   // уровни опытов: по сбросу -- опыты выключены
        vid_gate     <= 1'b0;
        vid_pol      <= 1'b0;
        ce_gate      <= 1'b0;
        ce_by_cas    <= 1'b0;
    end
end

endmodule

`default_nettype wire
