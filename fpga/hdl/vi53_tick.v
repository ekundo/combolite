// Такт ВИ53 от машины: 1,5 МГц, привязанные к её видеоциклам.
//
// ЗАЧЕМ. ВИ53 «Вектора» считает от того же кварца, что и всё остальное: 12 МГц
// на 8 = 1,5 МГц. Эмуляции со своим кварцем (50 МГц x 3/100) это число только
// кажется равным: два кварца расходятся на доли процента, и на машине, где
// звук настоящего таймера ещё и идёт проводом с контакта 42 на то же гнездо,
// длинная нота даёт биение (vi53.v, «ТАКТ ОТ МАШИНЫ»).
//
// ОПОРА -- ВИДЕОЦИКЛ. Он длится 16 тактов кварца машины, 1333 нс (замер: 66-67
// тактов нашего генератора), то есть ровно два такта ВИ53. Видеоцикл отличает
// vid_phase.v: спад ~RAS в его окне при захвате.
//
// КАК. Свой генератор 1,5 МГц (3/100 от 50 МГц, как в vi53.v) идёт сам, а на
// каждом видеоспаде его фаза ставится в ноль. Между спадами он и даёт второй
// такт, и закрывает пропуски: различитель может не опознать отдельный спад, и
// такт от этого не выпадает. На спаде такт даётся, если прошлый был дальше
// полупериода; иначе только сбрасывается фаза -- двух тактов подряд не бывает.
// Средняя частота выходит частотой машины, дрожание -- такт нашего
// генератора, 20 нс, для звука ничто.
//
// en -- захват различителя есть и видеоспад был недавно. Без него vi53.v
// считает по своему генератору.
`default_nettype none

module vi53_tick (
    input  wire clk,
    input  wire reset,
    input  wire vid_fall,      // спад ~RAS видеоцикла (ras_fall & vid_win)
    input  wire vid_lock,
    output reg  tick = 1'b0,
    output wire en
);

reg [6:0] acc = 7'd0;          // фаза в третях такта: 100 -- период ВИ53
reg [5:0] since = 6'd0;        // тактов с прошлого такта ВИ53
reg [7:0] quiet = 8'hFF;       // тактов с прошлого видеоспада

always @(posedge clk) begin
    tick <= 1'b0;
    if (~&since) since <= since + 6'd1;
    if (~&quiet) quiet <= quiet + 8'd1;

    if (reset) begin
        acc <= 7'd0; quiet <= 8'hFF;
    end
    else if (vid_fall & vid_lock) begin
        quiet <= 8'd0;
        acc   <= 7'd0;
        if (since >= 6'd17) begin tick <= 1'b1; since <= 6'd0; end
    end
    else if (acc + 7'd3 >= 7'd100) begin
        acc   <= acc + 7'd3 - 7'd100;
        tick  <= 1'b1;
        since <= 6'd0;
    end
    else
        acc <= acc + 7'd3;
end

// два видеоцикла без спада -- опоры нет
assign en = vid_lock & (quiet < 8'd140);

endmodule

`default_nettype wire
