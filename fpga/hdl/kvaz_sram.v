// Квазидиск «Вектор-06Ц» на внешнем статическом ОЗУ.
//
// Основано на kvaz.v из svofski/vector06c-lesshadoks (modified BSD),
// поддержка расширений А. Баркаря там же от Ивана Городецкого.
// Переделано под плату: квазидиск -- внешняя статика, FPGA лишь выдаёт номер
// страницы в старшие разряды адреса и снимает /БЛК.
// У svofski номер страницы уходил в арбитр SDRAM.
//
// ДВА КВАЗИДИСКА. Модуль один, порт -- параметр: 0x10 и 0x11 (второй диск,
// банкинг RDS в CO по 10h/11h, тест ware/921). Как они делят память и кто главнее
// при споре -- в top.v.
//
// Регистр управления, порт 0x10 (0x11). Названия разрядов — АВТОРСКИЕ, из таблицы
// А. Баркаря («Радиолюбитель» 11/95, с. 4, раздел «Управление квазидиском»),
// а не наши пересказы:
//
//   [1:0] экран. банк — банк для областей экрана
//   [3:2] стек. банк  — банк для стековых операций
//   [4]   замена стека
//   [5]   замена экрана 1-2 — область A000-DFFF
//   [6]   замена экрана 3   — область 8000-9FFF
//   [7]   замена экрана 0   — область E000-FFFF
//
// «Замена»: 0 — операции с квазидиском отключены, 1 — включены.
//
// ТРИ ЗАМЕНЫ НЕЗАВИСИМЫ, И РАЗРЯД 5 НЕ ГЛАВНЕЕ ОСТАЛЬНЫХ. Он включает ровно
// свою область A000-DFFF. «ОЗУ включено» — наше собственное прозвище, оно
// прижилось потому, что микродос держит все три разряда разом (`11100000B`,
// пример из той же статьи), и по одному их никто не наблюдал.
//
// ОТ ЭМУЛЯТОРА ОТЛИЧАЕМСЯ НАМЕРЕННО. В `kvaz.v` стоит
//
//   wire ram_sel = cr_ram_on & addr_sel & (memwr|memrd);
//
// где `addr_sel` — все три области разом, и потому при `40h`, `80h`, `C0h`
// эмулятор не отдаёт квазидиску ничего. Настоящая доработка отдаёт. Это
// показали тесты Баркаря на живой машине (`ware/918` и `ware/921`) и
// подтвердил первоисточник: совпадение с эмулятором — не доказательство.
//
// Схема на с. 5 статьи в этом вопросе бесполезна: дешифрация областей сидит в
// ПЗУ `DD6 К155РЕ3` (32×8), её содержимого в журнале нет. Решает таблица.
//
// Чтобы не начать круг заново: в `kvaz.v` окно записано как
//
//   ((adsel==4'h8)|(adsel==4'h9)&&(control_reg[6]==1))
//
// и легко прочесть, что `&&` связывает сильнее `|`, а значит оригинал отдаёт
// `8000-8FFF` всегда. Приоритет РОВНО ОБРАТНЫЙ: по IEEE 1364 битовое `|`
// стоит выше логического `&&` (проверено в симуляции). В ЭТОЙ строке
// расхождения нет.

`default_nettype none

module kvaz_sram #(
    parameter [7:0] PORT_KVAZ = 8'h10
) (
    input  wire       clk,
    input  wire       reset,

    // шина
    input  wire [7:0] port,          // адрес ввода-вывода, прямой
    input  wire [7:0] addr_hi,       // старший байт адреса памяти, A15..A8
    input  wire [7:0] data_in,       // шина данных от процессора
    input  wire       iowr_reg,      // импульс записи в порт, один такт (vu_bus)
    input  wire       stack,         // признак стекового обращения

    // СЫРЫЕ стробы памяти, только для опыта с квалификацией выбора кристалла.
    // Сырые нарочно: очищенные `memrd`/`memwr` отстают на два такта, а для
    // выбора кристалла это вечность.
    input  wire       chtzu_n,
    input  wire       zpzu_n,
    input  wire       cas_n,         // ~CAS: метит НАСТОЯЩИЕ циклы данных
    input  wire       ce_gate,       // 1 = квалифицировать выбор кристалла
    input  wire       ce_by_cas,     // 1 = квалифицировать по ~CAS, 0 = по стробам

    // наружу
    output wire [1:0] page,          // страница -> старшие адреса ОЗУ
    output wire       blk_n,         // /БЛК на шину и /CE на ОЗУ

    // ПОЧЕМУ ОТДЕЛЬНО ПО ОКНАМ. Пока окно открыто, память системы в этой
    // области — это НАШЕ ОЗУ, и любая шаткость платы портит саму MicroDOS.
    // Значит первый вопрос отладки: не претендуем ли мы на память, на которую
    // не должны. Три признака наружу, чтобы наверху их посчитать:
    output wire       hit_std,       // ответили в штатном окне A000-DFFF
    output wire       hit_bar,       // ответили в окнах Баркаря 8000-9FFF/E000-FFFF
    output wire       hit_stack,     // ответили по стековому обращению
    output wire [7:0] control        // для отладки и чтения состояния
);

reg [7:0] control_reg;

always @(posedge clk) begin
    if (reset)
        control_reg <= 8'h00;
    else if (iowr_reg && port == PORT_KVAZ)
        control_reg <= data_in;
end

wire [1:0] cr_ram_page   = control_reg[1:0];
wire [1:0] cr_stack_page = control_reg[3:2];
wire       cr_stack_on   = control_reg[4];
wire       cr_ram_on     = control_reg[5];
wire       cr_win_8      = control_reg[6];
wire       cr_win_e      = control_reg[7];

wire [3:0] adsel = addr_hi[7:4];

// У КАЖДОЙ ОБЛАСТИ СВОЙ РАЗРЯД, И РАЗРЯД 5 НЕ ОТКРЫВАЕТ ЧУЖИЕ. Подробности и
// авторские названия разрядов — в шапке файла.
//
// Эталонная таблица теста `kdadrtst` (И. Городецкий, 2018,
// `caglrc.cc/scalar/ware/918`). Три знака — области `8000-9FFF`, `A000-DFFF`,
// `E000-FFFF`, строка — значение регистра:
//
//     20  -+-      40  +--      60  ++-      80  --+
//     A0  -++      C0  +-+      E0  +++
//
// Ровно таблица истинности трёх независимых разрядов: 6, 5, 7. Сходится с
// примером самого Баркаря: `10110011B` — «обращение к ОЗУ 0A000H...0FFFFH»,
// то есть разряды 7 и 5 при сброшенном 6, строка `A0`.
wire win_std   = ((adsel == 4'hA) | (adsel == 4'hB)
                | (adsel == 4'hC) | (adsel == 4'hD)) & cr_ram_on;
wire win_bar_8 = ((adsel == 4'h8) | (adsel == 4'h9)) & cr_win_8;
wire win_bar_e = ((adsel == 4'hE) | (adsel == 4'hF)) & cr_win_e;

wire ram_sel   = win_std | win_bar_8 | win_bar_e;
wire stack_sel = cr_stack_on & stack;

// КВАЛИФИКАЦИЯ ВЫБОРА КРИСТАЛЛА СТРОБОМ, опыт.
//
// Без неё `/CE` прижат всё время, пока `~ШАВВ` показывает адрес в окне, — в
// том числе в циклах регенерации экрана. Если `A0..A7` микросхемы ОЗУ идут с
// `~ШАП` ЖИВЬЁМ, без защёлки столбца, то внутри строба чтения процессора
// чужой видеоцикл уводит СТОЛБЕЦ адреса немедленно, и ОЗУ выкладывает байт
// не оттуда.
//
// Заморозка защёлки бережёт только СТРОКУ и ошибок в такой схеме не убрала —
// 8,4% против базовых 10-13. Значит порча приходит из
// младшей половины, а её защитить можно только тем, чтобы кристалл на чужие
// циклы вообще не отзывался.
//
// ЧЕМ ОПАСНО. `blk_n` — это одновременно `~БЛК` машине, и он обязан прийти
// раньше её собственного `/CAS`. `~ЧТЗУ` иногда приходит позже.
// Тогда машина успеет ответить сама, и квазидиск отвалится целиком. Отказ
// будет громкий и мгновенный, поэтому опыт переключаемый и по умолчанию
// выключен.
// ЧЕМ КВАЛИФИЦИРОВАТЬ. Замер:
//
//   фаза строба относительно ~RAS   40..560 нс, разброс в 14 раз
//   спадов ~RAS между спадами ~CAS  2..255, единицы нет ни разу
//   спадов ~CAS внутри чтения       1 (при двух лишних спадах ~RAS)
//
// То есть строб для этого не годится — он приходит когда попало и держится
// долго; квалификация по нему уже пробована и ухудшила стековые пары вдвое,
// потому что `~БЛК` к машине опаздывал. А `~CAS` метит строго подмножество
// циклов, приходит раньше строба и короче его (380 нс).
wire strobe   = ce_by_cas ? ~cas_n : (~chtzu_n | ~zpzu_n);
assign blk_n   = ~((ram_sel | stack_sel) & (strobe | ~ce_gate));

// Признаки «кто именно заставил нас ответить». Стековое обращение перебивает
// адресное, поэтому у него отдельный признак, а адресные считаются только
// когда стека нет: иначе одно обращение попало бы в два счётчика.
// `win_*` уже включают в себя свои биты разрешения, поэтому лишнего `ram_sel`
// в этих трёх строках нет: он бы только маскировал ошибку, если окно
// когда-нибудь разойдётся со своим битом.
assign hit_stack = stack_sel;
assign hit_std   = win_std & ~stack_sel;
assign hit_bar   = (win_bar_8 | win_bar_e) & ~stack_sel;
assign page    = stack_sel ? cr_stack_page : cr_ram_page;
assign control = control_reg;

endmodule

`default_nettype wire
