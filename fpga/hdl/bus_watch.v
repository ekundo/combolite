// Наблюдатель за шиной: считает аномалии на СТЕК и ~RAS.
//
// ЗАЧЕМ. По замерам на разъёме единица `СТЕК` = 3,64 В при гарантированном
// пороге транслятора `VCCI x 0,7` = 3,30…3,47 В, и линия звенит на вольт.
// Осциллограф видит только то, что попало в его окно захвата, а окно это
// меньше процента реального времени. Здесь смотрит сама ПЛИС — тем самым
// приёмником, чьё мнение и решает, и без слепого времени вовсе.
//
// ПОЧЕМУ ЗДЕСЬ ДВА НАБОРА ЧИСЕЛ. Простые счётчики пересечений порога
// (`СТЕК` сменился внутри обращения, импульс на `~RAS` короче 160 нс) на
// живой машине насыщаются — `~RAS` быстрее, чем успевает пройти один запрос
// по SPI. Уликой это не служит: у обоих счётчиков есть механизм ложного
// срабатывания, и он объясняет ровно такую картину:
//
//   `СТЕК` и `~ЧТЗУ` идут каждый через свою пару синхронизаторов, и порядок
//   их появления внутри может отличаться от порядка на выводах. В НАЧАЛЕ
//   обращения это безобидно: статус 8080 защёлкивается в начале машинного
//   цикла, задолго до строба памяти. А вот в КОНЦЕ — нет: статус следующего
//   цикла выставляется, пока текущий строб ещё не снят, и на сетке в 20 нс
//   порядок «сменился СТЕК» и «снялся строб» плавает. Частота таких
//   перестановок задаётся биениями двух независимых генераторов — единицы
//   событий в секунду, что и наблюдалось.
//
//   Порог 160 нс на `~RAS` брался из соображения «честные уровни держатся
//   сотнями наносекунд». Для НИЗКОГО уровня это верно и измерено. Про паузу
//   МЕЖДУ циклами регенерации экрана не измерено ничего, а считаются оба.
//
// Поэтому рядом с простыми счётчиками стоят два измерения, которые не
// зависят ни от какого угаданного порога:
//
//   ras_lo_min / ras_hi_min  самый короткий уровень `~RAS`, который вообще
//                 наблюдался, в тактах 50 МГц. Не «больше или меньше порога»,
//                 а число. Если минимум высокого уровня окажется, скажем, 6
//                 тактов при периоде цикла в 25, значит 160 нс просто не тот
//                 порог, и говорить не о чем. Если там 2-3 такта при обычных
//                 12 — вот это уже глитч.
//
//   stk_late      то же, что stk_unstable, но устойчиво к перестановке на
//                 краях. Опорное значение снимается через SETTLE тактов после
//                 фронта строба, а расхождение засчитывается, только если оно
//                 продержалось два такта ПОКА СТРОБ ЕЩЁ АКТИВЕН. Первое
//                 закрывает начало обращения, второе — конец: смена за такт до
//                 снятия строба даёт единственный такт расхождения и не
//                 считается. Если stk_unstable насыщен, а stk_late ноль —
//                 вопрос закрыт, виноват был наблюдатель.
//
// ЧТО СЧИТАЕМ (простые счётчики, для сравнения):
//
//   stk_unstable  `СТЕК` сменил состояние ВНУТРИ обращения к памяти. Именно
//                 это делает `~БЛК` неверным на полпути: часть цикла ОЗУ платы
//                 выбрано, часть — нет.
//
//   ras_glitch    импульс на `~RAS` короче порога, в любую сторону. Короткий
//                 ноль — двойное пересечение на спаде; короткая единица —
//                 лишний фронт посреди цикла, то есть лишний такт защёлки
//                 адреса строки, и `A15..A8` берутся в фазе столбца.
//
// ПОЧЕМУ ОКНО ПО СТРОБУ ПАМЯТИ, А НЕ ПО `~RAS`. Регенерацию экрана «Вектор»
// гонит своими циклами `~RAS`, а статус процессора к ним не привязан: `СТЕК`
// вполне законно меняется между обращениями процессора, и внутри «чужого»
// цикла `~RAS` это выглядело бы глитчем. `~ЧТЗУ`/`~ЗПЗУ` — сигналы обращения
// процессора, и ровно на их протяжении `~БЛК` должен быть верным.
//
// Насыщение на 255: нужен не точный счёт, а «ноль или не ноль» и порядок
// величины. Как у счётчиков окон в top.v. Минимумы, наоборот, ползут ВНИЗ от
// 255, и 255 читается как «ни одного законченного уровня не видели».
//
// Сброс по `clr` — чтобы мерить заданный отрезок (например, минуту теста), не
// дёргая питание. Без него насыщенный счётчик бесполезен: он говорит только
// «за всё время с включения хоть раз было».

`default_nettype none

module bus_watch #(
    // Порог узкого импульса в тактах 50 МГц для простого счётчика ras_glitch.
    parameter NARROW = 8,
    // Сколько тактов дать статусу установиться после фронта строба, прежде
    // чем снимать опорное значение СТЕК. Три такта = 60 нс: втрое больше
    // возможного расхождения синхронизаторов в один такт.
    parameter SETTLE = 3
) (
    input  wire       clk,
    input  wire       por,
    input  wire       clr,        // обнулить счётчики, минимумы вернуть в 255

    // Сырые выводы с трансляторов. Синхронизация внутри: без неё
    // метастабильность сама добавляла бы ложные срабатывания, а мы здесь
    // именно редкие срабатывания и считаем.
    input  wire       ras_n,
    input  wire       cas_n,          // ~CAS
    input  wire       stack,
    input  wire       chtzu_n,
    input  wire       zpzu_n,

    // НАШЕ ОКНО АДРЕСУЕТСЯ: `ram_sel | stack_sel` из `kvaz_sram`, собранное в
    // `top.v` как `hit_std | hit_bar | hit_stack`.
    //
    // ЗАЧЕМ. Без этого входа `chtzu_n` здесь был бы сырым стробом с разъёма,
    // то есть ЛЮБЫМ чтением «Вектора», включая выборку команд из его
    // собственного ОЗУ. Все измерения строба набирали бы свои максимумы за доли
    // секунды на фоне машины и про обращения ПЛАТЫ не говорили бы ничего.
    //
    // Сигнал КОМБИНАЦИОННЫЙ и следует за адресом, поэтому он снимается один
    // раз на спаде строба и дальше держится: если квалифицировать им каждый
    // такт, измерение обрывалось бы ровно в тот момент, который мы и ловим —
    // когда чужой цикл уводит адрес из окна.
    input  wire       sel,

    // ~ШАВВ: в фазе памяти это A15..A8. Из НЕГО собирается `blk_n`, то есть
    // выбор кристалла ОЗУ платы.
    //
    // ВНИМАНИЕ: это НЕ адрес строки, который берёт защёлка 574. Входы D
    // защёлки — `AP0..AP7`, то есть `~ШАП`. О запасе защёлки по этим числам
    // судить нельзя.
    input  wire [7:0] shavv_n,

    output reg  [7:0] stk_unstable,
    output reg  [7:0] ras_glitch,
    output reg  [7:0] stk_late,
    output reg  [7:0] ras_lo_min,
    output reg  [7:0] ras_hi_min,
    output reg  [7:0] adr_setup_min,
    output reg  [7:0] adr_hold_min,

    // Сколько спадов ~RAS укладывается ВНУТРИ одного активного строба, сверх
    // того, с которым строб начался. Это решающее число.
    //
    // Защёлка 574 тактируется `~ras_n` безусловно, а `/OE` микросхемы ОЗУ —
    // это `~ЧТЗУ` прямо с машины, мимо ПЛИС. Если внутри одного чтения
    // случается лишний спад ~RAS, защёлка берёт адрес чужого цикла (регенерации
    // экрана), пока выбор кристалла и разрешение выхода ещё активны, и ОЗУ
    // выкладывает на шину байт по чужому адресу.
    //
    // Единица здесь — версия мертва. Двойка и больше — подтверждена.
    //
    // Замеры: ~ЧТЗУ 30/650/1330 нс, цикл ~RAS 480 нс. По этим числам
    // ожидается 2-4 у чтения и ноль у
    // записи: ~ЗПЗУ 160-200 нс лишнего цикла не вмещает.
    output reg  [7:0] rd_ras_max,
    output reg  [7:0] wr_ras_max,
    output reg  [7:0] rd_len_max,     // длительность ~ЧТЗУ, тактов
    // МИНИМУМЫ по НАШИМ чтениям. Без них максимум ничего не разделяет:
    // `rd_len_min == rd_len_max` означало бы, что все наши чтения одной
    // длины, то есть версия «у пары строб длинный» неверна. А `rd_cas_min`
    // отличает «~CAS сопровождает каждое наше чтение» (min = max = 1, есть
    // за что зацепиться такту второй защёлки) от «когда как» (min = 0).
    output reg  [7:0] rd_len_min,
    output reg  [7:0] rd_cas_min,

    // ФАЗА СТРОБА ОТНОСИТЕЛЬНО ЦИКЛОВ ШИНЫ.
    //
    // Вопрос: можно ли средствами платы отличить процессорный цикл от
    // видеоцикла. И квалификация выбора стробом, и заморозка защёлки упираются
    // именно в это.
    //
    // Если строб приходит в УСТОЙЧИВОЙ фазе относительно своего цикла ~RAS,
    // момент захвата вычислим и правка проектируется. Если разброс большой —
    // пассивной защёлкой не лечится вовсе.
    output reg  [7:0] ras_to_rd_min,  // тактов от спада ~RAS до начала ~ЧТЗУ
    output reg  [7:0] ras_to_rd_max,
    output reg  [7:0] rd_cas_max      // спадов ~CAS внутри строба чтения
);

reg [1:0] ras_sync, stk_sync, rd_sync, wr_sync, cas_sync;
wire cas_s = cas_sync[1];
reg  cas_d;
reg [7:0] since_ras;    // тактов с последнего спада ~RAS
reg [7:0] cas_edges;    // спадов ~CAS внутри текущего строба чтения
// Различитель видео/процессор -- в vid_phase.v: он там и меряет, и работает,
// а держать две копии классификатора незачем.
reg [7:0] adr_sync0, adr_sync1;
wire [7:0] adr_s = adr_sync1;
reg [7:0] adr_d;
reg [7:0] adr_stable;                        // тактов адрес не менялся
reg [7:0] row_latched;                       // что взяла защёлка
reg [7:0] hold_cnt;
reg       in_hold;
wire ras_s = ras_sync[1];
wire stk_s = stk_sync[1];
wire mem_s = ~rd_sync[1] | ~wr_sync[1];     // идёт обращение процессора к памяти

reg       ras_d, mem_d;
reg       stk_at_acc;                        // СТЕК на фронте строба
reg       acc_counted;                       // в этом обращении уже засчитали
reg [7:0] dur;                               // тактов держится текущий ~RAS

// строгая проверка СТЕК
reg [3:0] acc_age;                           // тактов с начала обращения
reg       stk_ref;                           // СТЕК, снятый после установления
reg       ref_taken;
reg [1:0] diff_run;                          // тактов держится расхождение
reg       late_counted;

localparam [7:0] DUR_MAX = 8'hFF;

// счётчики чужих циклов внутри строба
reg       rd_d, wr_d;
reg [7:0] rd_edges, wr_edges, rd_len;
// «строб наш»: снято на спаде, держится до конца строба
reg [1:0] sel_sync;
wire      sel_s = sel_sync[1];
reg       rd_mine, wr_mine;
localparam [3:0] AGE_MAX = 4'hF;

always @(posedge clk) begin
    if (por | clr) begin
        ras_sync     <= 2'b11;
        stk_sync     <= 2'b00;
        rd_sync      <= 2'b11;
        wr_sync      <= 2'b11;
        ras_d        <= 1'b1;
        mem_d        <= 1'b0;
        stk_at_acc   <= 1'b0;
        acc_counted  <= 1'b1;                // до первого честного строба молчим
        dur          <= DUR_MAX;             // и первый переход узким не считаем
        acc_age      <= AGE_MAX;
        stk_ref      <= 1'b0;
        ref_taken    <= 1'b0;
        diff_run     <= 2'd0;
        late_counted <= 1'b1;
        adr_sync0    <= 8'hFF;
        adr_sync1    <= 8'hFF;
        adr_d        <= 8'hFF;
        adr_stable   <= DUR_MAX;
        row_latched  <= 8'hFF;
        hold_cnt     <= 8'h00;
        in_hold      <= 1'b0;
        stk_unstable <= 8'h00;
        ras_glitch   <= 8'h00;
        stk_late     <= 8'h00;
        ras_lo_min   <= 8'hFF;
        ras_hi_min   <= 8'hFF;
        adr_setup_min <= 8'hFF;
        adr_hold_min  <= 8'hFF;
        rd_d          <= 1'b1;
        wr_d          <= 1'b1;
        sel_sync      <= 2'b00;
        rd_mine       <= 1'b0;
        wr_mine       <= 1'b0;
        rd_edges      <= 8'h00;
        wr_edges      <= 8'h00;
        rd_len        <= 8'h00;
        rd_ras_max    <= 8'h00;
        wr_ras_max    <= 8'h00;
        rd_len_max    <= 8'h00;
        rd_len_min    <= 8'hFF;
        rd_cas_min    <= 8'hFF;
        cas_sync      <= 2'b11;
        cas_d         <= 1'b1;
        since_ras     <= DUR_MAX;
        cas_edges     <= 8'h00;
        ras_to_rd_min <= 8'hFF;
        ras_to_rd_max <= 8'h00;
        rd_cas_max    <= 8'h00;
    end
    else begin
        ras_sync <= {ras_sync[0], ras_n};
        sel_sync <= {sel_sync[0], sel};
        stk_sync <= {stk_sync[0], stack};
        rd_sync  <= {rd_sync[0],  chtzu_n};
        wr_sync  <= {wr_sync[0],  zpzu_n};
        ras_d    <= ras_s;
        mem_d    <= mem_s;

        // --- длительность текущего уровня ~RAS
        if (ras_s != ras_d)
            dur <= 8'd1;
        else if (dur != DUR_MAX)
            dur <= dur + 1'b1;

        // Уровень, который только что кончился, держался `dur` тактов: значение
        // ещё старое, потому что присваивание выше неблокирующее.
        if (ras_s != ras_d) begin
            if ((dur < NARROW) && (ras_glitch != 8'hFF))
                ras_glitch <= ras_glitch + 1'b1;
            // ras_d — уровень, который закончился
            if (ras_d) begin
                if (dur < ras_hi_min) ras_hi_min <= dur;
            end
            else begin
                if (dur < ras_lo_min) ras_lo_min <= dur;
            end
        end

        // --- ~ШАВВ вокруг спада ~RAS
        //
        // Это НЕ про защёлку адреса строки (см. оговорку у порта shavv_n), а
        // про то, насколько устойчив вход, из которого комбинационно собран
        // выбор кристалла `blk_n`:
        //
        //   adr_setup_min  сколько тактов ~ШАВВ стоял к моменту спада ~RAS;
        //   adr_hold_min   сколько тактов продержался после него.
        adr_sync0 <= shavv_n;
        adr_sync1 <= adr_sync0;
        adr_d     <= adr_s;

        if (adr_s != adr_d)
            adr_stable <= 8'd1;
        else if (adr_stable != DUR_MAX)
            adr_stable <= adr_stable + 1'b1;

        if (ras_d & ~ras_s) begin
            // спад ~RAS: защёлка закрылась
            if (adr_stable < adr_setup_min)
                adr_setup_min <= adr_stable;
            row_latched <= adr_s;
            hold_cnt    <= 8'd0;
            in_hold     <= 1'b1;
        end
        else if (in_hold) begin
            if (adr_s != row_latched) begin
                in_hold <= 1'b0;
                if (hold_cnt < adr_hold_min)
                    adr_hold_min <= hold_cnt;
            end
            else if (hold_cnt != DUR_MAX)
                hold_cnt <= hold_cnt + 1'b1;
        end

        // --- фаза строба относительно циклов шины
        cas_sync <= {cas_sync[0], cas_n};
        cas_d    <= cas_s;

        // сколько тактов прошло с последнего спада каждого сигнала
        if (ras_d & ~ras_s)      since_ras <= 8'd0;
        else if (since_ras != DUR_MAX) since_ras <= since_ras + 1'b1;

        if (rd_d & ~rd_sync[1]) begin           // строб чтения НАЧАЛСЯ
            rd_mine <= sel_s;                   // наш он или машины — решаем ЗДЕСЬ
            if (sel_s) begin
                if (since_ras < ras_to_rd_min) ras_to_rd_min <= since_ras;
                if (since_ras > ras_to_rd_max) ras_to_rd_max <= since_ras;
            end
            cas_edges <= 8'd0;
        end
        else if (~rd_sync[1]) begin             // строб активен
            if ((cas_d & ~cas_s) && (cas_edges != DUR_MAX))
                cas_edges <= cas_edges + 1'b1;
        end
        else if (~rd_d & rd_sync[1]) begin      // строб КОНЧИЛСЯ
            if (rd_mine) begin                  // накапливаем всегда, СЧИТАЕМ своё
                if (cas_edges > rd_cas_max)     rd_cas_max     <= cas_edges;
                if (cas_edges < rd_cas_min)     rd_cas_min     <= cas_edges;
            end
        end

        // --- чужие циклы ~RAS внутри активного строба
        rd_d <= rd_sync[1];
        wr_d <= wr_sync[1];

        if (rd_d & ~rd_sync[1]) begin           // строб чтения начался
            rd_edges <= 8'd0;
            rd_len   <= 8'd0;
        end
        else if (~rd_sync[1]) begin             // строб активен
            if (rd_len != DUR_MAX) rd_len <= rd_len + 1'b1;
            if ((ras_d & ~ras_s) && (rd_edges != DUR_MAX))
                rd_edges <= rd_edges + 1'b1;
        end
        else if (~rd_d & rd_sync[1]) begin      // строб кончился
            if (rd_mine) begin
                if (rd_edges > rd_ras_max) rd_ras_max <= rd_edges;
                if (rd_len   > rd_len_max) rd_len_max <= rd_len;
                if (rd_len   < rd_len_min) rd_len_min <= rd_len;
            end
        end

        if (wr_d & ~wr_sync[1]) begin
            wr_mine  <= sel_s;
            wr_edges <= 8'd0;
        end
        else if (~wr_sync[1]) begin
            if ((ras_d & ~ras_s) && (wr_edges != DUR_MAX))
                wr_edges <= wr_edges + 1'b1;
        end
        else if (~wr_d & wr_sync[1]) begin
            if (wr_mine && (wr_edges > wr_ras_max)) wr_ras_max <= wr_edges;
        end

        // --- СТЕК обязан стоять всё обращение (наивная проверка)
        if (mem_s & ~mem_d) begin
            stk_at_acc  <= stk_s;
            acc_counted <= 1'b0;
        end
        else if (mem_s & ~acc_counted & (stk_s != stk_at_acc)) begin
            acc_counted <= 1'b1;
            if (stk_unstable != 8'hFF)
                stk_unstable <= stk_unstable + 1'b1;
        end

        // --- то же самое, но с окном установления и выдержкой
        if (mem_s & ~mem_d) begin
            acc_age      <= 4'd0;
            ref_taken    <= 1'b0;
            diff_run     <= 2'd0;
            late_counted <= 1'b0;
        end
        else if (mem_s) begin
            if (acc_age != AGE_MAX)
                acc_age <= acc_age + 1'b1;

            if (~ref_taken) begin
                if (acc_age >= SETTLE) begin
                    stk_ref   <= stk_s;
                    ref_taken <= 1'b1;
                end
            end
            else if (stk_s != stk_ref) begin
                if (diff_run != 2'd3)
                    diff_run <= diff_run + 1'b1;
                // расхождение продержалось два такта подряд — это не разрез
                // синхронизатора, а настоящая смена уровня
                if ((diff_run == 2'd1) & ~late_counted) begin
                    late_counted <= 1'b1;
                    if (stk_late != 8'hFF)
                        stk_late <= stk_late + 1'b1;
                end
            end
            else
                diff_run <= 2'd0;
        end
    end
end

endmodule

`default_nettype wire
