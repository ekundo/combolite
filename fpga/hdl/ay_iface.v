// Обвязка ядра AY: декодирование портов, разрешение такта и шина управления.
//
// Ядро — ym2149.vhd из svofski/vector06c-lesshadoks. Его обвязка ayglue.v взята
// НЕ была, по двум причинам:
//
//   1. Там `always begin case ... end` без списка чувствительности и без
//      задержки. Quartus это синтезирует, а симулятор зависает в нулевом
//      времени, поэтому проверить такую обвязку нельзя.
//   2. Выход `odataoe` объявлен, но нигде не присваивается — висит в воздухе.
//      Разрешение выдачи на шину здесь формируется своим декодированием.
//
// ОТЛИЧИЕ ПО СТРОБАМ. У svofski `wren` — импульс в один такт от фронта строба.
// Здесь `BDIR` и `BC1` держатся ВСЁ время обращения, как их видит настоящий AY
// на настоящей шине: строб «Вектора» длится сотни наносекунд, то есть много
// периодов разрешения, и однотактный импульс ядро может не заметить.
// Многократная защёлка адреса или повторная запись того же данного безвредны.
//
// ПОРТЫ. 0x14 — данные, 0x15 — регистр адреса. Подтверждено первоисточником:
// в svofski/vector06c-lesshadoks, quartus/src/ay/ayglue.v, это записано в
// объявлении — «port 14 (00) = data; port 15 (01) = address», — и следует из
// логики: при address = 1 идёт запись регистра адреса. Сам address там берётся
// как shavv[0], то есть младший разряд адреса ввода-вывода: у 0x14 он нулевой,
// у 0x15 единичный. Сходится в обе стороны.
//
// ТАКТ. AY требует ровно 1,75 МГц — 14 МГц, делённые на 8. Нацело системным
// тактом он не делится,
// поэтому разрешение формируется ДРОБНЫМ делителем: накопитель по модулю CE_DEN
// с шагом CE_NUM даёт ровно CE_NUM разрешений на каждые CE_DEN тактов. При
// 50 МГц это 7 на 200, то есть в среднем 1,750000 МГц ТОЧНО.
//
// Почему так, а не делением нацело от 56 МГц (ФАПЧ из 14 МГц): ровных 14,000 МГц
// на 3,3 В в продаже искать, распространена 14,31818 МГц, которая дала бы AY
// 1,79 МГц — 2,3 процента мимо. А 50,000 МГц есть везде, и с дробным
// делителем AY своя ФАПЧ не нужна.
//
// ЧЕМ ПЛАТИМ. Интервалы между разрешениями не равны: при 50 МГц они чередуются
// между 28 и 29 тактами, то есть дрожание одного системного такта, 20 нс. На
// высоту тона это не влияет: внутренние счётчики AY считают ИМПУЛЬСЫ разрешения,
// а их среднее число точно, и период тона в 16 x N импульсов выдерживается с
// точностью до одного такта на весь период. Тот же приём уже работает в звуке
// (audio.v), там его точность проверена побитово.

`default_nettype none

module ay_iface #(parameter CE_NUM = 7, parameter CE_DEN = 200,
                  parameter AY_PORTS = 1) (
    input  wire       clk,
    input  wire       reset,

    input  wire [7:0] port,        // адрес ввода-вывода, прямой
    input  wire       iord,        // активные высокие, уровнем
    input  wire       iowr,
    input  wire [7:0] din,         // от процессора
    output wire [7:0] dout,        // процессору
    output wire       dout_oe,     // разрешение выдачи на ШД

    output wire [7:0] ch_a,        // в микшер
    output wire [7:0] ch_b,
    output wire [7:0] ch_c
);

// ---------------------------------------------------------- декодирование
wire ay_sel  = (port[7:1] == 7'b0001010);   // 0x14 и 0x15
wire ay_addr = port[0];                     // 1 = 0x15 = регистр адреса

wire ay_wr = ay_sel & iowr;
wire ay_rd = ay_sel & iord;

wire ay_bdir = ay_wr;
wire ay_bc1  = (ay_wr & ay_addr) | (ay_rd & ~ay_addr);

assign dout_oe = ay_rd & ~ay_addr;          // читается только 0x14

// ----------------------------------------------------------------- такт
// Дробный делитель по модулю CE_DEN. Накопитель нарастает на CE_NUM, и когда
// переваливает через CE_DEN, выдаётся разрешение и вычитается CE_DEN. За любые
// CE_DEN тактов разрешений ровно CE_NUM, независимо от начального остатка.
localparam ACC_W = $clog2(CE_DEN) + 1;
reg [ACC_W-1:0] ce_acc;
reg             ay_ce;

always @(posedge clk) begin
    if (reset) begin
        ce_acc <= {ACC_W{1'b0}};
        ay_ce  <= 1'b0;
    end
    else if (ce_acc + CE_NUM >= CE_DEN) begin
        ce_acc <= ce_acc + CE_NUM - CE_DEN;
        ay_ce  <= 1'b1;
    end
    else begin
        ce_acc <= ce_acc + CE_NUM;
        ay_ce  <= 1'b0;
    end
end

// ------------------------------------------------------------------ ядро
// По умолчанию — настоящее ядро, переведённое в Verilog (ym2149.v,
// происхождение в шапке файла).
//
// Заглушка осталась под ключом USE_AY_STUB: она короче и удобна, когда надо
// проверить обвязку, а не звук.
`ifndef USE_AY_STUB
ym2149 #(.HAS_PORTS(AY_PORTS)) core (
    .CLK   (clk),
    .ENA   (ay_ce),
    .RESET (reset),
    .CS    (1'b1),
    .BDIR  (ay_bdir),
    .BC    (ay_bc1),
    .DI    (din),
    .DO    (dout),
    .OUT_A (ch_a),
    .OUT_B (ch_b),
    .OUT_C (ch_c)
);
`else
// Заглушка: тот же протокол шины, без звукогенерации.
ay_stub core (
    .clk(clk), .ce(ay_ce), .reset(reset),
    .bdir(ay_bdir), .bc1(ay_bc1),
    .di(din), .q(dout),
    .out_a(ch_a), .out_b(ch_b), .out_c(ch_c)
);
`endif

endmodule

// --------------------------------------------------------------- заглушка AY
// Повторяет только протокол шины AY: защёлка адреса, запись и чтение данного.
// Громкости отдаются наружу как есть, чтобы был виден путь до микшера.
// Звукогенерация не моделируется — она проверяется только в железе.
//
// Объявление закрыто тем же ключом, что и создание. Иначе модуль существует
// всегда, никем не создаётся, и в иерархии Diamond появляется вторым корнем
// рядом с верхним уровнем — а там, где корней два, «какой из них верхний уровень»
// становится вопросом, и ответ на него зависит от настройки проекта.
`ifdef USE_AY_STUB
module ay_stub (
    input  wire       clk,
    input  wire       ce,
    input  wire       reset,
    input  wire       bdir,
    input  wire       bc1,
    input  wire [7:0] di,
    output wire [7:0] q,
    output wire [7:0] out_a,
    output wire [7:0] out_b,
    output wire [7:0] out_c
);

reg [7:0] regs [0:15];
reg [3:0] addr;

integer i;
always @(posedge clk) begin
    if (reset) begin
        addr <= 4'd0;
        for (i = 0; i < 16; i = i + 1) regs[i] <= 8'h00;
    end
    else begin
        if (bdir & bc1)                     // защёлка адреса
            addr <= di[3:0];
        else if (bdir & ~bc1)               // запись данного
            regs[addr] <= di;
    end
end

assign q = regs[addr];

// Регистры 8, 9, 10 — громкости каналов A, B, C
assign out_a = {regs[8][3:0],  4'b0000};
assign out_b = {regs[9][3:0],  4'b0000};
assign out_c = {regs[10][3:0], 4'b0000};

endmodule
`endif

`default_nettype wire
