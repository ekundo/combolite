// Где сейчас луч машины: номер строки и место в строке -- по видеоциклам.
//
// ЗАЧЕМ. Журнал палитры (vid_rec.v) кладёт каждую запись в порт под своей
// строкой машины и местом в ней, иначе мультиколор не воспроизвести. Своего
// растра у платы нет -- его надо снять с шины.
//
// СЧЁТ -- ПО ВИДЕОЦИКЛАМ. Растровая фаза подтверждена замером: за кадр ровно
// 14976 видеоциклов, 48 на строку, 312 строк. Видеоцикл от процессорного
// отличает vid_phase.v (спад ~RAS в его окне при захвате); здесь их считают: 48 -- строка, 312 строк -- кадр.
// Место в строке -- номер видеоцикла и четверть его периода (видеоцикл --
// четыре такта процессора, 1320 нс = 66 тактов 50 МГц): 192 места, по одному
// на такт процессора.
//
// ОПОРА -- АДРЕС ВИДЕОЦИКЛА НА ~ШАП (по схеме машины). В видеоцикле
// мультиплексор адреса (555КП2, D11..D14, входы 0 и 1) выводит на ~ШАП счётчики
// видеотракта:
//     строка:  ~ШАП0..4 -- колонка V (V1..V5, 555ИЕ5 D4, D5), ~ШАП5, 6 -- S0, S1
//     столбец: ~ШАП0..5 -- S2..S7
// S -- строка памяти, восьмиразрядный РЕВЕРСИВНЫЙ счётчик D24:D25 (555ИЕ7):
// загружается из порта A (прокрутка) по ~ZXX_WVA раз в кадр и убывает на
// каждой строке. Отсюда две опоры, обе точнее INTA:
//   * по горизонтали -- переход колонки V с 0 на 1: видеоцикл колонки 0 --
//     это CYC_COL0 нашего счёта. На ~ШАП только пять младших разрядов
//     колонки, шестой (V6, «S32») остаётся внутри -- по нему убывает S. При 48
//     видеоциклах в строке колонка на ~ШАП идёт 0..31, потом 0..15, и переход
//     0 -> 1 бывает дважды; начало строки -- тот, перед которым было V_PRE
//     (по умолчанию 15). Это допущение о счётчике, проверяется калибровкой;
//   * по вертикали -- ЗАГРУЗКА счётчика: разрыв в убывании S. После RUN_OK
//     строк подряд с убыванием на единицу строка загрузки -- это MARK_LINE, а
//     значение S в ней -- прокрутка ровно такой, какой её взяла машина
//     (scroll_hw), без догадок о том, что порт A общий с клавиатурой.
//     СТРОКУ ставит только ДЛИННЫЙ ряд, RUN_LONG строк: в обратном ходе кадра
//     S не стоит, а ходит кругами по восемь строк -- 255, 254 .. 248, снова
//     255, -- и между кругами ещё по девять строк держится 255 (журнал портов
//     на живой машине). Ряд в четыре строки набирается в каждом круге: опора
//     срабатывала бы до пяти раз за кадр, счёт прыгал бы, и строки выпадали бы
//     из журнала палитры. Длиннее семи строк ряд бывает только в картинке.
//     Прокрутку берёт короткий ряд (RUN_OK): круг начинается с того же
//     значения порта A, и выборка узнаёт её без ожидания длинного ряда.
// Строку берут сразу после спада ~RAS видеоцикла (держится 100 нс), столбец --
// через COL_DLY тактов, 140-180 нс: ~CAS в видеоцикле на разъём не выходит, и
// момент берётся по времени, как у зеркала (mirror.v).
//
// INTA -- ЗАПАСНАЯ ОПОРА. Прерывание кадра приходит в известном месте растра,
// и процессор отвечает циклом INTA (D0 слова состояния под СТРОБ СОСТ.). Но
// ответ ждёт конца текущей команды -- до 18 тактов, четыре с половиной
// видеоцикла дрожания. Поэтому INTA ставит счёт, только пока опоры по адресу
// нет (опора пропала дольше чем на два кадра).
//
// ЧИСЛА MARK_LINE, CYC_COL0, INT_LINE, INT_CYC -- ПАРАМЕТРЫ, калибровать на
// живой машине: где в нашем счёте загрузка S, колонка 0, прерывание. Для этого
// наружу выведены последние поправки (slip_v, slip_h) и что было на ~ШАП
// (last_v, last_s): при верных числах поправки нулевые.
`default_nettype none

module vid_raster #(
    parameter [8:0] INT_LINE   = 9'd0,
    parameter [5:0] INT_CYC    = 6'd0,
    parameter [8:0] FRAME_LINE = 9'd40,  // здесь машина читает прокрутку (порт A)
    parameter [8:0] MARK_LINE  = 9'd40,  // строка загрузки счётчика S
    parameter [5:0] CYC_COL0   = 6'd8,   // видеоцикл колонки 0 в нашем счёте
    parameter [3:0] RUN_OK     = 4'd4,   // строк убывания S до прокрутки
    parameter [3:0] RUN_LONG   = 4'd12,  // строк убывания S до опоры строки
    parameter [4:0] V_PRE      = 5'd15,  // колонка перед нулём в начале строки
    parameter [3:0] COL_DLY    = 4'd6
) (
    input  wire       clk,
    input  wire       reset,
    input  wire       ras_n,         // живые с разъёма
    input  wire [7:0] shap,
    input  wire       vid_win,       // vu_bus.v, окно видеоспада
    input  wire       vid_lock,
    input  wire       strob,         // СТРОБ СОСТ. с разъёма
    input  wire [7:0] shd,           // шина данных: под стробом -- слово состояния
    output reg  [8:0] line = 9'd0,   // строка машины 0..311
    output wire [7:0] pos,           // место в строке 0..191
    output reg        line_stb = 1'b0,  // началась строка line
    output reg        frame_stb = 1'b0, // строка FRAME_LINE: снять прокрутку
    output wire       ok,
    // прокрутка, какой её взяла машина (значение S в строке загрузки)
    output reg  [7:0] scroll_hw = 8'h00,
    output wire       scroll_hw_ok,
    // для калибровки: последние поправки и что было на ~ШАП
    output reg  [7:0] slip_v = 8'd0,
    output reg  [7:0] slip_h = 8'd0,
    output reg  [4:0] last_v = 5'd0,
    output reg  [7:0] last_s = 8'd0,
    // в журнал портов (vid_rec.v), диагностика: 0 -- разрыв в
    // убывании S (a -- S сейчас, b -- прежнее), 1 -- опора поставила строку
    // (a -- S, b -- строка до поправки), 2 -- INTA (a -- строка, b -- видеоцикл)
    output reg        dbg_stb = 1'b0,
    output reg  [1:0] dbg_kind = 2'd0,
    output reg  [7:0] dbg_a = 8'd0,
    output reg  [7:0] dbg_b = 8'd0
);

// ------------------------------------------------------ спад ~RAS видеоцикла
reg [3:0] rs = 4'hF;
reg [7:0] s1 = 8'h00;
always @(posedge clk) begin
    rs <= {rs[2:0], ras_n};
    s1 <= shap;
end
wire vfall = rs[3] & rs[2] & ~rs[1] & vid_win & vid_lock;

// строка сейчас, столбец -- через COL_DLY тактов
reg [7:0] row = 8'h00;
reg [3:0] dly = 4'd0;
reg       dec = 1'b0;                 // такт разбора адреса
always @(posedge clk) begin
    dec <= 1'b0;
    if (vfall) begin row <= s1; dly <= COL_DLY; end
    else if (dly != 4'd0) begin
        dly <= dly - 4'd1;
        if (dly == 4'd1) dec <= 1'b1;
    end
end
wire [4:0] v_now = row[4:0];
wire [7:0] s_now = {s1[5:0], row[6], row[5]};   // s1 здесь -- фаза столбца

// ------------------------------------------------------------ слово состояния
reg [1:0] st_s = 2'b00;
reg       st_taken = 1'b0;
reg       inta = 1'b0;
always @(posedge clk) begin
    st_s <= {st_s[0], strob};
    inta <= 1'b0;
    if (!st_s[1]) st_taken <= 1'b0;
    else if (!st_taken) begin
        st_taken <= 1'b1;
        inta     <= shd[0];
    end
end

// --------------------------------------------------------------------- счёт
reg  [5:0] cyc = 6'd0;
reg  [6:0] since = 7'd0;        // тактов с видеоспада
reg        aligned = 1'b0;      // была хоть одна привязка
reg  [4:0] v_prev = 5'h1F, v_prev2 = 5'h1F;
reg  [7:0] s_prev = 8'h00;
reg  [3:0] run = 4'd0;
reg  [9:0] no_mark = 10'd1023;  // строк без опоры по адресу (насыщается)
wire       mark_ok = (no_mark < 10'd624);     // опора по адресу свежая: < 2 кадров

wire [5:0] cyc_col1 = (CYC_COL0 == 6'd47) ? 6'd0 : CYC_COL0 + 6'd1;
wire [8:0] line_run = MARK_LINE + {5'd0, RUN_LONG};
wire [8:0] line_mk  = (line_run >= 9'd312) ? line_run - 9'd312 : line_run;

always @(posedge clk) begin
    line_stb  <= 1'b0;
    frame_stb <= 1'b0;
    dbg_stb   <= 1'b0;
    if (~&since) since <= since + 7'd1;

    if (reset) begin
        aligned <= 1'b0; cyc <= 6'd0; line <= 9'd0; run <= 4'd0; no_mark <= 10'd1023;
    end
    else begin
        // счёт видеоциклов: 48 -- строка
        if (vfall) begin
            since <= 7'd0;
            if (cyc == 6'd47) begin
                cyc      <= 6'd0;
                line     <= (line == 9'd311) ? 9'd0 : line + 9'd1;
                line_stb <= aligned;
                frame_stb <= aligned & (((line == 9'd311) ? 9'd0 : line + 9'd1) == FRAME_LINE);
                if (~&no_mark) no_mark <= no_mark + 10'd1;
            end
            else
                cyc <= cyc + 6'd1;
        end

        // разбор адреса видеоцикла
        if (dec) begin
            v_prev  <= v_now;
            v_prev2 <= v_prev;
            // колонка 1 после колонки 0 после V_PRE: горизонтальная опора
            if (v_now == 5'd1 && v_prev == 5'd0 && v_prev2 == V_PRE) begin
                slip_h <= {2'b00, cyc} - {2'b00, cyc_col1};
                cyc    <= cyc_col1;
                last_v <= v_prev2;
                last_s <= s_now;
                s_prev <= s_now;
                // вертикальная: S убывает на единицу -- продолжение, иначе загрузка
                if (s_now == s_prev - 8'd1) begin
                    if (run != 4'hF) run <= run + 4'd1;
                    if (run == RUN_OK - 4'd1)
                        scroll_hw <= s_now + {4'd0, RUN_OK};
                    if (run == RUN_LONG - 4'd1) begin
                        dbg_stb <= 1'b1; dbg_kind <= 2'd1; dbg_a <= s_now; dbg_b <= line[7:0];
                        slip_v    <= line[7:0] - line_mk[7:0];
                        line      <= line_mk;
                        aligned   <= 1'b1;
                        no_mark   <= 10'd0;
                    end
                end
                else begin
                    run <= 4'd0;
                    dbg_stb <= 1'b1; dbg_kind <= 2'd0; dbg_a <= s_now; dbg_b <= s_prev;
                end
            end
        end

        if (inta) begin
            dbg_stb <= 1'b1; dbg_kind <= 2'd2; dbg_a <= line[7:0]; dbg_b <= {2'b00, cyc};
        end
        // INTA -- только без опоры по адресу
        if (inta && !mark_ok) begin
            cyc     <= INT_CYC;
            line    <= INT_LINE;
            aligned <= 1'b1;
        end
    end
end

// четверть видеоцикла: 66 тактов / 4 = 16,5 -- берём по 16, последняя шире
wire [1:0] quarter = (since >= 7'd48) ? 2'd3 : since[5:4];
assign pos = {cyc, quarter};
assign ok  = aligned & vid_lock;
assign scroll_hw_ok = mark_ok;

endmodule

`default_nettype wire
