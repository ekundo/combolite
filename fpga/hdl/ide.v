// Контроллер IDE для «Вектор-06Ц».
//
// Повторяет поведение оригинального контроллера 1999 года, где старший байт
// данных ходит через
// две защёлки, а младший — напрямую через двунаправленный буфер.
//
// Порты:
//   0x50…0x57  регистры командного блока ATA, адресуются DA[2:0]
//   0x58       старший байт 16-разрядного слова. Это НЕ регистр привода,
//              а регистр на плате.
//   0x5F       системный сброс; привода не касается (см. «сброс» ниже)
//
// Порядок доступа, как в оригинальном коде:
//   чтение  — сначала IN 0x50, потом IN 0x58
//   запись  — сначала OUT 0x58, потом OUT 0x50
//
// То есть обращение к 0x50 порождает одно 16-разрядное обращение к приводу:
// на чтении младший байт уходит процессору сразу, а старший защёлкивается и
// ждёт следующего чтения 0x58; на записи старший байт берётся из регистра,
// заполненного предыдущей записью в 0x58.
//
// Все стробы на выходе — активный низкий уровень, как на разъёме IDE.

`default_nettype none

module ide (
    input  wire        clk,          // системный такт, кратно быстрее шины
    input  wire        reset,        // сброс всей платы, активный высокий

    // сторона «Вектора»
    input  wire [7:0]  port,         // адрес ввода-вывода, прямой (не инверсный)
    input  wire        iord,         // строб чтения ввода-вывода, активный высокий
    input  wire        iowr,         // строб записи ввода-вывода, активный высокий
    // Импульс в один такт в начале записи в порт, с честной фильтрацией
    // (vu_bus.v). Им забираются данные с шины машины: уровневый захват брал бы
    // их и после снятия строба, когда машина их уже не гарантирует.
    input  wire        iowr_reg,
    // Придержать процессор: шиной привода владеет удалённая сторона. Стробы к
    // приводу не идут, сброс не дёргается, а на чтение отдаётся 0x80 —
    // состояние с поднятым BSY. Драйвер в машине увидит «привод занят» и будет
    // ждать, а не читать мусор и не портить обмен.
    input  wire        hold,
    // Сброс привода по команде удалённой стороны. Импульс в один такт; линия
    // RESET физически одна, поэтому счётчик длительности общий с процессорным
    // сбросом — кто первый дёрнул, тот и перезапустил отсчёт.
    input  wire        rem_reset,
    input  wire [7:0]  cpu_din,      // данные от процессора
    output wire [7:0]  cpu_dout,     // данные процессору
    output wire        cpu_dout_oe,  // разрешение выдачи на шину данных

    // сторона привода
    output wire [2:0]  ide_da,       // адрес регистра
    output wire        ide_cs0_n,    // выбор командного блока
    output wire        ide_cs1_n,    // блок управления не используется
    output wire        ide_dior_n,   // строб чтения
    output wire        ide_diow_n,   // строб записи
    output reg         ide_reset_n,  // сброс привода
    input  wire [15:0] ide_din,      // данные от привода
    output wire [15:0] ide_dout,     // данные приводу
    output wire        ide_dout_oe   // разрешение выдачи на шину привода
);

// ------------------------------------------------------------ декодирование

wire in_block  = (port[7:3] == 5'b01010);      // 0x50…0x57
wire sel_data  = in_block & (port[2:0] == 3'd0);   // 0x50
wire sel_hi    = (port == 8'h58);

wire access    = iord | iowr;
wire block_acc = in_block & access;

assign ide_da    = port[2:0];
assign ide_cs0_n = ~block_acc;
assign ide_cs1_n = 1'b1;                       // как в оригинале: на единице

// Стробы уходят приводу только при обращении к его регистрам. Обращения к
// 0x58 и 0x5F привод не видит — это наши собственные регистры.
assign ide_dior_n = ~(block_acc & iord & ~hold);
assign ide_diow_n = ~(block_acc & iowr & ~hold);

// -------------------------------------------------- старший байт, чтение

// ЗАБИРАЕМ ПО УРОВНЮ, А НЕ НА КОНЦЕ ЧТЕНИЯ. Захват по `sel_data & iord_fall`
// (на такте, где iord перешёл из единицы в нуль) на такт позже, чем можно:
// `ide_dior_n` собран из того же iord комбинационно, значит на этом такте
// строб чтения приводу УЖЕ СНЯТ и привод начинает убирать данные с шины.
// Старший байт получался бы то верным, то нет -- редкие испорченные байты в
// секторах, прочитанных машиной: каждый второй байт сектора идёт именно через
// этот регистр.
//
// Уровневый захват повторяется каждый такт, пока идёт чтение, и ПОСЛЕДНИЙ
// приходится на такт ДО снятия ~DIOR, то есть данные ещё держатся. Ранние
// захваты берут мусор (у привода время доступа до 165 нс), но их затирают
// поздние: строб машины замерен в 320-360 нс.
//
// Удалённая сторона сделана так же: ide_cycle.v забирает ide_din на
// последнем такте активного ~DIOR, а не после него.
reg [7:0] hi_read;
always @(posedge clk) begin
    if (reset)
        hi_read <= 8'h00;
    else if (sel_data & iord & ~hold)
        hi_read <= ide_din[15:8];
end

// ------------------------------------------ байты записи, взятые с шины машины

// Процессор кладёт старший байт записью в 0x58, а выставляется он на шину
// привода при следующей записи в 0x50.
//
// ПОЧЕМУ ИМПУЛЬСОМ, А НЕ УРОВНЕМ. Уровневый захват повторяется каждый такт, и
// последний приходится уже за концом строба: очищенный iowr отстаёт от ~ЗПВВ
// на два такта (регистровый выход purifier). Машина к этому времени данные с
// шины уже снимает.
reg [7:0] hi_write;
always @(posedge clk) begin
    if (reset)
        hi_write <= 8'h00;
    else if (iowr_reg & sel_hi)
        hi_write <= cpu_din;
end

// МЛАДШИЙ БАЙТ ИДЁТ К ПРИВОДУ ЖИВЬЁМ, И ЭТО ПРАВИЛЬНО.
//
// Регистра по `iowr_reg` для него нет: `iowr` падает по живому `~ЗПВВ`, и
// живой `cpu_din` до конца строба гарантирован самой машиной. Регистр добавлял
// бы путь тихой порчи -- если импульс `iowr_reg` не сложится (строб короче
// 70 нс), приводу уйдёт СТАРЫЙ байт, а `~DIOW` при этом пойдёт.

// ------------------------------------------------------------------- сброс

// RESET привода дёргает ТОЛЬКО удалённая сторона (вход rem_reset) и подача
// питания. Держим достаточно долго: по стандарту ATA нужно не меньше 25 мкс,
// берём с запасом. Проверку «шина наша» делает ide_remote, здесь исполнение.
//
// ПОЧЕМУ ОБРАЩЕНИЕ К 0x5F НЕ СБРАСЫВАЕТ ПРИВОД. Иначе начальный загрузчик
// «Вектора» не находит контроллер вовсе, показывая кассету вместо винта. Его
// процедура опознания (ПЗУ, адрес 0x0818)
// выглядит так: записать 0x80 в 0x5F, затем ПЯТНАДЦАТЬ раз подряд, без единой
// задержки, прочитать состояние на 0x57 и ждать (st & 0xC0) == 0x40, то есть
// BSY снят и DRDY поднят. Пятнадцать таких попыток — это единицы микросекунд.
//
// CompactFlash после аппаратного сброса поднимает BSY на сотни миллисекунд:
// измерено — 400 мс. Успеть она не может. Хуже того, ПЗУ крутит опознание в
// цикле, пока держат клавиши, и каждое обращение к 0x5F заново перезаряжало
// бы счётчик -- привод не выходил бы из сброса вообще.
//
// Описание оригинального контроллера говорит про этот порт прямо —
//
//   5fH  Системный сброс (лучше не пользоваться, сходство с 57Н без обнуления
//        микросхем жесткого диска).
//
// То есть в оригинале 0x5F сбрасывал СВОЮ логику и привода намеренно не
// касался. Обращение к 0x5F игнорируется — стробов приводу от него нет,
// block_acc покрывает только 0x50…0x57.
//
// Чем платим: машина больше не может сбросить привод сама. Для зависшего
// привода остаётся сброс через ESP, а при подаче питания ~RESET дёргается сам.
parameter  RESET_TICKS = 12'd2500;             // при 50 МГц это 50 мкс
reg [11:0] reset_cnt;
always @(posedge clk) begin
    if (reset) begin
        reset_cnt   <= RESET_TICKS;
        ide_reset_n <= 1'b0;
    end
    else if (rem_reset) begin
        reset_cnt   <= RESET_TICKS;
        ide_reset_n <= 1'b0;
    end
    else if (reset_cnt != 0) begin
        reset_cnt   <= reset_cnt - 1'b1;
        ide_reset_n <= 1'b0;
    end
    else
        ide_reset_n <= 1'b1;
end

// --------------------------------------------------------------- шина данных

// Процессору отдаём либо младший байт слова прямо от привода, либо
// защёлкнутый старший.
assign cpu_dout    = hold   ? 8'h80              // BSY: «привод занят»
                   : sel_hi ? hi_read
                   :          ide_din[7:0];
assign cpu_dout_oe = iord & (block_acc | sel_hi);

// Приводу: старший байт из регистра, младший живьём с шины машины (см. выше).
assign ide_dout    = {hi_write, cpu_din};
assign ide_dout_oe = block_acc & iowr & ~hold;

endmodule

`default_nettype wire
