// Канал «Вектор» <-> ESP: Wi-Fi модем за портами в раскладке UART 16550.
//
// ЗАЧЕМ ТАК. Для «Вектора» уже есть программы под модем на COM-порту 16550 с
// базой 28h -- например, VTTPX.COM С. В. Терентьева (терминал с XMODEM и
// YMODEM). Плата изображает ровно то подмножество 16550, которым такие
// программы пользуются; за портами -- модем Hayes в ESP (fw/modem.c),
// протокол поверх канала -- забота ESP (fw/vchan.c). doc/MODEM.md -- для
// программ и эмуляторов.
//
// РЕГИСТРЫ (база 28h, DLAB -- разряд 7 LCR):
//   28h чтение  RBR -- байт от ESP (снимается с очереди по концу строба);
//   28h запись  THR -- байт к ESP (кладётся, если есть место; иначе пропадает);
//               при DLAB = 1 -- младший байт делителя: пропускается;
//   29h запись  IER (или старший байт делителя) -- пропускается;
//   2Ah запись  FCR: разряд 1 или 2 -- очистить обе очереди. ESP узнает об
//               этом по признаку flushed и начнёт разбор заново;
//   2Bh запись  LCR: помнится только DLAB;
//   2Ch запись  MCR -- пропускается;
//   2Dh чтение  LSR: разряд 0 (DR) -- есть байт от ESP, 5 (THRE) -- есть место
//               к ESP, 6 (TEMT) -- очередь к ESP пуста, прочие -- 0. Пока ESP
//               молчит (SPI тихо дольше 0,34 с), LSR = 00h: ни байта, ни места.
// Прочее не отвечает: шина -- FFh. Программа узнаёт модем по
// (LSR & 9Eh) == 0: пустая шина даёт FFh. Прерываний у канала нет: принимать
// -- опросом LSR. 2Eh и 2Fh (MSR, SCR) не заняты: там джойстики у других плат.
//
// ESP -- ведущий SPI, ПЛИС начать обмен не может, поэтому ESP опрашивает
// канал сама, раз в тик (команды 0x58/0x59, ide_remote.v).
//
// БЕЗ ЦЕПОЧЕК ПЕРЕНОСА. Первая сборка (Diamond, прогон rev4-6layer-32) с
// пятиразрядными указателями, счётом байт и своим сторожем «ESP жива» заняла
// ~180 LUT4 -- переносы стоят по два LUT4 на разряд -- и кристалл не вместил
// (SLICE 101 %). Здесь указатели -- четырёхразрядные регистры сдвига с
// обратной связью (x^4 + x^3 + 1, 15 состояний, нуля нет), очередь пуста при
// равных указателях и полна, когда следующий за записью равен чтению: 14 байт.
// Числа байт ESP не получает: перед каждым байтом ide_remote отдаёт признак
// «есть ещё». Живость ESP -- сторож тишины SPI из ide_remote.
//
// ПАМЯТЬ -- распределённая (LUT), блочной не осталось: 26 из 26. Очередь --
// массив с синхронной записью и асинхронным чтением, это DPR16X4; ячейка 0
// не используется (указатель её не принимает).
//
// Очереди сбрасываются только по питанию и по очистке с «Вектора». Сброс машины
// их не трогает: программа, начиная, очищает канал сама, а ESP не должна
// терять ответ из-за того, что машину перезагрузили посреди обмена.
`default_nettype none

module vchan #(
    parameter [7:0] BASE = 8'h28
) (
    input  wire       clk,
    input  wire       por,
    // шина «Вектора»
    input  wire [7:0] port,
    input  wire       iord,          // чтение порта, уровнем на весь цикл
    input  wire       iowr_reg,      // один такт на цикл записи
    input  wire [7:0] din,
    output wire [7:0] dout,
    output wire       dout_oe,
    // сторона ESP (ide_remote.v)
    input  wire       esp_alive,     // SPI не молчит
    input  wire       esp_poll,      // ESP опросила канал: снять flushed
    input  wire       esp_push,      // байт от ESP в очередь к «Вектору»
    input  wire [7:0] esp_wdata,
    input  wire       esp_pop,       // ESP забрала голову очереди от «Вектора»
    output wire [7:0] v2e_head,
    output wire       v2e_avail,     // от «Вектора» есть байт
    output wire       e2v_empty,     // к «Вектору» пусто: можно 14 байт разом
    output reg        flushed = 1'b0 // «Вектор» очистил канал
);

function [3:0] nx(input [3:0] p);
    nx = {p[2:0], p[3] ^ p[2]};
endfunction

// ------------------------------------------------------------ очереди
reg  [7:0] v2e [0:15];
reg  [7:0] e2v [0:15];
reg  [3:0] v2e_wp = 4'd1, v2e_rp = 4'd1;
reg  [3:0] e2v_wp = 4'd1, e2v_rp = 4'd1;

wire v2e_full  = (nx(v2e_wp) == v2e_rp);
wire e2v_full  = (nx(e2v_wp) == e2v_rp);
wire v2e_none  = (v2e_wp == v2e_rp);
assign e2v_empty = (e2v_wp == e2v_rp);
assign v2e_avail = ~v2e_none;
assign v2e_head  = v2e[v2e_rp];

// ------------------------------------------------------------ шина
wire       ours = (port[7:3] == BASE[7:3]);
wire [2:0] reg_n = port[2:0];
reg        dlab = 1'b0;

wire rd_data = iord & ours & (reg_n == 3'd0) & ~dlab;
wire rd_lsr  = iord & ours & (reg_n == 3'd5);
wire wr_data = iowr_reg & ours & (reg_n == 3'd0) & ~dlab;
wire wr_fcr  = iowr_reg & ours & (reg_n == 3'd2);
wire wr_lcr  = iowr_reg & ours & (reg_n == 3'd3);
wire flush   = wr_fcr & (din[1] | din[2]);

always @(posedge clk)
    if (por)         dlab <= 1'b0;
    else if (wr_lcr) dlab <= din[7];

wire [7:0] lsr = esp_alive ? {1'b0, v2e_none, ~v2e_full, 4'b0000, ~e2v_empty} : 8'h00;

// Голова очереди к «Вектору» посреди цикла не меняется: снимает её только сам
// процессор, а ESP лишь докладывает в хвост. Защёлкивать байт поэтому незачем.
// Нужен один признак -- был ли байт на начале строба: в пустую очередь ESP
// может положить байт посреди цикла, и снять его тогда было бы нечестно --
// процессор прочёл мусор. Снимаем по концу строба.
//
// Конец строба -- со второй и третьей ступени, а не по самому rd_data. iord снимается по
// живому ~ЧТВВ (vu_bus.v), то есть не в такт: прежде rd_end = rd_d & ~rd_data
// шёл сразу на четыре разряда e2v_rp и на rd_d, и когда строб снимался у фронта,
// rd_d уже видел конец, а указатель ещё нет. Сдвиг пропадал, и следующее чтение
// отдавало тот же байт ещё раз: на «Векторе» вместо OK -- OKK (25.10.2026, rev4).
// Первая ступень (rd_s1) ловит несинхронный строб и в rd_end не входит: её
// метастабильность не должна доходить до указателя. q_ok держится, пока конец
// не дошёл до rd_s3: иначе байт, положенный ESP в пустую очередь за эти такты,
// снялся бы непрочитанным. Он один триггер, несинхронный rd_data ему не страшен.
reg rd_s1 = 1'b0, rd_s2 = 1'b0, rd_s3 = 1'b0, q_ok = 1'b0;
always @(posedge clk) begin
    rd_s1 <= rd_data;
    rd_s2 <= rd_s1;
    rd_s3 <= rd_s2;
    if (!rd_data && !rd_s1 && !rd_s2 && !rd_s3) q_ok <= ~e2v_empty;
end
wire rd_end = rd_s3 & ~rd_s2;

assign dout    = rd_lsr ? lsr : e2v[e2v_rp];
assign dout_oe = rd_data | rd_lsr;

// ------------------------------------------------------------ указатели
always @(posedge clk) begin
    if (wr_data & ~v2e_full)  v2e[v2e_wp] <= din;
    if (esp_push & ~e2v_full) e2v[e2v_wp] <= esp_wdata;
end

always @(posedge clk)
    if (por | flush) begin
        v2e_wp <= 4'd1; v2e_rp <= 4'd1;
        e2v_wp <= 4'd1; e2v_rp <= 4'd1;
    end
    else begin
        if (wr_data & ~v2e_full)         v2e_wp <= nx(v2e_wp);
        if (esp_pop & ~v2e_none)         v2e_rp <= nx(v2e_rp);
        if (esp_push & ~e2v_full)        e2v_wp <= nx(e2v_wp);
        if (rd_end & q_ok & ~e2v_empty)  e2v_rp <= nx(e2v_rp);
    end

always @(posedge clk)
    if (por)           flushed <= 1'b0;
    else if (flush)    flushed <= 1'b1;
    else if (esp_poll) flushed <= 1'b0;

endmodule

`default_nettype wire
