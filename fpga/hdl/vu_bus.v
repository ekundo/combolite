// Интерфейс системной шины «Вектор-06Ц».
//
// Модуль purifier взят из vu_bus.v проекта svofski/vector06c-lesshadoks
// (modified BSD, (C) 2018 Viacheslav Slavinsky) без изменений логики.
// Остальное написано под эту плату.
//
// ЧТО НЕСЁТ ~ШАВВ. В цикле обращения к вводу-выводу это адрес порта, а в цикле
// обращения к памяти — старший байт адреса, A15..A8. Это подтверждают две
// независимые работающие конструкции: у Syntal'а ПЛИС не подключена к ~ШАП
// вовсе, но формирует ~БЛК, то есть декодирует окно квазидиска, и декодировать
// его ей больше не от чего; у svofski в kvaz.v окно берётся как shavv[7:4].
// Поэтому здесь одна шина bus_addr идёт и на декодирование портов, и на
// декодирование окна. Путаницы не возникает: окно смотрят только когда идёт
// обращение к памяти, а порты — только по стробам ввода-вывода.
//
// ЗАЧЕМ ЗДЕСЬ НЕ НУЖЕН ~ШАП. Плоский адрес нужен только микросхеме ОЗУ и
// собирается на пятивольтовой стороне: A8..A15 — с ~ШАП через защёлку 574
// строки, A0..A7 — через защёлку столбца (latch_clk2, top.v). В FPGA ~ШАП
// заведён для других узлов (shap_demux.v, vid_raster.v).
//
// ПОЧЕМУ ЗАЩЁЛКА ТАКТИРУЕТСЯ ИНВЕРТИРОВАННЫМ ~RAS. На «Векторе» ~RAS снимается
// РАНЬШЕ ~CAS — это отмеченная Syntal'ом особенность. Поэтому строку нельзя
// защёлкивать по снятию ~RAS: адрес к тому моменту уже переключается на столбец.
// Защёлкивать надо по установке ~RAS, то есть по фронту инвертированного
// сигнала, и защёлка должна быть по фронту (574), а не прозрачная (573).
//
// ЧТО PURIFIER РЕАЛЬНО ДЕЛАЕТ. Это подавитель дребезга, и попутно — коротких
// помех. Выход принимает значение входа не в момент обнаружения нестабильности,
// а такт спустя, поэтому помеха длиной в один такт до выхода не доходит вовсе:
// к моменту переписывания вход уже вернулся (порог замерен в симуляции).
// Дребезг же даёт ровно одно переключение выхода.
//
// Взято как есть, потому что именно этот вариант проверен в железе у svofski.
// Его собственные комментарии в vu_bus.v показывают, что варианты с честной
// задержкой на согласование ломали исполнение кода из квазидиска: задержка
// MEMORY тактов на стробах шины конструкцией не переносится.

`default_nettype none

// ------------------------------------------------------------------ purifier
// НЕ УПРОЩАТЬ. Соблазн заменить это на «отсемплировать вход двумя триггерами»
// возникает у всех, и он уже проверен на живой машине автором оригинала:
// «Простое семплирование… ни в каком виде не давало стабильного результата»
// (zx-pk.ru/threads/29311, стр. 3). Параметры тоже итоговые, а не первые
// попавшиеся: MEMORY=4 на ~RAS, по 8 на остальных стробах — как у него.
//
// Чего этот модуль НЕ делает: он не подавляет узкий выброс, а РАСТЯГИВАЕТ его.
// В состоянии S1 условие «устойчивость потеряна» сразу отдаёт новое значение на
// выход, и лишь потом восемь отсчётов запрещают следующее изменение. Поэтому
// глитч на ~ЗПВВ даст одну ложную запись. У автора оригинала это проявлялось
// как «невозможная запись в диск» и самопроизвольное переключение страниц;
// причина — звон на длинной ёмкостной шине.
// (C) 2018 Viacheslav Slavinsky, modified BSD. Логика не изменена.
module purifier #(parameter MEMORY = 8) (
    input  wire clk,
    input  wire reset,
    input  wire in,
    output reg  out
);

reg [MEMORY-1:0] memory;

wire all_hi = &memory;
wire all_lo = ~|memory;
wire stable = all_hi | all_lo;

reg stable_r;

localparam S1 = 1, S2 = 2;
reg [1:0] state;

always @(posedge clk) begin
    memory   <= {memory[MEMORY-2:0], in};
    stable_r <= stable;
end

always @(posedge clk) begin
    if (reset) begin
        state <= S1;
        out   <= in;
    end
    // `default` обязателен: состояние двухразрядное, а осмысленных значений
    // два. Из 2'b00 и 2'b11 ни одна ветвь не выводит, и очиститель залипал бы
    // навсегда — то есть плата молча умирала бы после конфигурации. Полагаться
    // на то, что Diamond разложит preload через GSR, тут незачем: строка
    // бесплатная.
    else case (state)
        S1: if (stable_r & !stable) begin
                out   <= in;
                state <= S2;
            end
        S2: if (stable) begin
                out   <= in;
                state <= S1;
            end
        default: state <= S1;
    endcase
end

endmodule

// -------------------------------------------------------------------- vu_bus
module vu_bus #(
    parameter VID_STATS = 1          // замеры различителя по стробу (vid_phase.v, STATS)
) (
    input  wire       clk,           // 50 МГц
    input  wire       reset,         // сброс, активный высокий

    // с разъёма СНП, после неинвертирующих трансляторов уровня
    input  wire [7:0] shavv_n,       // ~ШАВВ: порт либо A15..A8
    input  wire       ras_n,
    input  wire       cas_n,
    input  wire       chtzu_n,       // ~ЧТЗУ
    input  wire       zpzu_n,        // ~ЗПЗУ
    input  wire       chtvv_n,       // ~ЧТВВ
    input  wire       zpvv_n,        // ~ЗПВВ
    input  wire       stack,         // СТЕК, активный высокий
    input  wire       sbros_n,       // ~СБРОС

    // наружу, всё активное высокое
    output wire [7:0] bus_addr,      // порт для декодирования, он же A15..A8
    output wire       iord,          // ~ЧТВВ очищенный и инвертированный
    output wire       iowr,          // ~ЗПВВ
    output wire       memrd,         // ~ЧТЗУ
    output wire       memwr,         // ~ЗПЗУ
    output wire       clean_stack,
    output wire       sys_reset,

    // фронты, по одному такту
    output wire       iord_fall,     // конец чтения ввода-вывода
    output wire       iowr_fall,     // конец записи ввода-вывода
    // Импульс в один такт в начале записи в порт, с честной фильтрацией.
    // Только для регистров на плате; разбор — ниже по файлу.
    output wire       iowr_reg,
    output wire       ras_fall,      // ~RAS установился
    // Различитель наружу -- следилке за растром (vid_raster.v): спад ~RAS в
    // окне при захвате -- видеоцикл.
    output wire       vid_win,
    output wire       vid_lock,

    // Включить заморозку защёлки на время обращения. Ноль — выключено.
    input  wire       latch_gate,

    // Гасить такт защёлки на предсказанном ВИДЕОспаде ~RAS. Ноль — выключено.
    // Разбор в `hdl/vid_phase.v`; в отличие от заморозки выше,
    // защёлка продолжает тактоваться от процессорных спадов и теряет только
    // видеоадаптерные, то есть строка остаётся верной, а не устаревшей.
    input  wire       vid_gate,
    input  wire       vid_clr,       // обнулить измерения различителя
    input  wire       vid_pol,       // 0 -- видеоспад после длинного промежутка ~RAS, 1 -- после короткого
    output wire [7:0] stb_after_min, // от предыдущего спада до строба
    output wire [7:0] stb_after_max,
    output wire [7:0] stb_before_min,// от строба до следующего спада
    output wire [7:0] stb_before_max,
    output wire [7:0] vid_lost,
    output wire [7:0] vid_state,
    output wire [7:0] stb_max,     // срабатываний строба между спадами ~RAS

    // на плату
    output wire       latch_clk      // такт защёлки 574 адреса строки
);

// ~ШАВВ инвертируется без фильтрации: шина адреса устоялась задолго до стробов,
// а лишний такт задержки здесь только сузил бы окно принятия решения.
assign bus_addr = ~shavv_n;

// Такт защёлки 574 — чисто комбинационный, без регистров. Регистрировать нельзя:
// адрес строки держится после установки ~RAS недолго, и лишние такты его теряют.
//
// ЗАМОРОЗКА НА ВРЕМЯ ОБРАЩЕНИЯ, опыт.
//
// Измерено наблюдателем: внутрь одного строба чтения попадает ДВА лишних спада
// ~RAS (циклы регенерации экрана), внутрь строба записи — ноль. Каждый лишний
// спад перезаписывает A8..A15 микросхемы ОЗУ чужим, видеоадресом, пока /CE и
// /OE ещё активны. Это объясняет и порчу чтения, и целость записи.
//
// Строка адреса взята ПЕРВЫМ спадом; любой следующий фронт внутри обращения
// может только навредить. Значит на время строба защёлку надо заморозить.
//
// Почему не просто `~ras_n & chtzu_n & zpzu_n`. При таком гейте в момент
// СНЯТИЯ строба, пока ~RAS ещё внизу, latch_clk подскочил бы вверх — и защёлка
// взяла бы адрес в фазе СТОЛБЦА. Одна порча сменилась бы другой. Поэтому
// разрешение держится регистром и перевзводится ТОЛЬКО при снятом ~RAS: тогда
// в момент перевзвода latch_clk заведомо внизу и лишнего фронта не возникает.
//
// Выключено по умолчанию. Включается командой по SPI, чтобы сравнить оба
// поведения вживую на одном битстриме и чтобы плата поднималась в заведомо
// рабочем виде, если опыт окажется неудачным.
//
// Чем это может кончиться плохо: если на какой-то машине ~ЧТЗУ приходит РАНЬШЕ
// собственного ~RAS, разрешение снимется до первого спада и строка не
// защёлкнется никогда. Отказ будет громким и мгновенным, а не тихим.
reg latch_arm;
always @(posedge clk) begin
    if (reset)                       latch_arm <= 1'b1;
    else if (~chtzu_n | ~zpzu_n)     latch_arm <= 1'b0;   // идёт обращение
    else if (ras_n)                  latch_arm <= 1'b1;   // взводим при снятом ~RAS
end


// Различитель стоит ниже, после purifier'ов: ему нужны очищенные стробы.
wire vid_block, vid_locked;
assign vid_win  = vid_block;
assign vid_lock = vid_locked;
// Сам гейт -- отдельным модулем с постоянным именем: pins.lpf держит его у
// выводов ras_n (143) и latch_clk (141), иначе размещение уводит его в середину
// кристалла (12,65 нс вместо 7,61).
lclk_gate lclk (
    .ras_n(ras_n), .arm(latch_arm), .gate_on(latch_gate),
    .vid_block(vid_block), .vid_gate(vid_gate), .latch_clk(latch_clk)
);

wire c_ras_n, c_cas_n, c_chtzu_n, c_zpzu_n, c_chtvv_n, c_zpvv_n;
wire c_stack, c_sbros_n;

// У ~RAS память короче: он самый быстрый на шине. Так же сделано у svofski.
purifier #(.MEMORY(4)) pu_ras   (.clk(clk), .reset(reset), .in(ras_n),   .out(c_ras_n));
purifier               pu_cas   (.clk(clk), .reset(reset), .in(cas_n),   .out(c_cas_n));
purifier               pu_chtzu (.clk(clk), .reset(reset), .in(chtzu_n), .out(c_chtzu_n));
purifier               pu_zpzu  (.clk(clk), .reset(reset), .in(zpzu_n),  .out(c_zpzu_n));
purifier               pu_chtvv (.clk(clk), .reset(reset), .in(chtvv_n), .out(c_chtvv_n));
purifier               pu_zpvv  (.clk(clk), .reset(reset), .in(zpvv_n),  .out(c_zpvv_n));
purifier               pu_stack (.clk(clk), .reset(reset), .in(stack),   .out(c_stack));
purifier               pu_sbros (.clk(clk), .reset(reset), .in(sbros_n), .out(c_sbros_n));

// СТРОБЫ ВВОДА-ВЫВОДА: ПОДНИМАЮТСЯ ПО ОЧИЩЕННОМУ, ПАДАЮТ ПО ЖИВОМУ.
//
// У purifier выход регистровый и отстаёт от входа на два такта — в обе стороны.
// Запаздывание на установке безобидно и даже полезно: узкий выброс до этого
// момента уже отсеян. А вот запаздывание на СНЯТИИ вредит дважды:
//
//   1. Плата продолжает держать шину данных машины ещё до 40 нс после того, как
//      машина закончила цикл чтения (`cpu_dout_oe` в ide.v собран из iord).
//      Машина к этому времени уже начинает следующий цикл — и если это цикл
//      памяти, на шине оказываются два источника разом.
//   2. Стробы приводу (`~DIOR`, `~DIOW`) снимаются позже, чем машина сняла свой,
//      то есть привод защёлкивает данные, которых на шине машины может уже не
//      быть.
//
// Поэтому берём И очищенный, И живой уровень: подъём даёт очищенный (с
// фильтрацией выброса), спад — живой (ровно когда машина закончила). Задержки
// это не добавляет и запрет svofski на задержку в стробах не нарушает: живой
// уровень только УКОРАЧИВАЕТ активную фазу, а не сдвигает её.
assign iord        = ~c_chtvv_n & ~chtvv_n;
assign iowr        = ~c_zpvv_n  & ~zpvv_n;
// Строб машины для различителя: только ~ЧТЗУ и ~ЗПЗУ, и только ОЧИЩЕННЫЕ.
//
// ИЛИ всех четырёх сырыми не годится: классификация разваливается, `cpu_off`
// разъезжается на 23..132 такта, захвата нет вовсе. Причин две.
//
// Циклы ввода-вывода к ОЗУ не обращаются и спада `~RAS` не порождают, значит
// `~ЧТВВ` и `~ЗПВВ` в признаке не нужны и только мешают.
//
// А `~ЧТВВ` вдобавок ФОНИТ: осциллограф на `XS1` выводе 35 показал статическую
// единицу 3,26…3,98 В при `VIH` транслятора 3,50 В. Это уровневый дефект —
// машина на `К155` гарантирует 2,4 В, а `LVC` требует 3,5, — и на этой линии
// транслятор видит фантомные фронты. Каждый фантом ставил бы признак «был
// строб» не там, где надо.
//
// Очищенные, а не сырые: `purifier` фантомы срезает, а его задержка в два такта
// здесь ничего не стоит — до открытия окна 58 тактов.
wire strobe_n = c_chtzu_n & c_zpzu_n;

vid_phase #(.STATS(VID_STATS)) vph (
    .clk(clk), .reset(reset), .clr(vid_clr),
    .ras_n(ras_n), .strobe_n(strobe_n), .vid_pol(vid_pol),
    .vid_block(vid_block), .locked(vid_locked),
    .stb_after_min(stb_after_min), .stb_after_max(stb_after_max),
    .stb_before_min(stb_before_min), .stb_before_max(stb_before_max),
    .vid_lost(vid_lost), .vid_state(vid_state), .stb_max(stb_max)
);


assign memrd       = ~c_chtzu_n;
assign memwr       = ~c_zpzu_n;
// СТЕК: БЕЗ ФИЛЬТРА, как в оригинале.
//
// Здесь легко ошибиться в обе стороны.
//
// Очищенный `c_stack` не годится: `purifier` РАСТЯГИВАЕТ короткий импульс до
// ~160 нс, то есть `~БЛК` остаётся активным в следующем, НЕстековом цикле, и
// обычное обращение машины уходит в ОЗУ платы. Это порча одиночного байта где
// угодно.
//
// `c_stack & stack` — «спад по живому» — тоже нет. Замерено в симуляторе:
// импульс 40 нс проходит как 0-15 нс, 60 нс как 20-35, 100 нс как 60-75. То
// есть короткий СТЕК не проходит ВООБЩЕ: `~БЛК` не встаёт, стековое обращение
// уходит в DRAM машины или в страницу адресности.
//
// Поэтому `stack` — сырой уровень, как в COMBODEVICE: там на этом пути
// фильтра нет вовсе, и плата работает. Довод простой — потерять сигнал хуже, чем
// пропустить выброс. Выброс на СТЕК даёт `~БЛК` шириной те же единицы
// наносекунд, а у ОЗУ минимальный импульс записи 20 нс: записи не будет.
//
// ДЛИТЕЛЬНОСТЬ СТЕК НЕ ЗАМЕРЕНА НИКЕМ — ни у нас, ни у svofski (у него в
// захвате `VU_STACK` постоянный нуль). Пока её не замерят (`DD2` вывод 22,
// земля `DD2.21` в 0,5 мм), любой фильтр здесь — стрельба по невидимой цели.
assign clean_stack =  stack;
assign sys_reset   = ~c_sbros_n | reset;

// Фронты. Стробы уже инвертированы, поэтому «конец обращения» — это спад
// активного уровня, то есть переход iord из единицы в нуль.
reg iord_r, iowr_r, ras_n_r;
always @(posedge clk) begin
    iord_r  <= iord;
    iowr_r  <= iowr;
    ras_n_r <= c_ras_n;
end

// ------------------------------------- надёжный строб записи в регистры платы
//
// ПОЧЕМУ ОТДЕЛЬНЫЙ СТРОБ, А НЕ iowr. Регистры на плате (страницы квазидиска,
// старший байт данных привода) программируются записью в порт, а номер порта
// берётся из ~ШАВВ — той же шины, что в цикле ПАМЯТИ несёт A15..A8. Выброс на
// ~ЗПВВ purifier не подавляет, а растягивает, и если старший байт адреса совпал
// с номером порта, регистр перепишется мусором с шины данных. Для квазидиска
// это обращения по адресам 0x1000-0x10FF, то есть середина области программ:
// машина ходит по ним непрерывно. Замерено в симуляции: выброс шириной от
// 30 нс переписывает регистр страниц.
//
// ЗДЕСЬ МОЖНО ФИЛЬТРОВАТЬ ПО-ЧЕСТНОМУ, а на стробах шины — нельзя. Запрет на
// задержку (комментарии svofski в оригинальном vu_bus.v: честный фильтр ломал
// исполнение кода из квазидиска) касается путей, где плата обязана ОТВЕТИТЬ
// внутри цикла — выставить ~БЛК, отдать данные. Запись в свой регистр никого не
// ждёт: её достаточно успеть до конца цикла. Строб машины замерен в 320-360 нс,
// так что 80 нс на подтверждение — это четверть окна.
//
// ПОЧЕМУ 4, А НЕ 8. Соблазн взять глубину как у purifier есть, и выбросы до 140
// нс тогда отбрасывались бы. Но 320-360 нс — это замер на ЧУЖОЙ машине и всего
// по трём импульсам, а `~ЗПВВ` этой машины не мерил никто. Там же `~ЗПЗУ` =
// 160-200 нс — если `~ЗПВВ`
// окажется такой же, фильтр на 160 нс запретит запись ВООБЩЕ, и квазидиск
// перестанет работать совсем. Это хуже исходной болезни. Четыре отсчёта дают
// запас даже при стробе 160 нс и всё равно отбрасывают выбросы до 60 нс, а
// уровневый захват переписывал бы регистр от 30 нс.
//
// ЧТОБЫ ПОДНЯТЬ ГЛУБИНУ, надо сначала замерить `~ЗПВВ` на этой машине:
// `XS1` вывод 37, земля 33 или 45.
//
// ЗАХВАТ ИМПУЛЬСОМ, А НЕ УРОВНЕМ. Уровневый захват повторяется каждый такт, и
// последний приходится уже за концом строба: у purifier выход регистровый и
// отстаёт на два такта, то есть iowr держится до 40 нс дольше ~ЗПВВ. Замерено
// в симуляции: машина обязана держать данные ещё 30 нс после снятия строба, иначе в
// регистр попадёт мусор. Требование выполнимое, но брать данные посреди строба
// попросту незачем.
// Глубина на единицу больше окна: САМЫЙ СВЕЖИЙ разряд в решение не входит.
// Он — прямая выборка асинхронного входа, и метастабильность на нём в тот же
// такт дошла бы до `iowr_reg`, то есть до разрешения записи восьмиразрядного
// `control_reg`. Метастабильное разрешение на широком регистре грузит часть
// разрядов и не грузит остальные: получилась бы смесь старого значения с
// новым — например, новая страница при старом бите «ОЗУ включено».
localparam IOWR_ARM = 4;                  // 4 УСТОЯВШИХСЯ отсчёта; со свежим,
                                          // не входящим в решение, строб должен
                                          // продержаться 100 нс. ~ЗПВВ = 320-360 нс
                                          // (замер), запас втрое.
reg [IOWR_ARM:0]   zpvv_hist;
reg                iowr_armed;
wire               zpvv_all = &zpvv_hist[IOWR_ARM:1];

always @(posedge clk) begin
    if (reset) begin
        zpvv_hist  <= {(IOWR_ARM+1){1'b0}};
        iowr_armed <= 1'b0;
    end
    else begin
        zpvv_hist  <= {zpvv_hist[IOWR_ARM-1:0], ~zpvv_n};
        iowr_armed <= zpvv_all;
    end
end

// Один такт на цикл записи, в начале строба.
assign iowr_reg = zpvv_all & ~iowr_armed;

assign iord_fall = iord_r  & ~iord;
assign iowr_fall = iowr_r  & ~iowr;
assign ras_fall  = ras_n_r & ~c_ras_n;   // ~RAS перешёл в активный нуль

endmodule

// Такт защёлки 574 строки адреса: чистая комбинация от ~RAS, путь с вывода на
// вывод (сторож MAXDELAY в pins.lpf). syn_hier="hard" -- чтобы Synplify не
// растворил модуль: тогда у его LUT постоянное имя core/bus/lclk, и pins.lpf
// закрепляет их у выводов UGROUP'ом.
module lclk_gate (
    input  wire ras_n,
    input  wire arm,         // latch_arm: разрешение до первого спада в обращении
    input  wire gate_on,     // latch_gate: заморозка включена командой SPI
    input  wire vid_block,
    input  wire vid_gate,
    output wire latch_clk
) /* synthesis syn_hier="hard" */;
assign latch_clk = ~ras_n & (arm | ~gate_on) & ~(vid_block & vid_gate);
endmodule

`default_nettype wire
