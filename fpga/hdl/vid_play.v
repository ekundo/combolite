// Проигрыватель кадра: VGA 720x900@60 по журналу палитры и строчному буферу.
//
// Режим 60 Гц (с 25.10.2026) -- не 800x600, а половина VESA DMT 1440x900@60 (106,5 МГц, строка 1904,
// кадр 934, строчная синхра отрицательная, кадровая положительная). Точка --
// 53,333 МГц (480 / 9, pll_fdc.v), строка 952 точки, видно 720 x 900. Монитор
// с матрицей 1440x900 принимает это за свой родной режим и снимает каждую
// нашу точку дважды своим тактом: точка «Вектора» в режиме 512 -- ровно две
// точки матрицы, в режиме 256 -- четыре. По вертикали строка показа -- ТРИ
// строки VGA: 300 строк показа (22 бордюра, 256 картинки, 22 бордюра) x 3 =
// 900. Картинка 512 точек -- с X0 = 104, по бокам по 104 точки бордюра.
// 50 Гц (576p) пересчитан под новую точку: 26,667 МГц на ce, строка 852,
// видно 728, картинка с 108. Ниже -- текст про прежний 800x600: геометрия
// другая, устройство то же.
//
// Как устроено:
//   * 800x600@60 по VESA, точка 40,000 МГц (pll_fdc.v, CLKOP); синхра
//     положительная; строка 1056, кадр 628;
//   * картинка 512x512 -- точка «Вектора» два на два, по центру: с X0 = 144 и
//     Y0 = 44; строк показа 300, из них 256 картинки и по 22 бордюра;
//   * у каждой строки показа -- строка машины: снимок палитры на её начало и её
//     события (vid_rec.v). Строка самостоятельна, от верха кадра ничего не
//     ведётся, так что 50 Гц машины и 60 наши не склеивают два её кадра;
//   * событие встаёт на экран в том месте строки, где машина его сделала:
//     X0 + 4 x (место - POS_PIC0), место -- такт процессора от начала строки
//     машины (vid_raster.v), такт -- две её точки, четыре наших;
//   * строчный буфер хранит БАЙТЫ СЛОЁВ, то есть индексы, а не цвет: иначе
//     палитра замёрзла бы в момент выборки и мультиколор сломался бы.
//
// ЯЧЕЙКА ПАЛИТРЫ у события:
//   * запись вне картинки -- номер бордюра проигрывателя;
//   * запись «под лучом» (разряд 17, её регистратор поймал в картинке) -- цвет
//     точки, которую проигрыватель рисует в этом месте строки. Такие записи он
//     ещё и несёт вниз (перенос, carry): регистратор их ячейки не знал, и в
//     снимки следующих строк они не попали. Перенос держит ячейку, пока её не
//     перепишет запись вне картинки -- её событие проигрыватель играет сам:
//     за кадр VGA он берёт ВСЕ 312 строк машины, и невидимые тоже (строка
//     готовится на каждой строке VGA, 314 мест на 312 строк). На шве 60 Гц
//     перенос не сбрасывается: ниже шва идёт прошлый кадр машины, и у
//     программ, которые повторяют одно и то же каждый кадр, его состояние то
//     же самое.
//     Сброс на шве убивал бы разовые записи под лучом. Разряд смены ячейки в
//     снимке (переключается на каждой записи вне картинки) тоже не годится:
//     у соседних кадров машины он расходится, если таких записей за кадр
//     нечётное число, -- ниже шва перенос снимался бы, и тесты BORD2 и LENNA
//     мерцали бы половиной экрана.
// Режим 512 (разряд 4 порта B): точка делится пополам, левая половина --
// {0, 0, c1, c0}, правая -- {c3, c2, 0, 0}, как в vector06cc Славинского.
//
// ДВА РЕЖИМА КАДРА:
//   * 60 Гц (основной, mode60 = 1): 800x600@60 по VESA, 40 МГц, строка 1056
//     тактов (37,88 кГц), кадр 628 строк, синхра положительная. Свой ход:
//     кадр склеен из двух кадров машины, у программ, которые меняют картинку
//     от кадра к кадру, по экрану ползёт шов;
//   * 50 Гц (mode60 = 0): развёртка 576p, как в vector06cc Славинского
//     (vga_refresh.v, 640x576): точка -- ДВА такта 40 МГц (разрешение ce),
//     строка 639 точек = 31,95 мкс (31,3 кГц), кадр РОВНО 625 строк, видно
//     546 x 576, синхра отрицательная. 576 строк -- 288 строк машины: 16
//     бордюра, 256 картинки, 16 бордюра; строка машины -- две строки VGA,
//     темп тот же, что у машины. 800x600@50 (757 строк, 37,9 кГц) не
//     стандарт, его не берут ни HP L1908w, ни телевизор через VGA->HDMI; 625
//     строк -- требование скалеров (LeoN, чат «Вектор 06Ц»: BenQ BL702 берёт
//     50 Гц только при 625 строках в кадре).
//     ПРИВЯЗКА К КАДРУ МАШИНЫ -- ОДНА, при входе в режим (ниже, al50):
//     дальше развёртка идёт свободно, строки все одной длины. Почему не
//     подстраивать -- там же.
//
// ГДЕ КАРТИНКА В РАСТРЕ МАШИНЫ: PIC_LINE0 -- строка машины с первой строкой
// картинки (в счёте vid_raster.v), POS_PIC0 -- такт начала картинки в строке.
// Замерено на живой машине журналом портов (combo.py palog):
//   * PIC_LINE0 = 40 -- INTA в строке 0, опора по S ставит 40 + RUN_LONG;
//   * POS_PIC0 = 28 -- тест BORD (Городецкий): записи в
//     порт B на тактах 54 и 90, а на снимке с реала чёрный бордюр начинается
//     над «6» (точка 52) и кончается над «F» (~123): 2 x (54 - 28) = 52,
//     2 x (90 - 28) = 124. При POS_PIC0 = 40 бордюр уезжает на 24 точки влево.
//     Сходится с v06x: начало картинки там на 5,5 такта раньше прерывания, у
//     нас INTA на такте 34.
//
// ВЫБОРКА СТРОК -- чужая забота (vid_fetch.v): кольцо на 32 строки в четырёх
// блоках EBR, выборка идёт впереди показа. Отсюда уходят начало кадра показа
// (frame_tog) и строка картинки на экране (cur_row); обратно -- сколько строк
// готово. Строка не готова к своему показу -- underrun.
`default_nettype none

module vid_play #(
    parameter        RING_BITS = 5,        // строк в кольце выборки: 2^RING_BITS
    parameter [10:0] X0 = 11'd104,         // 720 - 512 = 2 x 104
    parameter [9:0]  Y0 = 10'd66,
    parameter [8:0]  TOP = 9'd22,          // строк показа бордюра над картинкой
    // Строки машины 0..VBL-1 -- кадровый гасящий: 22 строки, потом 18 бордюра,
    // 256 картинки, 16 бордюра (как в v06x, src/filler.cpp). Показ идёт с
    // PIC_LINE0 - TOP = 18 по 317, то есть сверху задевает строки 18..21, а
    // снизу -- 0..5 следующего кадра; там программы перепрограммируют палитру
    // и бордюр (загрузчик -- в строках 0..11), и низ бордюра шёл бы полосами.
    // Эти строки -- чёрные; видно 18 строк бордюра сверху и 16 снизу.
    parameter [8:0]  VBL = 9'd22,
    parameter [8:0]  RL  = 9'd352,         // строк в кольце журнала (vid_rec.v)
    // ВЫБОР КАДРА: в начале нашего кадра -- текущий кадр машины, если её запись
    // ушла от строки 0 не меньше чем на THR строк (иначе к низу картинки мы бы
    // её обогнали), и предыдущий -- если меньше (его верх ещё в кольце). 60 Гц:
    // строка машины у нас 52,8 мкс против 64, низ (строка 311) -- через 15,47
    // мс, машина дойдёт до его конца не раньше, чем с 71-й строки; верх
    // предыдущего кадра (строка 22) затрётся, когда запись уйдёт за 79-ю. 50 Гц:
    // темп тот же, что у машины, хватает 26 строк; верх живёт до 85-й.
    parameter [8:0]  THR60 = 9'd74,
    parameter [8:0]  THR50 = 9'd30,
    parameter [8:0]  PIC_LINE0 = 9'd40,
    parameter [7:0]  POS_PIC0  = 8'd28,
    // 50 Гц (576p): видимая часть строки, картинка с X0_50, бордюр TOP50
    // строк машины над картинкой. Строк кадра -- VTOT50, ровно.
    // точка 50 Гц -- ce, 26,667 МГц: 852 точки = 31,95 мкс, как прежние 639 по 20
    parameter [10:0] X0_50     = 11'd108,  // 728 - 512 = 2 x 108
    parameter [8:0]  TOP50     = 9'd16,
    parameter [9:0]  VTOT50    = 10'd625,
    parameter [10:0] HTOT50    = 11'd852,  // точек строки без поправки
    // Где наша развёртка на строке 0 машины в режиме 50 Гц: строка VGA
    // 2 x (288 - L), L -- на сколько строк машины показ отстаёт от неё. При
    // L = 86 (5,5 мс) -- 404.
    // Показ здесь идёт в темпе машины, отставание постоянно.
    parameter [9:0]  LOCK50    = 10'd404,
    parameter [9:0]  LOCK_VC   = LOCK50    // цель привязки
) (
    input  wire        clk,               // 53,333 МГц
    input  wire        mode60,            // 1 -- 720x900@60, 0 -- 576p 50 Гц с привязкой
    input  wire        mframe_tog,        // строка 0 машины (vid_raster.v), в чужом такте
    // журнал и снимки (vid_rec.v), чтение с задержкой в такт
    output wire [12:0] ev_raddr,
    input  wire [17:0] ev_q,
    output wire [12:0] sn_raddr,
    input  wire [8:0]  sn_q,
    // где запись (vid_rec.v, «КОЛЬЦО»), в чужом такте
    input  wire [8:0]  rec_line,
    input  wire [8:0]  fb_last,
    input  wire [8:0]  fb_prev,
    input  wire [15:0] vm_last,
    input  wire [15:0] vm_prev,
    // строчный буфер: пишет выборка в своём такте
    input  wire        wclk,
    input  wire        lb_we,
    input  wire [RING_BITS+6:0] lb_waddr, // {строка, слой 2, колонка 5}
    input  wire [7:0]  lb_wdata,
    // выборка
    output reg         frame_tog = 1'b0,
    output reg  [7:0]  cur_row = 8'd0,    // строка картинки 0..255
    input  wire [8:0]  fetched,           // строк кадра готово (в чужом такте)
    // VGA
    output reg  [2:0]  vga_r = 3'd0,
    output reg  [2:0]  vga_g = 3'd0,
    output reg  [1:0]  vga_b = 2'd0,
    output reg         vga_hs = 1'b0,
    output reg         vga_vs = 1'b0,
    output reg  [7:0]  underrun = 8'd0,
    // для диагностики: режим кадра и ошибка привязки на последней строке 0
    // машины (в строках, со знаком; 0 -- привязка точная)
    output wire        m60_o,
    output reg  [9:0]  vrem_o = 10'd0,    // строк до начала следующего кадра (vid_fetch.v)
    output wire        ce_o,              // разрешение такта: чтение журнала (vid_rec.v)
    output reg  [7:0]  lock_err_o = 8'd0
);

localparam [10:0] HTOT60 = 11'd952;
localparam [9:0]  VTOT60 = 10'd934;

reg        m60 = 1'b1;                 // режим, меняется только на границе кадра
// 50 Гц: точка -- два такта. Всё ниже идёт по ce.
reg        ce_t = 1'b0;
wire       ce = m60 | ce_t;
always @(posedge clk) ce_t <= ~ce_t;

// ---------------------------------------------------------- строчный буфер
// Четыре блока EBR по два разряда байта: при RING_BITS = 5 это 4096 x 2, родной
// режим блока, и выбирать банк не нужно (bram.v).
wire [7:0] lb_q;
wire [RING_BITS+6:0] lb_raddr;
genvar gl;
generate
    for (gl = 0; gl < 4; gl = gl + 1) begin : g_lb
        bram_sdp #(.AW(RING_BITS + 7), .DW(2)) b (
            .wclk(wclk), .we(lb_we), .wa(lb_waddr), .wd(lb_wdata[2*gl +: 2]),
            .rclk(clk), .re(ce), .ra(lb_raddr), .q(lb_q[2*gl +: 2]));
    end
endgenerate

// ---------------------------------------------------------- развёртка

// Геометрия по режиму (в точках): видимая часть, передний край, синхра.
wire [10:0] HVIS = m60 ? 11'd720 : 11'd728;
wire [10:0] HFP  = m60 ? 11'd40  : 11'd8;
wire [10:0] HSYN = m60 ? 11'd76  : 11'd63;
wire [9:0]  VVIS = m60 ? 10'd900 : 10'd576;
wire [9:0]  VFP  = m60 ? 10'd3   : 10'd5;
wire [9:0]  VSYN = m60 ? 10'd6   : 10'd5;
wire [10:0] XP0  = m60 ? X0  : X0_50;
wire [8:0]  TOPM = m60 ? TOP : TOP50;
// Подготовка строки (снимок, vid_rec.v) -- после того, как события прошлой
// строки доиграны: события правее видимой части доигрываются в гашении.
wire [10:0] HSN  = HVIS + 11'd40;

reg [10:0] hc = 11'd0;
reg [9:0]  vc = 10'd0;
reg [10:0] htot_m1 = HTOT60 - 11'd1;   // точек в ТЕКУЩЕЙ строке, без одной
reg [9:0]  vtot = VTOT60;              // строк в текущем кадре
reg [1:0]  md_s = 2'b11;
reg [2:0]  mf_s = 3'b000;
wire       hend = (hc == htot_m1);
// Следующая строка VGA и всё, что от неё зависит, -- РЕГИСТРАМИ, на такт-два
// позже смены vc: нужны они на конце строки (hend) и на подготовке (HSN), то
// есть через сотни тактов, а одной комбинацией от vc до строки кольца выходило
// 24 нс (rev4-6layer-33, 19 уровней) -- для 53 МГц это вдвое длиннее такта.
// Строка показа -- счётчиком: nd = номер строки показа, ns = строка VGA в ней
// (0..LPD-1, LPD = 3 в 60 Гц, 2 в 50 Гц).
reg [9:0]  nvc = 10'd1;
reg [8:0]  cd = 9'd0;                  // строка показа текущей строки VGA
reg [1:0]  cs = 2'd0;                  // и строка VGA в ней
wire [1:0] lpd_m1 = m60 ? 2'd2 : 2'd1;
wire       vlast = (vc == vtot - 10'd1);
// то же для следующей строки VGA
wire [8:0] nd = vlast ? 9'd0 : (cs == lpd_m1) ? cd + 9'd1 : cd;
wire [1:0] ns = (vlast || cs == lpd_m1) ? 2'd0 : cs + 2'd1;
always @(posedge clk) nvc <= vlast ? 10'd0 : vc + 10'd1;
wire       mframe = mf_s[2] ^ mf_s[1];
wire signed [10:0] lock_err = $signed({1'b0, vc}) - $signed({1'b0, LOCK50});

// Привязка 50 Гц -- ОДНА: при входе в режим, на первой строке 0 машины, наша
// развёртка встаёт на LOCK50 (строкой и точкой), дальше идёт свободно.
// Подстраивать длину строки HP L1908w не даёт: поправки на точку, разложенные
// по кадру, -- картинка дрожит и вертикали наклонно; собранные в кадровом гашении с перескоками (-20) -- монитор
// теряет синхронизацию и моргает. Цена свободного хода: наш кадр уходит от
// кадра машины (по номиналу 625 x 639 точек длиннее 312 x 64 мкс на 15 точек
// за кадр, плюс разница кварцев), и раз в несколько минут по экрану медленно
// проходит шов. Ошибка привязки на каждой строке 0 машины -- в диагностику.
reg        al50 = 1'b0;                // 50 Гц уже выставлен на LOCK50

always @(posedge clk) if (ce) begin
    md_s <= {md_s[0], mode60};
    mf_s <= {mf_s[1:0], mframe_tog};
    hc <= hend ? 11'd0 : hc + 11'd1;
    if (hend) begin
        vc <= nvc;
        cd <= nd;
        cs <= ns;
        if (nvc == 10'd0) begin            // новый кадр: режим и длина
            m60  <= md_s[1];
            vtot <= md_s[1] ? VTOT60 : VTOT50;
            if (md_s[1]) al50 <= 1'b0;
        end
        htot_m1 <= m60 ? HTOT60 - 11'd1 : HTOT50 - 11'd1;
    end
    // строка 0 машины: ошибка привязки -- в диагностику; первый раз -- встать
    if (mframe && !m60) begin
        lock_err_o <= (lock_err > 11'sd127) ? 8'sd127 : (lock_err < -11'sd127) ? -8'sd127
                    : lock_err[7:0];
        if (!al50) begin
            vc   <= LOCK50;
            cd   <= LOCK50[9:1];           // 50 Гц: строка показа -- две строки VGA
            cs   <= {1'b0, LOCK50[0]};
            hc   <= 11'd0;
            al50 <= 1'b1;
        end
    end
end

// ---------------------------------------------------------- выбор кадра
// Где запись, -- из чужого такта, по совпадению двух отсчётов: меняется раз в
// строку машины. Кадр машины на весь наш кадр выбирается в его начале
// (fsel_*), см. THR60.
reg  [58:0] rs1 = 59'd0, rs2 = 59'd0, rsv = 59'd0;
always @(posedge clk) begin
    rs1 <= {rec_line, fb_last, fb_prev, vm_last, vm_prev};
    rs2 <= rs1;
    if (rs1 == rs2) rsv <= rs2;
end
wire [8:0]  s_line = rsv[58:50];
wire [8:0]  s_fbl  = rsv[49:41];
wire [8:0]  s_fbp  = rsv[40:32];
wire [15:0] s_vml  = rsv[31:16];
wire [15:0] s_vmp  = rsv[15:0];
// запись ещё в гасящих строках -- новый кадр в кольце не начат, «последний»
// и есть предыдущий; дальше -- по порогу
wire        use_last = (s_line < VBL) || (s_line >= (md_s[1] ? THR60 : THR50));
reg  [8:0]  fsel_b = 9'd0;

// строка показа следующей строки VGA и её строка машины -- регистрами (см.
// «развёртка»): nd 0..311 (60 Гц, 934 = 3 x 311 + 1) или 0..312 (50), видимые
// 0..299 (60), 0..287 (50)
reg        nvis = 1'b0;
reg        npic = 1'b0;
reg  [7:0] ny = 8'd0;                                 // строка картинки
reg  [8:0] nm = 9'd0;
wire [9:0] m_raw = {1'b0, PIC_LINE0} - {1'b0, TOPM} + {1'b0, nd};
always @(posedge clk) begin
    nvis  <= nvc < VVIS;
    npic  <= nvc < VVIS && nd >= TOPM && nd < TOPM + 9'd256;
    ny    <= nd - TOPM;
    nm    <= (m_raw >= 10'd312) ? m_raw - 10'd312 : m_raw[8:0];
end

reg        pic_line = 1'b0;
reg  [RING_BITS-1:0] row_slot = 0;
reg        vis_line = 1'b0;

// ---------------------------------------------------------- выборка
// fetched меняется раз в строку выборки: берём, когда два отсчёта совпали.
reg [8:0] f1 = 9'd0, f2 = 9'd0, fsync = 9'd0;
always @(posedge clk) if (ce) begin
    f1 <= fetched; f2 <= f1;
    if (f1 == f2) fsync <= f2;
    if (hend) begin
        pic_line <= npic;
        row_slot <= ny[RING_BITS-1:0];
        vis_line <= nvis && nm >= VBL;
        if (nvc == 10'd0) begin frame_tog <= ~frame_tog; cur_row <= 8'd0; end
        // первая строка VGA строки картинки: она обязана быть готова
        if (npic && ns == 2'd0) begin
            cur_row <= ny;
            if (fsync <= {1'b0, ny})
                underrun <= (&underrun) ? underrun : underrun + 8'd1;
        end
    end
end

// ---------------------------------------------------------- палитра строки
// Рабочая палитра -- в распределённой памяти: пишет снимок и события, читает
// точка. Адрес чтения один: либо точка картинки, либо бордюр.
reg  [7:0] wk [0:15];
integer k;
initial for (k = 0; k < 16; k = k + 1) wk[k] = 8'h00;
reg        wk_we = 1'b0;
reg  [3:0] wk_wa = 4'd0;
reg  [7:0] wk_wd = 8'd0;
always @(posedge clk) if (wk_we) wk[wk_wa] <= wk_wd;

// Точка под лучом (ниже, в разделе «точки»): нужна и событиям «под лучом».
wire [3:0] idx;
wire       show;

reg  [3:0] wbd = 4'd0;                 // номер бордюра
reg        m512 = 1'b0;
reg        pv = 1'b0;                  // готовим видимую строку (не гасящую)
reg  [8:0] rline = 9'd0;               // её строка кольца

// Перенос записей «под лучом» на следующие строки: значение по ячейке и
// признак, что оно есть. Пишется только на ПОСЛЕДНЕЙ строке VGA каждой строки
// показа (второй из двух в 50 Гц, третьей из трёх в 60): на прежних снимок той
// же строки машины ещё обязан взять перенос без её собственных записей.
reg  [7:0] cr [0:15];
initial for (k = 0; k < 16; k = k + 1) cr[k] = 8'h00;
reg [15:0] cv = 16'h0000;
reg        cr_we = 1'b0;
reg  [3:0] cr_wa = 4'd0;
reg  [7:0] cr_wd = 8'd0;
always @(posedge clk) if (cr_we) cr[cr_wa] <= cr_wd;
reg        sec = 1'b0;                 // готовим последнюю строку VGA строки показа

// подготовка: снимок (9 слов, по две ячейки -- два такта на слово), потом
// события. Начинается в конце видимой части строки VGA, для следующей.
localparam [1:0] P_IDLE = 2'd0, P_SN = 2'd1, P_EV = 2'd2;
reg  [1:0]  ph = P_IDLE;
reg  [8:0]  pm = 9'd0;                 // строка машины, которую готовим
reg  [4:0]  si = 5'd0;                 // такт снимка: адрес si[4:1], половина si[0]
reg  [4:0]  ep = 5'd0;
reg         inl = 1'b0;                // строка, для которой готовили, уже идёт
reg  [2:0]  ev_v = 3'b000;             // ev_q соответствует ep -- через два такта
                                       // после смены адреса (vid_rec.v), ev_r и
wire        ev_ok = ev_v[2];           // e_x_r -- через три

// Снимок: 16 слов, по ячейке на такт; разряд 8 слов 0..4 -- порт B.
// События -- до слова-конца {11, ...} или до шестнадцатого.
assign sn_raddr = {rline, si[3:0]};
assign ev_raddr = {rline, ep[3:0]};
// строка кольца для строки машины nm выбранного кадра
wire [9:0] rl_sum = {1'b0, fsel_b} + {1'b0, nm - VBL};
reg  [8:0] rl_nm  = 9'd0;
always @(posedge clk) rl_nm <= (rl_sum >= {1'b0, RL}) ? rl_sum[8:0] - RL : rl_sum[8:0];

// место события на экране -- регистром за ev_q: от выхода блока памяти через
// сумматор и сравнение с hc в одном такте 53 МГц не уложиться
wire [7:0]         e_pos  = ev_q[15:8];
wire signed [12:0] e_x    = $signed({2'b00, XP0}) +
                            $signed({{3{1'b0}}, e_pos, 2'b00}) -
                            $signed({{3{1'b0}}, POS_PIC0, 2'b00});
// событие тактом позже: нужны только разряды 17..16 (что это) и 7..0 (значение)
reg  [17:0]        ev_r   = 18'd0;
reg  signed [12:0] e_x_r  = 13'sd0;
reg                e_neg  = 1'b0;
always @(posedge clk) if (ce) begin
    ev_r[17:16] <= ev_q[17:16];
    ev_r[7:0]   <= ev_q[7:0];
    e_x_r <= e_x;
    e_neg <= e_x < 0;
end
wire               e_term = ev_r[17] & ev_r[16];
wire               e_due  = ev_ok && pv && ep < 5'd16 && !e_term &&
                            (e_neg || (inl && ($signed({2'b00, hc}) >= e_x_r || hc >= HVIS)));

// слово снимка приходит тактом позже адреса
reg  [4:0] si_d = 5'd0;
reg        sn_v = 1'b0;
wire [3:0] sn_cell = si_d[3:0];

always @(posedge clk) if (ce) begin
    wk_we <= 1'b0;
    cr_we <= 1'b0;
    sn_v  <= (ph == P_SN);
    si_d  <= si;
    if (hend) inl <= 1'b1;
    // начало нашего кадра: кадр машины на весь кадр; ячейки, записанные в
    // гасящих строках перед ним, снимают перенос
    if (hend && nvc == 10'd0) begin
        fsel_b <= use_last ? s_fbl : s_fbp;
        cv     <= cv & ~(use_last ? s_vml : s_vmp);
    end

    case (ph)
    P_IDLE:
        if (hc == HSN) begin
            pm  <= nm;
            pv  <= nm >= VBL;
            rline <= rl_nm;
            sec <= (ns == lpd_m1);
            si  <= 5'd0;
            ph  <= P_SN;
            inl <= 1'b0;
        end
    P_SN: begin
        si <= si + 5'd1;
        if (si == 5'd16) begin ph <= P_EV; ep <= 5'd0; ev_v <= 3'b000; end
    end
    P_EV: begin
        ev_v <= {ev_v[1:0], 1'b1};
        if (e_due) begin
            if (ev_r[16]) begin wbd <= ev_r[3:0]; m512 <= ev_r[4]; end
            else if (ev_r[17]) begin
                // под лучом: ячейка -- точка, которую рисуем сейчас
                wk_we <= 1'b1; wk_wa <= show ? idx : wbd; wk_wd <= ev_r[7:0];
                if (sec) begin
                    cr_we <= 1'b1; cr_wa <= show ? idx : wbd; cr_wd <= ev_r[7:0];
                    cv[show ? idx : wbd] <= 1'b1;
                end
            end
            else begin
                wk_we <= 1'b1; wk_wa <= wbd; wk_wd <= ev_r[7:0];
                if (sec) cv[wbd] <= 1'b0;        // известная запись новее переноса
            end
            ep    <= ep + 5'd1;
            ev_v  <= 3'b000;                     // новое слово -- через три такта
        end
        if (inl && hc == HSN - 11'd1) ph <= P_IDLE;
    end
    default: ph <= P_IDLE;
    endcase

    // снимок: ячейки 0..15, разряд 8 слов 0..4 -- порт B; ячейка с переносом
    // берётся из переноса
    if (sn_v && pv && !si_d[4]) begin
        wk_we <= 1'b1;
        wk_wa <= sn_cell;
        wk_wd <= cv[sn_cell] ? cr[sn_cell] : sn_q[7:0];
        if (si_d[3:0] < 4'd4)  wbd[si_d[1:0]] <= sn_q[8];
        if (si_d[3:0] == 4'd4) m512 <= sn_q[8];
    end
end

// ---------------------------------------------------------- точки
// pc: 0..527 от X0 - 16. Группа g = pc[9:4] (0..32): в группе g выбирается
// колонка g (четыре слоя, по такту), показывается колонка g - 1. Точка
// «Вектора» -- два такта, в колонке восемь.
reg  [9:0] pc = 10'd0;
reg        run = 1'b0;
reg  [7:0] nxt0, nxt1, nxt2, nxt3;
reg  [7:0] cur0, cur1, cur2, cur3;
wire [4:0] col = pc[8:4];

assign lb_raddr = {row_slot, pc[1:0], col};

always @(posedge clk) if (ce) begin
    if (hc == XP0 - 11'd17 && pic_line) begin run <= 1'b1; pc <= 10'd0; end
    else if (run) begin
        pc <= pc + 10'd1;
        if (pc == 10'd527) run <= 1'b0;
    end
    // адрес слоя s -- на pc[3:0] = s, байт -- тактом позже
    if (run && pc[3:2] == 2'b00)
        case (pc[1:0])
        2'd1: nxt0 <= lb_q;
        2'd2: nxt1 <= lb_q;
        2'd3: nxt2 <= lb_q;
        default: ;
        endcase
    if (run && pc[3:0] == 4'd4) nxt3 <= lb_q;
    if (run && pc[3:0] == 4'd15) begin
        cur0 <= nxt0; cur1 <= nxt1; cur2 <= nxt2; cur3 <= nxt3;
    end
end

wire [2:0] bitn = 3'd7 - pc[3:1];
wire [3:0] idx4 = {cur0[bitn], cur1[bitn], cur2[bitn], cur3[bitn]};
assign m60_o = m60;
always @(posedge clk) vrem_o <= vtot - vc;
assign ce_o  = ce;
assign idx  = !m512  ? idx4
            : !pc[0] ? {2'b00, idx4[1:0]} : {idx4[3:2], 2'b00};
assign show = run && pc >= 10'd16;
wire       vis  = (hc < HVIS) && vis_line;
wire [7:0] c    = wk[show ? idx : wbd];

always @(posedge clk) if (ce) begin
    vga_r  <= vis ? c[2:0] : 3'd0;
    vga_g  <= vis ? c[5:3] : 3'd0;
    vga_b  <= vis ? c[7:6] : 2'd0;
    // 60 Гц (DMT 1440x900): строчная отрицательная, кадровая положительная;
    // 50 Гц (576p): обе отрицательные
    vga_hs <= !((hc >= HVIS + HFP) && (hc < HVIS + HFP + HSYN));
    vga_vs <= ((vc >= VVIS + VFP) && (vc < VVIS + VFP + VSYN)) ~^ m60;
end

endmodule

`default_nettype wire
